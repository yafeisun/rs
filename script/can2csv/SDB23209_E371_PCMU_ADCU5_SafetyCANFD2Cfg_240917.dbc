// *************************************************************************** *
// *                                                                           *
// * Description:         CANDB File                                           *
// * Generated at:        2024-09-17 14:55                                     *
// * System:              SDB23200                                             *
// * Variant:             E371_PCMU_ADCU5                                      *
// * Network:             SafetyCANFD2                                         *
// *                                                                           *
// *************************************************************************** *
VERSION "SafetyCANFD2"

NS_ :

BS_ :

BU_ :  ASDM ETC FLR4

BO_ 101 AdmcSafetyCANFD2Frame01 : 64 ASDM
 SG_ AgDataRawSafe_UB : 9|1@0+ (1,0) [0|1] "" FLR4
 SG_ AgDataRawSafeChks : 55|8@0+ (1.0,0.0) [0.0|255.0] "Unitless" FLR4
 SG_ AgDataRawSafeCntr : 63|4@0+ (1.0,0.0) [0.0|15.0] "Unitless" FLR4
 SG_ AgDataRawSafeRollRate : 23|16@0- (0.000244140625,0.0) [-6.0|6.0] "rad/s" FLR4
 SG_ AgDataRawSafeRollRateQf : 59|2@0+ (1,0) [0|3] "" FLR4
 SG_ AgDataRawSafeYawRate : 39|16@0- (0.000244140625,0.0) [-6.0|6.0] "rad/s" FLR4
 SG_ AgDataRawSafeYawRateQf : 57|2@0+ (1,0) [0|3] "" FLR4

BO_ 848 AdmcSafetyCANFD2Frame02 : 64 ASDM
 SG_ AbsCtrlActv_UB : 58|1@0+ (1,0) [0|1] "" FLR4
 SG_ AbsCtrlActvChks : 55|8@0+ (1.0,0.0) [0.0|255.0] "Unitless" FLR4
 SG_ AbsCtrlActvCntr : 63|4@0+ (1.0,0.0) [0.0|15.0] "Unitless" FLR4
 SG_ AbsCtrlActvCtrlSts1 : 59|1@0+ (1,0) [0|1] "" FLR4
 SG_ AsySftyEnaDecelAckd : 57|1@0+ (1,0) [0|1] "" FLR4
 SG_ AsySftyEnaDecelAckd_UB : 56|1@0+ (1,0) [0|1] "" FLR4
 SG_ BrkSysCylPMst_UB : 6|1@0+ (1,0) [0|1] "" FLR4
 SG_ BrkSysCylPMstAct : 23|10@0+ (0.3,-30.0) [-30.0|276.59999999999997] "bar" FLR4
 SG_ BrkSysCylPMstActQf : 5|2@0+ (1,0) [0|3] "" FLR4
 SG_ BrkSysCylPMstChks : 15|8@0+ (1.0,0.0) [0.0|255.0] "Unitless" FLR4
 SG_ BrkSysCylPMstCntr : 3|4@0+ (1.0,0.0) [0.0|15.0] "Unitless" FLR4
 SG_ BrkSysCylPMstTar : 29|10@0+ (0.25,0.0) [0.0|250.0] "bar" FLR4
 SG_ BrkSysCylPMstVirt : 35|10@0+ (0.25,0.0) [0.0|250.0] "bar" FLR4
 SG_ BrkSysCylPMstVirtQf : 41|2@0+ (1,0) [0|3] "" FLR4
 SG_ EpbSts_UB : 7|1@0+ (1,0) [0|1] "" FLR4
 SG_ EpbStsChks : 71|8@0+ (1.0,0.0) [0.0|255.0] "Unitless" FLR4
 SG_ EpbStsCntr : 75|4@0+ (1.0,0.0) [0.0|15.0] "Unitless" FLR4
 SG_ EpbStsEpbSts : 79|4@0+ (1,0) [0|15] "" FLR4
 SG_ EscCtrlIndcn : 292|2@0+ (1,0) [0|3] "" FLR4
 SG_ EscCtrlIndcn_UB : 290|1@0+ (1,0) [0|1] "" FLR4
 SG_ EscSt_UB : 87|1@0+ (1,0) [0|1] "" FLR4
 SG_ EscStChks : 95|8@0+ (1.0,0.0) [0.0|255.0] "Unitless" FLR4
 SG_ EscStCntr : 83|4@0+ (1.0,0.0) [0.0|15.0] "Unitless" FLR4
 SG_ EscStEscSt : 86|3@0+ (1,0) [0|7] "" FLR4
 SG_ GearLvrIndcn : 295|3@0+ (1,0) [0|7] "" FLR4
 SG_ GearLvrIndcn_UB : 289|1@0+ (1,0) [0|1] "" FLR4
 SG_ StandStillMgrStsForHld_UB : 103|1@0+ (1,0) [0|1] "" FLR4
 SG_ StandStillMgrStsForHld1 : 102|3@0+ (1,0) [0|7] "" FLR4
 SG_ StandStillMgrStsForHldChks : 111|8@0+ (1.0,0.0) [0.0|255.0] "Unitless" FLR4
 SG_ StandStillMgrStsForHldCntr : 99|4@0+ (1.0,0.0) [0.0|15.0] "Unitless" FLR4
 SG_ VehTiAndData_UB : 119|1@0+ (1,0) [0|1] "" FLR4
 SG_ VehTiAndDataDataValid : 118|1@0+ (1,0) [0|1] "" FLR4
 SG_ VehTiAndDataDay : 140|5@0+ (1.0,0.0) [1.0|31.0] "Days" FLR4
 SG_ VehTiAndDataHr1 : 132|5@0+ (1.0,0.0) [0.0|23.0] "hours" FLR4
 SG_ VehTiAndDataMins1 : 125|6@0+ (1.0,0.0) [0.0|59.0] "Mins" FLR4
 SG_ VehTiAndDataMth1 : 147|4@0+ (1.0,0.0) [1.0|12.0] "Month" FLR4
 SG_ VehTiAndDataSec1 : 117|6@0+ (1.0,0.0) [0.0|59.0] "s" FLR4
 SG_ VehTiAndDataYr1 : 158|7@0+ (1.0,0.0) [0.0|99.0] "Year" FLR4
 SG_ WhlDirRotlFrnt_UB : 288|1@0+ (1,0) [0|1] "" FLR4
 SG_ WhlDirRotlFrntChks : 167|8@0+ (1.0,0.0) [0.0|255.0] "Unitless" FLR4
 SG_ WhlDirRotlFrntCntr : 175|4@0+ (1.0,0.0) [0.0|15.0] "Unitless" FLR4
 SG_ WhlDirRotlFrntLe : 171|2@0+ (1,0) [0|3] "" FLR4
 SG_ WhlDirRotlFrntRi : 169|2@0+ (1,0) [0|3] "" FLR4
 SG_ WhlDirRotlRe_UB : 232|1@0+ (1,0) [0|1] "" FLR4
 SG_ WhlDirRotlReChks : 183|8@0+ (1.0,0.0) [0.0|255.0] "Unitless" FLR4
 SG_ WhlDirRotlReCntr : 187|4@0+ (1.0,0.0) [0.0|15.0] "Unitless" FLR4
 SG_ WhlDirRotlReLe : 191|2@0+ (1,0) [0|3] "" FLR4
 SG_ WhlDirRotlReRi : 189|2@0+ (1,0) [0|3] "" FLR4
 SG_ WhlSpdCircumlFrnt_UB : 199|1@0+ (1,0) [0|1] "" FLR4
 SG_ WhlSpdCircumlFrntChks : 215|8@0+ (1.0,0.0) [0.0|255.0] "Unitless" FLR4
 SG_ WhlSpdCircumlFrntCntr : 223|4@0+ (1.0,0.0) [0.0|15.0] "Unitless" FLR4
 SG_ WhlSpdCircumlFrntLe : 198|15@0+ (0.00391,0.0) [0.0|125.0027] "m/s" FLR4
 SG_ WhlSpdCircumlFrntLeQf : 219|2@0+ (1,0) [0|3] "" FLR4
 SG_ WhlSpdCircumlFrntRiQf : 217|2@0+ (1,0) [0|3] "" FLR4
 SG_ WhlSpdCircumlFrntWhlSpdCircumlFrntRi : 231|15@0+ (0.00391,0.0) [0.0|125.0027] "m/s" FLR4
 SG_ WhlSpdCircumlRe_UB : 247|1@0+ (1,0) [0|1] "" FLR4
 SG_ WhlSpdCircumlReChks : 263|8@0+ (1.0,0.0) [0.0|255.0] "Unitless" FLR4
 SG_ WhlSpdCircumlReCntr : 271|4@0+ (1.0,0.0) [0.0|15.0] "Unitless" FLR4
 SG_ WhlSpdCircumlReLe : 246|15@0+ (0.00391,0.0) [0.0|125.0027] "m/s" FLR4
 SG_ WhlSpdCircumlReLeQf : 267|2@0+ (1,0) [0|3] "" FLR4
 SG_ WhlSpdCircumlReRi : 279|15@0+ (0.00391,0.0) [0.0|125.0027] "m/s" FLR4
 SG_ WhlSpdCircumlReRiQf : 265|2@0+ (1,0) [0|3] "" FLR4

BO_ 405 AdmcSafetyCANFD2Frame03 : 64 ASDM
 SG_ AgDataCmpQuality_UB : 95|1@0+ (1,0) [0|1] "" FLR4
 SG_ AgDataCmpQualityPitchRateCmpQuality : 71|8@0+ (1.0,0.0) [0.0|255.0] "Unitless" FLR4
 SG_ AgDataCmpQualityRollRateCmpQuality : 79|8@0+ (1.0,0.0) [0.0|255.0] "Unitless" FLR4
 SG_ AgDataCmpQualityYawRateCmpQuality : 87|8@0+ (1.0,0.0) [0.0|255.0] "Unitless" FLR4
 SG_ BrkTracCtrlActv : 6|1@0+ (1,0) [0|1] "" FLR4
 SG_ BrkTracCtrlActv_UB : 5|1@0+ (1,0) [0|1] "" FLR4
 SG_ ExtrLtgSts_UB : 4|1@0+ (1,0) [0|1] "" FLR4
 SG_ ExtrLtgStsAFS : 23|2@0+ (1,0) [0|3] "" FLR4
 SG_ ExtrLtgStsAHBC : 21|2@0+ (1,0) [0|3] "" FLR4
 SG_ ExtrLtgStsAHL : 19|2@0+ (1,0) [0|3] "" FLR4
 SG_ ExtrLtgStsAllWL : 17|2@0+ (1,0) [0|3] "" FLR4
 SG_ ExtrLtgStsApproach : 31|2@0+ (1,0) [0|3] "" FLR4
 SG_ ExtrLtgStsChks : 15|8@0+ (1.0,0.0) [0.0|255.0] "Unitless" FLR4
 SG_ ExtrLtgStsCntr : 3|4@0+ (1.0,0.0) [0.0|15.0] "Unitless" FLR4
 SG_ ExtrLtgStsCornrgLi : 29|2@0+ (1,0) [0|3] "" FLR4
 SG_ ExtrLtgStsDBL : 27|2@0+ (1,0) [0|3] "" FLR4
 SG_ ExtrLtgStsDRL : 25|2@0+ (1,0) [0|3] "" FLR4
 SG_ ExtrLtgStsFlash : 39|2@0+ (1,0) [0|3] "" FLR4
 SG_ ExtrLtgStsFrntFog : 37|2@0+ (1,0) [0|3] "" FLR4
 SG_ ExtrLtgStsGoodbye : 35|2@0+ (1,0) [0|3] "" FLR4
 SG_ ExtrLtgStsHiBeam : 33|2@0+ (1,0) [0|3] "" FLR4
 SG_ ExtrLtgStsHomeSafe : 47|2@0+ (1,0) [0|3] "" FLR4
 SG_ ExtrLtgStsHWL : 45|2@0+ (1,0) [0|3] "" FLR4
 SG_ ExtrLtgStsLoBeam : 43|2@0+ (1,0) [0|3] "" FLR4
 SG_ ExtrLtgStsLtgShow : 41|2@0+ (1,0) [0|3] "" FLR4
 SG_ ExtrLtgStsPosLiFrnt : 55|2@0+ (1,0) [0|3] "" FLR4
 SG_ ExtrLtgStsPosLiRe : 53|2@0+ (1,0) [0|3] "" FLR4
 SG_ ExtrLtgStsReFog : 51|2@0+ (1,0) [0|3] "" FLR4
 SG_ ExtrLtgStsReverseLi : 49|2@0+ (1,0) [0|3] "" FLR4
 SG_ ExtrLtgStsStopLi : 63|2@0+ (1,0) [0|3] "" FLR4
 SG_ ExtrLtgStsTurnIndrLe : 61|2@0+ (1,0) [0|3] "" FLR4
 SG_ ExtrLtgStsTurnIndrRi : 59|2@0+ (1,0) [0|3] "" FLR4
 SG_ ExtrLtgStsWelcome : 57|2@0+ (1,0) [0|3] "" FLR4
 SG_ LvlgDirMovmtIndcr : 169|2@0+ (1,0) [0|3] "" FLR4
 SG_ LvlgDirMovmtIndcr_UB : 148|1@0+ (1,0) [0|1] "" FLR4

BO_ 837 AdmcSafetyCANFD2Frame04 : 64 ASDM
 SG_ VehCfgPrmExt_UB : 134|1@0+ (1,0) [0|1] "" FLR4
 SG_ VehCfgPrmExtBlkIDBytePosn1 : 71|8@0+ (1.0,0.0) [0.0|255.0] "Unitless" FLR4
 SG_ VehCfgPrmExtCCPBytePosn2 : 79|8@0+ (1.0,0.0) [0.0|255.0] "Unitless" FLR4
 SG_ VehCfgPrmExtCCPBytePosn3 : 87|8@0+ (1.0,0.0) [0.0|255.0] "Unitless" FLR4
 SG_ VehCfgPrmExtCCPBytePosn4 : 95|8@0+ (1.0,0.0) [0.0|255.0] "Unitless" FLR4
 SG_ VehCfgPrmExtCCPBytePosn5 : 103|8@0+ (1.0,0.0) [0.0|255.0] "Unitless" FLR4
 SG_ VehCfgPrmExtCCPBytePosn6 : 111|8@0+ (1.0,0.0) [0.0|255.0] "Unitless" FLR4
 SG_ VehCfgPrmExtCCPBytePosn7 : 119|8@0+ (1.0,0.0) [0.0|255.0] "Unitless" FLR4
 SG_ VehCfgPrmExtCCPBytePosn8 : 127|8@0+ (1.0,0.0) [0.0|255.0] "Unitless" FLR4

BO_ 853 AdmcSafetyCANFD2Frame05 : 64 ASDM
 SG_ AD4HDMapRoadTyp : 7|3@0+ (1,0) [0|7] "" FLR4
 SG_ AD4HDMapRoadTyp_UB : 4|1@0+ (1,0) [0|1] "" FLR4
 SG_ AgDataRaw2Safe_UB : 350|1@0+ (1,0) [0|1] "" FLR4
 SG_ AgDataRaw2SafeChks : 359|8@0+ (1.0,0.0) [0.0|255.0] "Unitless" FLR4
 SG_ AgDataRaw2SafeCntr : 347|4@0+ (1.0,0.0) [0.0|15.0] "Unitless" FLR4
 SG_ AgDataRaw2SafePitchRate : 367|16@0- (0.000244140625,0.0) [-6.0|6.0] "rad/s" FLR4
 SG_ AgDataRaw2SafePitchRateQf : 349|2@0+ (1,0) [0|3] "" FLR4
 SG_ FrntRdrMdlPrm_UB : 0|1@0+ (1,0) [0|1] "" FLR4
 SG_ FrntRdrMdlPrmRdrMountPit : 15|16@0+ (0.01,-90.0) [-90.0|90.0] "Deg" FLR4
 SG_ FrntRdrMdlPrmRdrMountPosnInDirX : 31|16@0+ (1.0,0.0) [0.0|65535.0] "mm" FLR4
 SG_ FrntRdrMdlPrmRdrMountPosnInDirY : 47|16@0+ (1.0,0.0) [0.0|65535.0] "mm" FLR4
 SG_ FrntRdrMdlPrmRdrMountPosnInDirZ : 63|16@0+ (1.0,0.0) [0.0|65535.0] "mm" FLR4
 SG_ FrntRdrMdlPrmRdrMountRoll : 79|16@0+ (0.01,-90.0) [-90.0|90.0] "Deg" FLR4
 SG_ FrntRdrMdlPrmRdrMountYaw : 95|16@0+ (0.01,-90.0) [-90.0|90.0] "Deg" FLR4
 SG_ FrntRdrMdlPrmVehBas : 111|16@0+ (1.0,0.0) [0.0|65535.0] "mm" FLR4
 SG_ FrntRdrMdlPrmVehFrntPosnInDirX : 127|16@0+ (1.0,0.0) [0.0|65535.0] "mm" FLR4
 SG_ FrntRdrMdlPrmVehLen : 143|16@0+ (1.0,0.0) [0.0|65535.0] "mm" FLR4
 SG_ FrntRdrMdlPrmVehType : 159|8@0+ (1.0,0.0) [0.0|255.0] "Unitless" FLR4
 SG_ FrntRdrMdlPrmVehWidth : 167|16@0+ (1.0,0.0) [0.0|65535.0] "mm" FLR4

BO_ 33 ASDMCanFD2TimeSynchFr : 8 ASDM

BO_ 18 ASDMSafetyCANFD2Frame3 : 64 ASDM
 SG_ RainfallAmnt : 7|4@0+ (1,0) [0|15] "" FLR4
 SG_ RainfallAmnt_UB : 3|1@0+ (1,0) [0|1] "" FLR4
 SG_ TiAndDateIndcn_UB : 431|1@0+ (1,0) [0|1] "" FLR4
 SG_ TiAndDateIndcnDataValid : 430|1@0+ (1,0) [0|1] "" FLR4
 SG_ TiAndDateIndcnDay : 452|5@0+ (1.0,0.0) [1.0|31.0] "Days" FLR4
 SG_ TiAndDateIndcnHr1 : 444|5@0+ (1.0,0.0) [0.0|23.0] "hours" FLR4
 SG_ TiAndDateIndcnMins1 : 437|6@0+ (1.0,0.0) [0.0|59.0] "Mins" FLR4
 SG_ TiAndDateIndcnMth1 : 459|4@0+ (1.0,0.0) [1.0|12.0] "Month" FLR4
 SG_ TiAndDateIndcnSec1 : 429|6@0+ (1.0,0.0) [0.0|59.0] "s" FLR4
 SG_ TiAndDateIndcnYr1 : 470|7@0+ (1.0,0.0) [0.0|99.0] "Year" FLR4

BO_ 288 ASDMSafetyCANFD2Frame4 : 64 ASDM
 SG_ ADataRawSafe_UB : 56|1@0+ (1,0) [0|1] "" FLR4
 SG_ ADataRawSafeALat : 23|15@0- (0.0085,0.0) [-138.99200000000002|139.00050000000002] "m/s^2" FLR4
 SG_ ADataRawSafeALat1Qf : 11|2@0+ (1,0) [0|3] "" FLR4
 SG_ ADataRawSafeALgt : 38|15@0- (0.0085,0.0) [-138.99200000000002|139.00050000000002] "m/s^2" FLR4
 SG_ ADataRawSafeALgt1Qf : 9|2@0+ (1,0) [0|3] "" FLR4
 SG_ ADataRawSafeAVert : 55|15@0- (0.0085,0.0) [-138.99200000000002|139.00050000000002] "m/s^2" FLR4
 SG_ ADataRawSafeAVertQf : 24|2@0+ (1,0) [0|3] "" FLR4
 SG_ ADataRawSafeChks : 7|8@0+ (1.0,0.0) [0.0|255.0] "Unitless" FLR4
 SG_ ADataRawSafeCntr : 15|4@0+ (1.0,0.0) [0.0|15.0] "Unitless" FLR4
 SG_ ALgtStdFromWhlSpd_UB : 318|1@0+ (1,0) [0|1] "" FLR4
 SG_ ALgtStdFromWhlSpdALgtStdFromWhlSpd : 335|16@0- (0.0009765625,0.0) [-18.0|18.0] "m/s^2" FLR4
 SG_ ALgtStdFromWhlSpdChks : 327|8@0+ (1.0,0.0) [0.0|255.0] "Unitless" FLR4
 SG_ ALgtStdFromWhlSpdCntr : 315|4@0+ (1.0,0.0) [0.0|15.0] "Unitless" FLR4
 SG_ ALgtStdFromWhlSpdQf : 317|2@0+ (1,0) [0|3] "" FLR4
 SG_ AmbTRaw_UB : 106|1@0+ (1,0) [0|1] "" FLR4
 SG_ AmbTRawAmbTVal : 234|11@0+ (0.1,-70.0) [-70.0|134.70000000000002] "degC" FLR4
 SG_ AmbTRawQly : 236|2@0+ (1,0) [0|3] "" FLR4
 SG_ AsyDataWithCmpSafe_UB : 168|1@0+ (1,0) [0|1] "" FLR4
 SG_ AsyDataWithCmpSafeALat1Qf : 153|2@0+ (1,0) [0|3] "" FLR4
 SG_ AsyDataWithCmpSafeALatWithCmp : 167|15@0- (0.0085,0.0) [-138.99200000000002|139.00050000000002] "m/s^2" FLR4
 SG_ AsyDataWithCmpSafeALgt1Qf : 155|2@0+ (1,0) [0|3] "" FLR4
 SG_ AsyDataWithCmpSafeChks : 135|8@0+ (1.0,0.0) [0.0|255.0] "Unitless" FLR4
 SG_ AsyDataWithCmpSafeCntr : 159|4@0+ (1.0,0.0) [0.0|15.0] "Unitless" FLR4
 SG_ AsyDataWithCmpSafeGrdtOfALgt : 143|14@0- (0.00390625,0.0) [-30.0|30.0] "m/s^3" FLR4
 SG_ AsyDataWithCmpSafeYawRateQf : 145|2@0+ (1,0) [0|3] "" FLR4
 SG_ AsyDataWithCmpSafeYawRateWithCmp : 119|16@0- (0.000244140625,0.0) [-6.0|6.0] "rad/s" FLR4
 SG_ BkpOfDstTrvld : 416|21@0+ (1.0,0.0) [0.0|2000000.0] "km" FLR4
 SG_ BkpOfDstTrvld_UB : 319|1@0+ (1,0) [0|1] "" FLR4
 SG_ BodyHei : 487|15@0- (0.000062,0.0) [-0.999998|1.00006] "m" FLR4
 SG_ BodyHei_UB : 488|1@0+ (1,0) [0|1] "" FLR4
 SG_ CarTiGlb : 391|32@0+ (0.1,0.0) [0.0|429496729.5] "s" FLR4
 SG_ CarTiGlb_UB : 107|1@0+ (1,0) [0|1] "" FLR4
 SG_ DrvModReq : 227|4@0+ (1,0) [0|15] "" FLR4
 SG_ DrvModReq_UB : 105|1@0+ (1,0) [0|1] "" FLR4
 SG_ PinionSteerAgGroup_UB : 305|1@0+ (1,0) [0|1] "" FLR4
 SG_ PinionSteerAgGroupChks : 255|8@0+ (1.0,0.0) [0.0|255.0] "Unitless" FLR4
 SG_ PinionSteerAgGroupCntr : 311|4@0+ (1.0,0.0) [0.0|15.0] "Unitless" FLR4
 SG_ PinionSteerAgGroupPinionSteerAg1 : 294|15@0- (0.0009765625,0.0) [-14.5|14.5] "rad" FLR4
 SG_ PinionSteerAgGroupPinionSteerAg1Qf : 263|2@0+ (1,0) [0|3] "" FLR4
 SG_ PinionSteerAgGroupPinionSteerAgSpd1 : 261|14@0- (0.0078125,0.0) [-50.0|50.0] "rad/s" FLR4
 SG_ PinionSteerAgGroupPinionSteerAgSpd1Qf : 279|2@0+ (1,0) [0|3] "" FLR4
 SG_ PinionSteerAgGroupSteerWhlTq : 277|14@0- (0.00390625,0.0) [-30.0|30.0] "NewtonMeter" FLR4
 SG_ PinionSteerAgGroupSteerWhlTqQf : 307|2@0+ (1,0) [0|3] "" FLR4
 SG_ SteerWhlSnsr_UB : 71|1@0+ (1,0) [0|1] "" FLR4
 SG_ SteerWhlSnsrAg : 70|15@0- (0.0009765625,0.0) [-14.5|14.5] "rad" FLR4
 SG_ SteerWhlSnsrAgSpd : 85|14@0- (0.0078125,0.0) [-50.0|50.0] "rad/s" FLR4
 SG_ SteerWhlSnsrChks : 103|8@0+ (1.0,0.0) [0.0|255.0] "Unitless" FLR4
 SG_ SteerWhlSnsrCntr : 111|4@0+ (1.0,0.0) [0.0|15.0] "Unitless" FLR4
 SG_ SteerWhlSnsrQf : 87|2@0+ (1,0) [0|3] "" FLR4
 SG_ SuspHeiLvlIndcn : 231|3@0+ (1,0) [0|7] "" FLR4
 SG_ SuspHeiLvlIndcn_UB : 228|1@0+ (1,0) [0|1] "" FLR4
 SG_ VehBattU_UB : 442|1@0+ (1,0) [0|1] "" FLR4
 SG_ VehBattUSysU : 455|8@0+ (0.1,0.0) [0.0|25.0] "Volt" FLR4
 SG_ VehBattUSysUQf : 441|2@0+ (1,0) [0|3] "" FLR4
 SG_ VehModMngtGlbSafe1_UB : 376|1@0+ (1,0) [0|1] "" FLR4
 SG_ VehModMngtGlbSafe1CarModSts1 : 383|3@0+ (1,0) [0|7] "" FLR4
 SG_ VehModMngtGlbSafe1CarModSubtypWdCarModSubtyp : 380|3@0+ (1.0,0.0) [0.0|7.0] "Unitless" FLR4
 SG_ VehModMngtGlbSafe1Chks : 351|8@0+ (1.0,0.0) [0.0|255.0] "Unitless" FLR4
 SG_ VehModMngtGlbSafe1Cntr : 359|4@0+ (1.0,0.0) [0.0|15.0] "Unitless" FLR4
 SG_ VehModMngtGlbSafe1EgyLvlElecMai : 355|4@0+ (1.0,0.0) [0.0|15.0] "Unitless" FLR4
 SG_ VehModMngtGlbSafe1EgyLvlElecSubtyp : 367|4@0+ (1.0,0.0) [0.0|15.0] "Unitless" FLR4
 SG_ VehModMngtGlbSafe1FltEgyCnsWdSts : 377|1@0+ (1,0) [0|1] "" FLR4
 SG_ VehModMngtGlbSafe1PwrLvlElecMai : 363|4@0+ (1.0,0.0) [0.0|15.0] "Unitless" FLR4
 SG_ VehModMngtGlbSafe1PwrLvlElecSubtyp : 375|4@0+ (1.0,0.0) [0.0|15.0] "Unitless" FLR4
 SG_ VehModMngtGlbSafe1UsgModSts : 371|4@0+ (1,0) [0|15] "" FLR4
 SG_ VehMtnSt_UB : 183|1@0+ (1,0) [0|1] "" FLR4
 SG_ VehMtnStChks : 191|8@0+ (1.0,0.0) [0.0|255.0] "Unitless" FLR4
 SG_ VehMtnStCntr : 182|4@0+ (1.0,0.0) [0.0|15.0] "Unitless" FLR4
 SG_ VehMtnStVehMtnSt : 178|3@0+ (1,0) [0|7] "" FLR4
 SG_ VehSpdLgt_UB : 199|1@0+ (1,0) [0|1] "" FLR4
 SG_ VehSpdLgtA : 198|15@0+ (0.00391,0.0) [0.0|125.0027] "m/s" FLR4
 SG_ VehSpdLgtChks : 215|8@0+ (1.0,0.0) [0.0|255.0] "Unitless" FLR4
 SG_ VehSpdLgtCntr : 223|4@0+ (1.0,0.0) [0.0|15.0] "Unitless" FLR4
 SG_ VehSpdLgtQf : 219|2@0+ (1,0) [0|3] "" FLR4
 SG_ WipgInfo_UB : 461|1@0+ (1,0) [0|1] "" FLR4
 SG_ WipgInfoWipgSpdInfo : 458|3@0+ (1,0) [0|7] "" FLR4
 SG_ WipgInfoWiprActv : 459|1@0+ (1,0) [0|1] "" FLR4
 SG_ WipgInfoWiprInWipgAr : 460|1@0+ (1,0) [0|1] "" FLR4

BO_ 1007 ASDMSafetyCANFD2Frame7 : 64 ASDM
 SG_ SuspPosnVertLe1_UB : 355|1@0+ (1,0) [0|1] "" FLR4
 SG_ SuspPosnVertLe1Chks : 351|8@0+ (1.0,0.0) [0.0|255.0] "Unitless" FLR4
 SG_ SuspPosnVertLe1Frnt : 319|15@0- (0.000062,0.0) [-0.999998|1.00006] "m" FLR4
 SG_ SuspPosnVertLe1FrntQf : 359|2@0+ (1,0) [0|3] "" FLR4
 SG_ SuspPosnVertLe1Re : 335|15@0- (0.000062,0.0) [-0.999998|1.00006] "m" FLR4
 SG_ SuspPosnVertLe1ReQf : 357|2@0+ (1,0) [0|3] "" FLR4
 SG_ SuspPosnVertRi1_UB : 354|1@0+ (1,0) [0|1] "" FLR4
 SG_ SuspPosnVertRi1SuspPosnVertRiChks : 399|8@0+ (1.0,0.0) [0.0|255.0] "Unitless" FLR4
 SG_ SuspPosnVertRi1SuspPosnVertRiFrnt : 367|15@0- (0.000062,0.0) [-0.999998|1.00006] "m" FLR4
 SG_ SuspPosnVertRi1SuspPosnVertRiFrntQf : 407|2@0+ (1,0) [0|3] "" FLR4
 SG_ SuspPosnVertRi1SuspPosnVertRiRe : 383|15@0- (0.000062,0.0) [-0.999998|1.00006] "m" FLR4
 SG_ SuspPosnVertRi1SuspPosnVertRiReQf : 405|2@0+ (1,0) [0|3] "" FLR4
 SG_ SuspSetg_UB : 414|1@0+ (1,0) [0|1] "" FLR4
 SG_ SuspSetgLvlCtrlSetg : 413|2@0+ (1,0) [0|3] "" FLR4
 SG_ SuspSetgSuspIdPen : 411|4@0+ (1,0) [0|15] "" FLR4

BO_ 1281 AsdmSafetyCanFD2NmFr : 8 ASDM
 SG_ PNC16_ASDM : 16|1@0+ (1,0) [0|0] "" Vector__XXX
 SG_ PNC17_ASDM : 17|1@0+ (1,0) [0|0] "" Vector__XXX
 SG_ PNC18_ASDM : 18|1@0+ (1,0) [0|0] "" Vector__XXX
 SG_ PNC19_ASDM : 19|1@0+ (1,0) [0|0] "" Vector__XXX
 SG_ PNC20_ASDM : 20|1@0+ (1,0) [0|0] "" Vector__XXX
 SG_ PNC21_ASDM : 21|1@0+ (1,0) [0|0] "" Vector__XXX
 SG_ PNC22_ASDM : 22|1@0+ (1,0) [0|0] "" Vector__XXX
 SG_ PNC23_ASDM : 23|1@0+ (1,0) [0|0] "" Vector__XXX
 SG_ PNC24_ASDM : 24|1@0+ (1,0) [0|0] "" Vector__XXX
 SG_ PNC25_ASDM : 25|1@0+ (1,0) [0|0] "" Vector__XXX
 SG_ PNC26_ASDM : 26|1@0+ (1,0) [0|0] "" Vector__XXX
 SG_ PNC27_ASDM : 27|1@0+ (1,0) [0|0] "" Vector__XXX
 SG_ PNC28_ASDM : 28|1@0+ (1,0) [0|0] "" Vector__XXX
 SG_ PNC29_ASDM : 29|1@0+ (1,0) [0|0] "" Vector__XXX
 SG_ PNC30_ASDM : 30|1@0+ (1,0) [0|0] "" Vector__XXX
 SG_ PNC31_ASDM : 31|1@0+ (1,0) [0|0] "" Vector__XXX
 SG_ PNC32_ASDM : 32|1@0+ (1,0) [0|0] "" Vector__XXX
 SG_ PNC33_ASDM : 33|1@0+ (1,0) [0|0] "" Vector__XXX
 SG_ PNC34_ASDM : 34|1@0+ (1,0) [0|0] "" Vector__XXX
 SG_ PNC35_ASDM : 35|1@0+ (1,0) [0|0] "" Vector__XXX
 SG_ PNC36_ASDM : 36|1@0+ (1,0) [0|0] "" Vector__XXX
 SG_ PNC37_ASDM : 37|1@0+ (1,0) [0|0] "" Vector__XXX
 SG_ PNC38_ASDM : 38|1@0+ (1,0) [0|0] "" Vector__XXX
 SG_ PNC39_ASDM : 39|1@0+ (1,0) [0|0] "" Vector__XXX
 SG_ PNC40_ASDM : 40|1@0+ (1,0) [0|0] "" Vector__XXX
 SG_ PNC41_ASDM : 41|1@0+ (1,0) [0|0] "" Vector__XXX
 SG_ PNC42_ASDM : 42|1@0+ (1,0) [0|0] "" Vector__XXX
 SG_ NM_PNI_ASDM : 14|1@0+ (1,0) [0|0] "" Vector__XXX
 SG_ NM_AW_ASDM : 12|1@0+ (1,0) [0|0] "" Vector__XXX
 SG_ NM_CS_ASDM : 11|1@0+ (1,0) [0|0] "" Vector__XXX
 SG_ NM_RMR_ASDM : 8|1@0+ (1,0) [0|0] "" Vector__XXX
 SG_ NM_NodeID_ASDM : 7|8@0+ (1,0) [0|0] "" Vector__XXX

BO_ 2047 AsdmToAllFuncSafetyCanFD2DiagReqFrame1 : 8 ASDM
 SG_ AsdmToAllFuncSafetyCanFD2DiagReqNpdu : 7|64@0+ (1,0) [0|0] "" FLR4

BO_ 1860 AsdmToFlrSafetyCanFD2DiagReqFrame1 : 64 ASDM
 SG_ AsdmToFlrSafetyCanFD2DiagReqNpdu : 7|512@0+ (1,0) [0|0] "" FLR4

BO_ 1410 EtctoFlrXcpFr01 : 8 ETC

BO_ 16 FlcSafetyCANFD2Fr01 : 64 ASDM
 SG_ BrkPedlTrvl_UB : 42|1@0+ (1,0) [0|1] "" FLR4
 SG_ BrkPedlTrvlAct : 39|13@0+ (0.01,-5.0) [-5.0|47.0] "mm" FLR4
 SG_ BrkPedlTrvlChks : 7|8@0+ (1.0,0.0) [0.0|255.0] "Unitless" FLR4
 SG_ BrkPedlTrvlCntr : 15|4@0+ (1.0,0.0) [0.0|15.0] "Unitless" FLR4
 SG_ BrkPedlTrvlQf : 11|2@0+ (1,0) [0|3] "" FLR4
 SG_ BrkPedlTrvlSt : 26|1@0+ (1,0) [0|1] "" FLR4
 SG_ BrkPedlTrvlStQf : 9|2@0+ (1,0) [0|3] "" FLR4
 SG_ BrkPedlTrvlTar : 23|13@0+ (0.01,-5.0) [-5.0|47.0] "mm" FLR4
 SG_ WhlDirRotlFrntForBkp_UB : 215|1@0+ (1,0) [0|1] "" FLR4
 SG_ WhlDirRotlFrntForBkpChks : 199|8@0+ (1.0,0.0) [0.0|255.0] "Unitless" FLR4
 SG_ WhlDirRotlFrntForBkpCntr : 207|4@0+ (1.0,0.0) [0.0|15.0] "Unitless" FLR4
 SG_ WhlDirRotlFrntForBkpLe : 203|2@0+ (1,0) [0|3] "" FLR4
 SG_ WhlDirRotlFrntForBkpRi : 201|2@0+ (1,0) [0|3] "" FLR4
 SG_ WhlDirRotlReForBkp_UB : 279|1@0+ (1,0) [0|1] "" FLR4
 SG_ WhlDirRotlReForBkpChks : 271|8@0+ (1.0,0.0) [0.0|255.0] "Unitless" FLR4
 SG_ WhlDirRotlReForBkpCntr : 259|4@0+ (1.0,0.0) [0.0|15.0] "Unitless" FLR4
 SG_ WhlDirRotlReForBkpLe : 261|2@0+ (1,0) [0|3] "" FLR4
 SG_ WhlDirRotlReForBkpRi : 263|2@0+ (1,0) [0|3] "" FLR4
 SG_ WhlSpdCircumlFrntForBkp_UB : 480|1@0+ (1,0) [0|1] "" FLR4
 SG_ WhlSpdCircumlFrntForBkpWhlSpdCircumlFrntChks : 447|8@0+ (1.0,0.0) [0.0|255.0] "Unitless" FLR4
 SG_ WhlSpdCircumlFrntForBkpWhlSpdCircumlFrntCntr : 455|4@0+ (1.0,0.0) [0.0|15.0] "Unitless" FLR4
 SG_ WhlSpdCircumlFrntForBkpWhlSpdCircumlFrntLe : 463|15@0+ (0.00391,0.0) [0.0|125.0027] "m/s" FLR4
 SG_ WhlSpdCircumlFrntForBkpWhlSpdCircumlFrntLeQf : 451|2@0+ (1,0) [0|3] "" FLR4
 SG_ WhlSpdCircumlFrntForBkpWhlSpdCircumlFrntRiQf : 449|2@0+ (1,0) [0|3] "" FLR4
 SG_ WhlSpdCircumlFrntForBkpWhlSpdCircumlFrntWhlSpdCircumlFrntRi : 479|15@0+ (0.00391,0.0) [0.0|125.0027] "m/s" FLR4
 SG_ WhlSpdCircumlReForBkp_UB : 432|1@0+ (1,0) [0|1] "" FLR4
 SG_ WhlSpdCircumlReForBkpWhlSpdCircumlReChks : 399|8@0+ (1.0,0.0) [0.0|255.0] "Unitless" FLR4
 SG_ WhlSpdCircumlReForBkpWhlSpdCircumlReCntr : 407|4@0+ (1.0,0.0) [0.0|15.0] "Unitless" FLR4
 SG_ WhlSpdCircumlReForBkpWhlSpdCircumlReLe : 415|15@0+ (0.00391,0.0) [0.0|125.0027] "m/s" FLR4
 SG_ WhlSpdCircumlReForBkpWhlSpdCircumlReLeQf : 403|2@0+ (1,0) [0|3] "" FLR4
 SG_ WhlSpdCircumlReForBkpWhlSpdCircumlReRi : 431|15@0+ (0.00391,0.0) [0.0|125.0027] "m/s" FLR4
 SG_ WhlSpdCircumlReForBkpWhlSpdCircumlReRiQf : 401|2@0+ (1,0) [0|3] "" FLR4

BO_ 955 FLRSafetyCANFD2Frame100 : 64 FLR4
 SG_ FourDRadarObjSts28_UB : 280|1@0+ (1,0) [0|1] "" ASDM
 SG_ FourDRadarObjSts28Chks : 7|8@0+ (1.0,0.0) [0.0|255.0] "Unitless" ASDM
 SG_ FourDRadarObjSts28Classification : 15|4@0+ (1,0) [0|15] "" ASDM
 SG_ FourDRadarObjSts28Cntr : 11|4@0+ (1.0,0.0) [0.0|15.0] "Unitless" ASDM
 SG_ FourDRadarObjSts28DistX : 23|16@0+ (0.015625,-512.0) [-512.0|511.984375] "m" ASDM
 SG_ FourDRadarObjSts28DistXStd : 39|7@0+ (0.1,0.0) [0.0|12.700000000000001] "m" ASDM
 SG_ FourDRadarObjSts28DistY : 47|13@0+ (0.015625,-64.0) [-64.0|63.984375] "m" ASDM
 SG_ FourDRadarObjSts28DistYStd : 71|7@0+ (0.1,0.0) [0.0|12.700000000000001] "m" ASDM
 SG_ FourDRadarObjSts28DistZ : 79|13@0+ (0.015625,-64.0) [-64.0|63.984375] "m" ASDM
 SG_ FourDRadarObjSts28DistZStd : 103|7@0+ (0.1,0.0) [0.0|12.700000000000001] "m" ASDM
 SG_ FourDRadarObjSts28DynamicProperty : 111|4@0+ (1,0) [0|15] "" ASDM
 SG_ FourDRadarObjSts28HeadingAngle : 107|12@0+ (0.0879,-180.0) [-180.0|179.95050000000003] "Deg" ASDM
 SG_ FourDRadarObjSts28ID : 127|8@0+ (1.0,0.0) [0.0|255.0] "Unitless" ASDM
 SG_ FourDRadarObjSts28LifeCycles : 135|4@0+ (1.0,0.0) [0.0|15.0] "Unitless" ASDM
 SG_ FourDRadarObjSts28ObjBoundingBoxHeight : 50|11@0+ (0.01,0.0) [0.0|20.0] "m" ASDM
 SG_ FourDRadarObjSts28ObjBoundingBoxLength : 131|12@0+ (0.01,0.0) [0.0|40.95] "m" ASDM
 SG_ FourDRadarObjSts28ObjBoundingBoxWidth : 82|11@0+ (0.01,0.0) [0.0|20.0] "m" ASDM
 SG_ FourDRadarObjSts28ObjNearestPtX : 151|16@0+ (0.015625,-512.0) [-512.0|511.984375] "m" ASDM
 SG_ FourDRadarObjSts28ObjNearestPtY : 167|13@0+ (0.015625,-64.0) [-64.0|63.984375] "m" ASDM
 SG_ FourDRadarObjSts28ObjNearestPtZ : 191|13@0+ (0.015625,-64.0) [-64.0|63.984375] "m" ASDM
 SG_ FourDRadarObjSts28ObjSNR : 169|10@0+ (0.1,0.0) [0.0|102.30000000000001] "dB" ASDM
 SG_ FourDRadarObjSts28ObjXAccRel : 193|10@0+ (0.125,-44.5) [-44.5|44.5] "m/s^2" ASDM
 SG_ FourDRadarObjSts28ObjYAccRel : 215|10@0+ (0.125,-44.5) [-44.5|44.5] "m/s^2" ASDM
 SG_ FourDRadarObjSts28ObstacleProbability : 236|5@0+ (3.2258,0.0) [0.0|99.9998] "%" ASDM
 SG_ FourDRadarObjSts28ProbabilityOfExistence : 247|8@0+ (1.0,0.0) [0.0|100.0] "%" ASDM
 SG_ FourDRadarObjSts28RCS : 231|11@0+ (0.1,-100.0) [-100.0|100.0] "dBm" ASDM
 SG_ FourDRadarObjSts28TargetClassificationConfidence : 221|6@0+ (1.5873,0.0) [0.0|99.9999] "%" ASDM
 SG_ FourDRadarObjSts28UpdateFlag : 32|1@0+ (1,0) [0|1] "" ASDM
 SG_ FourDRadarObjSts28VabsX : 263|11@0+ (0.1,-102.4) [-102.4|102.30000000000001] "m/s" ASDM
 SG_ FourDRadarObjSts28VabsXStd : 255|7@0+ (0.05,0.0) [0.0|6.3500000000000005] "m/s" ASDM
 SG_ FourDRadarObjSts28VabsY : 266|11@0+ (0.1,-102.4) [-102.4|102.30000000000001] "m/s" ASDM
 SG_ FourDRadarObjSts28VabsYStd : 287|7@0+ (0.05,0.0) [0.0|6.3500000000000005] "m/s" ASDM
 SG_ FourDRadarObjSts28ValidFlag : 64|1@0+ (1,0) [0|1] "" ASDM

BO_ 956 FLRSafetyCANFD2Frame101 : 64 FLR4
 SG_ FourDRadarObjSts30_UB : 280|1@0+ (1,0) [0|1] "" ASDM
 SG_ FourDRadarObjSts30Chks : 7|8@0+ (1.0,0.0) [0.0|255.0] "Unitless" ASDM
 SG_ FourDRadarObjSts30Classification : 15|4@0+ (1,0) [0|15] "" ASDM
 SG_ FourDRadarObjSts30Cntr : 11|4@0+ (1.0,0.0) [0.0|15.0] "Unitless" ASDM
 SG_ FourDRadarObjSts30DistX : 23|16@0+ (0.015625,-512.0) [-512.0|511.984375] "m" ASDM
 SG_ FourDRadarObjSts30DistXStd : 39|7@0+ (0.1,0.0) [0.0|12.700000000000001] "m" ASDM
 SG_ FourDRadarObjSts30DistY : 47|13@0+ (0.015625,-64.0) [-64.0|63.984375] "m" ASDM
 SG_ FourDRadarObjSts30DistYStd : 71|7@0+ (0.1,0.0) [0.0|12.700000000000001] "m" ASDM
 SG_ FourDRadarObjSts30DistZ : 79|13@0+ (0.015625,-64.0) [-64.0|63.984375] "m" ASDM
 SG_ FourDRadarObjSts30DistZStd : 103|7@0+ (0.1,0.0) [0.0|12.700000000000001] "m" ASDM
 SG_ FourDRadarObjSts30DynamicProperty : 111|4@0+ (1,0) [0|15] "" ASDM
 SG_ FourDRadarObjSts30HeadingAngle : 107|12@0+ (0.0879,-180.0) [-180.0|179.95050000000003] "Deg" ASDM
 SG_ FourDRadarObjSts30ID : 127|8@0+ (1.0,0.0) [0.0|255.0] "Unitless" ASDM
 SG_ FourDRadarObjSts30LifeCycles : 135|4@0+ (1.0,0.0) [0.0|15.0] "Unitless" ASDM
 SG_ FourDRadarObjSts30ObjBoundingBoxHeight : 50|11@0+ (0.01,0.0) [0.0|20.0] "m" ASDM
 SG_ FourDRadarObjSts30ObjBoundingBoxLength : 131|12@0+ (0.01,0.0) [0.0|40.95] "m" ASDM
 SG_ FourDRadarObjSts30ObjBoundingBoxWidth : 82|11@0+ (0.01,0.0) [0.0|20.0] "m" ASDM
 SG_ FourDRadarObjSts30ObjNearestPtX : 151|16@0+ (0.015625,-512.0) [-512.0|511.984375] "m" ASDM
 SG_ FourDRadarObjSts30ObjNearestPtY : 167|13@0+ (0.015625,-64.0) [-64.0|63.984375] "m" ASDM
 SG_ FourDRadarObjSts30ObjNearestPtZ : 191|13@0+ (0.015625,-64.0) [-64.0|63.984375] "m" ASDM
 SG_ FourDRadarObjSts30ObjSNR : 169|10@0+ (0.1,0.0) [0.0|102.30000000000001] "dB" ASDM
 SG_ FourDRadarObjSts30ObjXAccRel : 193|10@0+ (0.125,-44.5) [-44.5|44.5] "m/s^2" ASDM
 SG_ FourDRadarObjSts30ObjYAccRel : 215|10@0+ (0.125,-44.5) [-44.5|44.5] "m/s^2" ASDM
 SG_ FourDRadarObjSts30ObstacleProbability : 236|5@0+ (3.2258,0.0) [0.0|99.9998] "%" ASDM
 SG_ FourDRadarObjSts30ProbabilityOfExistence : 247|8@0+ (1.0,0.0) [0.0|100.0] "%" ASDM
 SG_ FourDRadarObjSts30RCS : 231|11@0+ (0.1,-100.0) [-100.0|100.0] "dBm" ASDM
 SG_ FourDRadarObjSts30TargetClassificationConfidence : 221|6@0+ (1.5873,0.0) [0.0|99.9999] "%" ASDM
 SG_ FourDRadarObjSts30UpdateFlag : 32|1@0+ (1,0) [0|1] "" ASDM
 SG_ FourDRadarObjSts30VabsX : 263|11@0+ (0.1,-102.4) [-102.4|102.30000000000001] "m/s" ASDM
 SG_ FourDRadarObjSts30VabsXStd : 255|7@0+ (0.05,0.0) [0.0|6.3500000000000005] "m/s" ASDM
 SG_ FourDRadarObjSts30VabsY : 266|11@0+ (0.1,-102.4) [-102.4|102.30000000000001] "m/s" ASDM
 SG_ FourDRadarObjSts30VabsYStd : 287|7@0+ (0.05,0.0) [0.0|6.3500000000000005] "m/s" ASDM
 SG_ FourDRadarObjSts30ValidFlag : 64|1@0+ (1,0) [0|1] "" ASDM

BO_ 994 FLRSafetyCANFD2Frame102 : 64 FLR4
 SG_ FrtFourDRadarAligSts_UB : 216|1@0+ (1,0) [0|1] "" ASDM
 SG_ FrtFourDRadarAligStsRdrLearntSts : 71|2@0+ (1,0) [0|3] "" ASDM
 SG_ FrtFourDRadarAligStsRdrStsAligPit : 7|16@0+ (0.01,-90.0) [-90.0|90.0] "Deg" ASDM
 SG_ FrtFourDRadarAligStsRdrStsAligYaw : 23|16@0+ (0.01,-90.0) [-90.0|90.0] "Deg" ASDM
 SG_ FrtFourDRadarAligStsRdrStsSN : 39|32@0+ (1.0,0.0) [0.0|4294967295.0] "Unitless" ASDM

BO_ 957 FLRSafetyCANFD2Frame103 : 64 FLR4
 SG_ FourDRadarObjSts32_UB : 280|1@0+ (1,0) [0|1] "" ASDM
 SG_ FourDRadarObjSts32Chks : 7|8@0+ (1.0,0.0) [0.0|255.0] "Unitless" ASDM
 SG_ FourDRadarObjSts32Classification : 15|4@0+ (1,0) [0|15] "" ASDM
 SG_ FourDRadarObjSts32Cntr : 11|4@0+ (1.0,0.0) [0.0|15.0] "Unitless" ASDM
 SG_ FourDRadarObjSts32DistX : 23|16@0+ (0.015625,-512.0) [-512.0|511.984375] "m" ASDM
 SG_ FourDRadarObjSts32DistXStd : 39|7@0+ (0.1,0.0) [0.0|12.700000000000001] "m" ASDM
 SG_ FourDRadarObjSts32DistY : 47|13@0+ (0.015625,-64.0) [-64.0|63.984375] "m" ASDM
 SG_ FourDRadarObjSts32DistYStd : 71|7@0+ (0.1,0.0) [0.0|12.700000000000001] "m" ASDM
 SG_ FourDRadarObjSts32DistZ : 79|13@0+ (0.015625,-64.0) [-64.0|63.984375] "m" ASDM
 SG_ FourDRadarObjSts32DistZStd : 103|7@0+ (0.1,0.0) [0.0|12.700000000000001] "m" ASDM
 SG_ FourDRadarObjSts32DynamicProperty : 111|4@0+ (1,0) [0|15] "" ASDM
 SG_ FourDRadarObjSts32HeadingAngle : 107|12@0+ (0.0879,-180.0) [-180.0|179.95050000000003] "Deg" ASDM
 SG_ FourDRadarObjSts32ID : 127|8@0+ (1.0,0.0) [0.0|255.0] "Unitless" ASDM
 SG_ FourDRadarObjSts32LifeCycles : 135|4@0+ (1.0,0.0) [0.0|15.0] "Unitless" ASDM
 SG_ FourDRadarObjSts32ObjBoundingBoxHeight : 50|11@0+ (0.01,0.0) [0.0|20.0] "m" ASDM
 SG_ FourDRadarObjSts32ObjBoundingBoxLength : 131|12@0+ (0.01,0.0) [0.0|40.95] "m" ASDM
 SG_ FourDRadarObjSts32ObjBoundingBoxWidth : 82|11@0+ (0.01,0.0) [0.0|20.0] "m" ASDM
 SG_ FourDRadarObjSts32ObjNearestPtX : 151|16@0+ (0.015625,-512.0) [-512.0|511.984375] "m" ASDM
 SG_ FourDRadarObjSts32ObjNearestPtY : 167|13@0+ (0.015625,-64.0) [-64.0|63.984375] "m" ASDM
 SG_ FourDRadarObjSts32ObjNearestPtZ : 191|13@0+ (0.015625,-64.0) [-64.0|63.984375] "m" ASDM
 SG_ FourDRadarObjSts32ObjSNR : 169|10@0+ (0.1,0.0) [0.0|102.30000000000001] "dB" ASDM
 SG_ FourDRadarObjSts32ObjXAccRel : 193|10@0+ (0.125,-44.5) [-44.5|44.5] "m/s^2" ASDM
 SG_ FourDRadarObjSts32ObjYAccRel : 215|10@0+ (0.125,-44.5) [-44.5|44.5] "m/s^2" ASDM
 SG_ FourDRadarObjSts32ObstacleProbability : 236|5@0+ (3.2258,0.0) [0.0|99.9998] "%" ASDM
 SG_ FourDRadarObjSts32ProbabilityOfExistence : 247|8@0+ (1.0,0.0) [0.0|100.0] "%" ASDM
 SG_ FourDRadarObjSts32RCS : 231|11@0+ (0.1,-100.0) [-100.0|100.0] "dBm" ASDM
 SG_ FourDRadarObjSts32TargetClassificationConfidence : 221|6@0+ (1.5873,0.0) [0.0|99.9999] "%" ASDM
 SG_ FourDRadarObjSts32UpdateFlag : 32|1@0+ (1,0) [0|1] "" ASDM
 SG_ FourDRadarObjSts32VabsX : 263|11@0+ (0.1,-102.4) [-102.4|102.30000000000001] "m/s" ASDM
 SG_ FourDRadarObjSts32VabsXStd : 255|7@0+ (0.05,0.0) [0.0|6.3500000000000005] "m/s" ASDM
 SG_ FourDRadarObjSts32VabsY : 266|11@0+ (0.1,-102.4) [-102.4|102.30000000000001] "m/s" ASDM
 SG_ FourDRadarObjSts32VabsYStd : 287|7@0+ (0.05,0.0) [0.0|6.3500000000000005] "m/s" ASDM
 SG_ FourDRadarObjSts32ValidFlag : 64|1@0+ (1,0) [0|1] "" ASDM

BO_ 958 FLRSafetyCANFD2Frame104 : 64 FLR4
 SG_ FourDRadarObjSts34_UB : 280|1@0+ (1,0) [0|1] "" ASDM
 SG_ FourDRadarObjSts34Chks : 7|8@0+ (1.0,0.0) [0.0|255.0] "Unitless" ASDM
 SG_ FourDRadarObjSts34Classification : 15|4@0+ (1,0) [0|15] "" ASDM
 SG_ FourDRadarObjSts34Cntr : 11|4@0+ (1.0,0.0) [0.0|15.0] "Unitless" ASDM
 SG_ FourDRadarObjSts34DistX : 23|16@0+ (0.015625,-512.0) [-512.0|511.984375] "m" ASDM
 SG_ FourDRadarObjSts34DistXStd : 39|7@0+ (0.1,0.0) [0.0|12.700000000000001] "m" ASDM
 SG_ FourDRadarObjSts34DistY : 47|13@0+ (0.015625,-64.0) [-64.0|63.984375] "m" ASDM
 SG_ FourDRadarObjSts34DistYStd : 71|7@0+ (0.1,0.0) [0.0|12.700000000000001] "m" ASDM
 SG_ FourDRadarObjSts34DistZ : 79|13@0+ (0.015625,-64.0) [-64.0|63.984375] "m" ASDM
 SG_ FourDRadarObjSts34DistZStd : 103|7@0+ (0.1,0.0) [0.0|12.700000000000001] "m" ASDM
 SG_ FourDRadarObjSts34DynamicProperty : 111|4@0+ (1,0) [0|15] "" ASDM
 SG_ FourDRadarObjSts34HeadingAngle : 107|12@0+ (0.0879,-180.0) [-180.0|179.95050000000003] "Deg" ASDM
 SG_ FourDRadarObjSts34ID : 127|8@0+ (1.0,0.0) [0.0|255.0] "Unitless" ASDM
 SG_ FourDRadarObjSts34LifeCycles : 135|4@0+ (1.0,0.0) [0.0|15.0] "Unitless" ASDM
 SG_ FourDRadarObjSts34ObjBoundingBoxHeight : 50|11@0+ (0.01,0.0) [0.0|20.0] "m" ASDM
 SG_ FourDRadarObjSts34ObjBoundingBoxLength : 131|12@0+ (0.01,0.0) [0.0|40.95] "m" ASDM
 SG_ FourDRadarObjSts34ObjBoundingBoxWidth : 82|11@0+ (0.01,0.0) [0.0|20.0] "m" ASDM
 SG_ FourDRadarObjSts34ObjNearestPtX : 151|16@0+ (0.015625,-512.0) [-512.0|511.984375] "m" ASDM
 SG_ FourDRadarObjSts34ObjNearestPtY : 167|13@0+ (0.015625,-64.0) [-64.0|63.984375] "m" ASDM
 SG_ FourDRadarObjSts34ObjNearestPtZ : 191|13@0+ (0.015625,-64.0) [-64.0|63.984375] "m" ASDM
 SG_ FourDRadarObjSts34ObjSNR : 169|10@0+ (0.1,0.0) [0.0|102.30000000000001] "dB" ASDM
 SG_ FourDRadarObjSts34ObjXAccRel : 193|10@0+ (0.125,-44.5) [-44.5|44.5] "m/s^2" ASDM
 SG_ FourDRadarObjSts34ObjYAccRel : 215|10@0+ (0.125,-44.5) [-44.5|44.5] "m/s^2" ASDM
 SG_ FourDRadarObjSts34ObstacleProbability : 236|5@0+ (3.2258,0.0) [0.0|99.9998] "%" ASDM
 SG_ FourDRadarObjSts34ProbabilityOfExistence : 247|8@0+ (1.0,0.0) [0.0|100.0] "%" ASDM
 SG_ FourDRadarObjSts34RCS : 231|11@0+ (0.1,-100.0) [-100.0|100.0] "dBm" ASDM
 SG_ FourDRadarObjSts34TargetClassificationConfidence : 221|6@0+ (1.5873,0.0) [0.0|99.9999] "%" ASDM
 SG_ FourDRadarObjSts34UpdateFlag : 32|1@0+ (1,0) [0|1] "" ASDM
 SG_ FourDRadarObjSts34VabsX : 263|11@0+ (0.1,-102.4) [-102.4|102.30000000000001] "m/s" ASDM
 SG_ FourDRadarObjSts34VabsXStd : 255|7@0+ (0.05,0.0) [0.0|6.3500000000000005] "m/s" ASDM
 SG_ FourDRadarObjSts34VabsY : 266|11@0+ (0.1,-102.4) [-102.4|102.30000000000001] "m/s" ASDM
 SG_ FourDRadarObjSts34VabsYStd : 287|7@0+ (0.05,0.0) [0.0|6.3500000000000005] "m/s" ASDM
 SG_ FourDRadarObjSts34ValidFlag : 64|1@0+ (1,0) [0|1] "" ASDM

BO_ 959 FLRSafetyCANFD2Frame105 : 64 FLR4
 SG_ FourDRadarObjSts36_UB : 280|1@0+ (1,0) [0|1] "" ASDM
 SG_ FourDRadarObjSts36Chks : 7|8@0+ (1.0,0.0) [0.0|255.0] "Unitless" ASDM
 SG_ FourDRadarObjSts36Classification : 15|4@0+ (1,0) [0|15] "" ASDM
 SG_ FourDRadarObjSts36Cntr : 11|4@0+ (1.0,0.0) [0.0|15.0] "Unitless" ASDM
 SG_ FourDRadarObjSts36DistX : 23|16@0+ (0.015625,-512.0) [-512.0|511.984375] "m" ASDM
 SG_ FourDRadarObjSts36DistXStd : 39|7@0+ (0.1,0.0) [0.0|12.700000000000001] "m" ASDM
 SG_ FourDRadarObjSts36DistY : 47|13@0+ (0.015625,-64.0) [-64.0|63.984375] "m" ASDM
 SG_ FourDRadarObjSts36DistYStd : 71|7@0+ (0.1,0.0) [0.0|12.700000000000001] "m" ASDM
 SG_ FourDRadarObjSts36DistZ : 79|13@0+ (0.015625,-64.0) [-64.0|63.984375] "m" ASDM
 SG_ FourDRadarObjSts36DistZStd : 103|7@0+ (0.1,0.0) [0.0|12.700000000000001] "m" ASDM
 SG_ FourDRadarObjSts36DynamicProperty : 111|4@0+ (1,0) [0|15] "" ASDM
 SG_ FourDRadarObjSts36HeadingAngle : 107|12@0+ (0.0879,-180.0) [-180.0|179.95050000000003] "Deg" ASDM
 SG_ FourDRadarObjSts36ID : 127|8@0+ (1.0,0.0) [0.0|255.0] "Unitless" ASDM
 SG_ FourDRadarObjSts36LifeCycles : 135|4@0+ (1.0,0.0) [0.0|15.0] "Unitless" ASDM
 SG_ FourDRadarObjSts36ObjBoundingBoxHeight : 50|11@0+ (0.01,0.0) [0.0|20.0] "m" ASDM
 SG_ FourDRadarObjSts36ObjBoundingBoxLength : 131|12@0+ (0.01,0.0) [0.0|40.95] "m" ASDM
 SG_ FourDRadarObjSts36ObjBoundingBoxWidth : 82|11@0+ (0.01,0.0) [0.0|20.0] "m" ASDM
 SG_ FourDRadarObjSts36ObjNearestPtX : 151|16@0+ (0.015625,-512.0) [-512.0|511.984375] "m" ASDM
 SG_ FourDRadarObjSts36ObjNearestPtY : 167|13@0+ (0.015625,-64.0) [-64.0|63.984375] "m" ASDM
 SG_ FourDRadarObjSts36ObjNearestPtZ : 191|13@0+ (0.015625,-64.0) [-64.0|63.984375] "m" ASDM
 SG_ FourDRadarObjSts36ObjSNR : 169|10@0+ (0.1,0.0) [0.0|102.30000000000001] "dB" ASDM
 SG_ FourDRadarObjSts36ObjXAccRel : 193|10@0+ (0.125,-44.5) [-44.5|44.5] "m/s^2" ASDM
 SG_ FourDRadarObjSts36ObjYAccRel : 215|10@0+ (0.125,-44.5) [-44.5|44.5] "m/s^2" ASDM
 SG_ FourDRadarObjSts36ObstacleProbability : 236|5@0+ (3.2258,0.0) [0.0|99.9998] "%" ASDM
 SG_ FourDRadarObjSts36ProbabilityOfExistence : 247|8@0+ (1.0,0.0) [0.0|100.0] "%" ASDM
 SG_ FourDRadarObjSts36RCS : 231|11@0+ (0.1,-100.0) [-100.0|100.0] "dBm" ASDM
 SG_ FourDRadarObjSts36TargetClassificationConfidence : 221|6@0+ (1.5873,0.0) [0.0|99.9999] "%" ASDM
 SG_ FourDRadarObjSts36UpdateFlag : 32|1@0+ (1,0) [0|1] "" ASDM
 SG_ FourDRadarObjSts36VabsX : 263|11@0+ (0.1,-102.4) [-102.4|102.30000000000001] "m/s" ASDM
 SG_ FourDRadarObjSts36VabsXStd : 255|7@0+ (0.05,0.0) [0.0|6.3500000000000005] "m/s" ASDM
 SG_ FourDRadarObjSts36VabsY : 266|11@0+ (0.1,-102.4) [-102.4|102.30000000000001] "m/s" ASDM
 SG_ FourDRadarObjSts36VabsYStd : 287|7@0+ (0.05,0.0) [0.0|6.3500000000000005] "m/s" ASDM
 SG_ FourDRadarObjSts36ValidFlag : 64|1@0+ (1,0) [0|1] "" ASDM

BO_ 961 FLRSafetyCANFD2Frame106 : 64 FLR4
 SG_ FourDRadarObjSts38_UB : 280|1@0+ (1,0) [0|1] "" ASDM
 SG_ FourDRadarObjSts38Chks : 7|8@0+ (1.0,0.0) [0.0|255.0] "Unitless" ASDM
 SG_ FourDRadarObjSts38Classification : 15|4@0+ (1,0) [0|15] "" ASDM
 SG_ FourDRadarObjSts38Cntr : 11|4@0+ (1.0,0.0) [0.0|15.0] "Unitless" ASDM
 SG_ FourDRadarObjSts38DistX : 23|16@0+ (0.015625,-512.0) [-512.0|511.984375] "m" ASDM
 SG_ FourDRadarObjSts38DistXStd : 39|7@0+ (0.1,0.0) [0.0|12.700000000000001] "m" ASDM
 SG_ FourDRadarObjSts38DistY : 47|13@0+ (0.015625,-64.0) [-64.0|63.984375] "m" ASDM
 SG_ FourDRadarObjSts38DistYStd : 71|7@0+ (0.1,0.0) [0.0|12.700000000000001] "m" ASDM
 SG_ FourDRadarObjSts38DistZ : 79|13@0+ (0.015625,-64.0) [-64.0|63.984375] "m" ASDM
 SG_ FourDRadarObjSts38DistZStd : 103|7@0+ (0.1,0.0) [0.0|12.700000000000001] "m" ASDM
 SG_ FourDRadarObjSts38DynamicProperty : 111|4@0+ (1,0) [0|15] "" ASDM
 SG_ FourDRadarObjSts38HeadingAngle : 107|12@0+ (0.0879,-180.0) [-180.0|179.95050000000003] "Deg" ASDM
 SG_ FourDRadarObjSts38ID : 127|8@0+ (1.0,0.0) [0.0|255.0] "Unitless" ASDM
 SG_ FourDRadarObjSts38LifeCycles : 135|4@0+ (1.0,0.0) [0.0|15.0] "Unitless" ASDM
 SG_ FourDRadarObjSts38ObjBoundingBoxHeight : 50|11@0+ (0.01,0.0) [0.0|20.0] "m" ASDM
 SG_ FourDRadarObjSts38ObjBoundingBoxLength : 131|12@0+ (0.01,0.0) [0.0|40.95] "m" ASDM
 SG_ FourDRadarObjSts38ObjBoundingBoxWidth : 82|11@0+ (0.01,0.0) [0.0|20.0] "m" ASDM
 SG_ FourDRadarObjSts38ObjNearestPtX : 151|16@0+ (0.015625,-512.0) [-512.0|511.984375] "m" ASDM
 SG_ FourDRadarObjSts38ObjNearestPtY : 167|13@0+ (0.015625,-64.0) [-64.0|63.984375] "m" ASDM
 SG_ FourDRadarObjSts38ObjNearestPtZ : 191|13@0+ (0.015625,-64.0) [-64.0|63.984375] "m" ASDM
 SG_ FourDRadarObjSts38ObjSNR : 169|10@0+ (0.1,0.0) [0.0|102.30000000000001] "dB" ASDM
 SG_ FourDRadarObjSts38ObjXAccRel : 193|10@0+ (0.125,-44.5) [-44.5|44.5] "m/s^2" ASDM
 SG_ FourDRadarObjSts38ObjYAccRel : 215|10@0+ (0.125,-44.5) [-44.5|44.5] "m/s^2" ASDM
 SG_ FourDRadarObjSts38ObstacleProbability : 236|5@0+ (3.2258,0.0) [0.0|99.9998] "%" ASDM
 SG_ FourDRadarObjSts38ProbabilityOfExistence : 247|8@0+ (1.0,0.0) [0.0|100.0] "%" ASDM
 SG_ FourDRadarObjSts38RCS : 231|11@0+ (0.1,-100.0) [-100.0|100.0] "dBm" ASDM
 SG_ FourDRadarObjSts38TargetClassificationConfidence : 221|6@0+ (1.5873,0.0) [0.0|99.9999] "%" ASDM
 SG_ FourDRadarObjSts38UpdateFlag : 32|1@0+ (1,0) [0|1] "" ASDM
 SG_ FourDRadarObjSts38VabsX : 263|11@0+ (0.1,-102.4) [-102.4|102.30000000000001] "m/s" ASDM
 SG_ FourDRadarObjSts38VabsXStd : 255|7@0+ (0.05,0.0) [0.0|6.3500000000000005] "m/s" ASDM
 SG_ FourDRadarObjSts38VabsY : 266|11@0+ (0.1,-102.4) [-102.4|102.30000000000001] "m/s" ASDM
 SG_ FourDRadarObjSts38VabsYStd : 287|7@0+ (0.05,0.0) [0.0|6.3500000000000005] "m/s" ASDM
 SG_ FourDRadarObjSts38ValidFlag : 64|1@0+ (1,0) [0|1] "" ASDM

BO_ 962 FLRSafetyCANFD2Frame107 : 64 FLR4
 SG_ FourDRadarObjSts40_UB : 280|1@0+ (1,0) [0|1] "" ASDM
 SG_ FourDRadarObjSts40Chks : 7|8@0+ (1.0,0.0) [0.0|255.0] "Unitless" ASDM
 SG_ FourDRadarObjSts40Classification : 15|4@0+ (1,0) [0|15] "" ASDM
 SG_ FourDRadarObjSts40Cntr : 11|4@0+ (1.0,0.0) [0.0|15.0] "Unitless" ASDM
 SG_ FourDRadarObjSts40DistX : 23|16@0+ (0.015625,-512.0) [-512.0|511.984375] "m" ASDM
 SG_ FourDRadarObjSts40DistXStd : 39|7@0+ (0.1,0.0) [0.0|12.700000000000001] "m" ASDM
 SG_ FourDRadarObjSts40DistY : 47|13@0+ (0.015625,-64.0) [-64.0|63.984375] "m" ASDM
 SG_ FourDRadarObjSts40DistYStd : 71|7@0+ (0.1,0.0) [0.0|12.700000000000001] "m" ASDM
 SG_ FourDRadarObjSts40DistZ : 79|13@0+ (0.015625,-64.0) [-64.0|63.984375] "m" ASDM
 SG_ FourDRadarObjSts40DistZStd : 103|7@0+ (0.1,0.0) [0.0|12.700000000000001] "m" ASDM
 SG_ FourDRadarObjSts40DynamicProperty : 111|4@0+ (1,0) [0|15] "" ASDM
 SG_ FourDRadarObjSts40HeadingAngle : 107|12@0+ (0.0879,-180.0) [-180.0|179.95050000000003] "Deg" ASDM
 SG_ FourDRadarObjSts40ID : 127|8@0+ (1.0,0.0) [0.0|255.0] "Unitless" ASDM
 SG_ FourDRadarObjSts40LifeCycles : 135|4@0+ (1.0,0.0) [0.0|15.0] "Unitless" ASDM
 SG_ FourDRadarObjSts40ObjBoundingBoxHeight : 50|11@0+ (0.01,0.0) [0.0|20.0] "m" ASDM
 SG_ FourDRadarObjSts40ObjBoundingBoxLength : 131|12@0+ (0.01,0.0) [0.0|40.95] "m" ASDM
 SG_ FourDRadarObjSts40ObjBoundingBoxWidth : 82|11@0+ (0.01,0.0) [0.0|20.0] "m" ASDM
 SG_ FourDRadarObjSts40ObjNearestPtX : 151|16@0+ (0.015625,-512.0) [-512.0|511.984375] "m" ASDM
 SG_ FourDRadarObjSts40ObjNearestPtY : 167|13@0+ (0.015625,-64.0) [-64.0|63.984375] "m" ASDM
 SG_ FourDRadarObjSts40ObjNearestPtZ : 191|13@0+ (0.015625,-64.0) [-64.0|63.984375] "m" ASDM
 SG_ FourDRadarObjSts40ObjSNR : 169|10@0+ (0.1,0.0) [0.0|102.30000000000001] "dB" ASDM
 SG_ FourDRadarObjSts40ObjXAccRel : 193|10@0+ (0.125,-44.5) [-44.5|44.5] "m/s^2" ASDM
 SG_ FourDRadarObjSts40ObjYAccRel : 215|10@0+ (0.125,-44.5) [-44.5|44.5] "m/s^2" ASDM
 SG_ FourDRadarObjSts40ObstacleProbability : 236|5@0+ (3.2258,0.0) [0.0|99.9998] "%" ASDM
 SG_ FourDRadarObjSts40ProbabilityOfExistence : 247|8@0+ (1.0,0.0) [0.0|100.0] "%" ASDM
 SG_ FourDRadarObjSts40RCS : 231|11@0+ (0.1,-100.0) [-100.0|100.0] "dBm" ASDM
 SG_ FourDRadarObjSts40TargetClassificationConfidence : 221|6@0+ (1.5873,0.0) [0.0|99.9999] "%" ASDM
 SG_ FourDRadarObjSts40UpdateFlag : 32|1@0+ (1,0) [0|1] "" ASDM
 SG_ FourDRadarObjSts40VabsX : 263|11@0+ (0.1,-102.4) [-102.4|102.30000000000001] "m/s" ASDM
 SG_ FourDRadarObjSts40VabsXStd : 255|7@0+ (0.05,0.0) [0.0|6.3500000000000005] "m/s" ASDM
 SG_ FourDRadarObjSts40VabsY : 266|11@0+ (0.1,-102.4) [-102.4|102.30000000000001] "m/s" ASDM
 SG_ FourDRadarObjSts40VabsYStd : 287|7@0+ (0.05,0.0) [0.0|6.3500000000000005] "m/s" ASDM
 SG_ FourDRadarObjSts40ValidFlag : 64|1@0+ (1,0) [0|1] "" ASDM

BO_ 965 FLRSafetyCANFD2Frame108 : 64 FLR4
 SG_ FourDRadarObjSts42_UB : 280|1@0+ (1,0) [0|1] "" ASDM
 SG_ FourDRadarObjSts42Chks : 7|8@0+ (1.0,0.0) [0.0|255.0] "Unitless" ASDM
 SG_ FourDRadarObjSts42Classification : 15|4@0+ (1,0) [0|15] "" ASDM
 SG_ FourDRadarObjSts42Cntr : 11|4@0+ (1.0,0.0) [0.0|15.0] "Unitless" ASDM
 SG_ FourDRadarObjSts42DistX : 23|16@0+ (0.015625,-512.0) [-512.0|511.984375] "m" ASDM
 SG_ FourDRadarObjSts42DistXStd : 39|7@0+ (0.1,0.0) [0.0|12.700000000000001] "m" ASDM
 SG_ FourDRadarObjSts42DistY : 47|13@0+ (0.015625,-64.0) [-64.0|63.984375] "m" ASDM
 SG_ FourDRadarObjSts42DistYStd : 71|7@0+ (0.1,0.0) [0.0|12.700000000000001] "m" ASDM
 SG_ FourDRadarObjSts42DistZ : 79|13@0+ (0.015625,-64.0) [-64.0|63.984375] "m" ASDM
 SG_ FourDRadarObjSts42DistZStd : 103|7@0+ (0.1,0.0) [0.0|12.700000000000001] "m" ASDM
 SG_ FourDRadarObjSts42DynamicProperty : 111|4@0+ (1,0) [0|15] "" ASDM
 SG_ FourDRadarObjSts42HeadingAngle : 107|12@0+ (0.0879,-180.0) [-180.0|179.95050000000003] "Deg" ASDM
 SG_ FourDRadarObjSts42ID : 127|8@0+ (1.0,0.0) [0.0|255.0] "Unitless" ASDM
 SG_ FourDRadarObjSts42LifeCycles : 135|4@0+ (1.0,0.0) [0.0|15.0] "Unitless" ASDM
 SG_ FourDRadarObjSts42ObjBoundingBoxHeight : 50|11@0+ (0.01,0.0) [0.0|20.0] "m" ASDM
 SG_ FourDRadarObjSts42ObjBoundingBoxLength : 131|12@0+ (0.01,0.0) [0.0|40.95] "m" ASDM
 SG_ FourDRadarObjSts42ObjBoundingBoxWidth : 82|11@0+ (0.01,0.0) [0.0|20.0] "m" ASDM
 SG_ FourDRadarObjSts42ObjNearestPtX : 151|16@0+ (0.015625,-512.0) [-512.0|511.984375] "m" ASDM
 SG_ FourDRadarObjSts42ObjNearestPtY : 167|13@0+ (0.015625,-64.0) [-64.0|63.984375] "m" ASDM
 SG_ FourDRadarObjSts42ObjNearestPtZ : 191|13@0+ (0.015625,-64.0) [-64.0|63.984375] "m" ASDM
 SG_ FourDRadarObjSts42ObjSNR : 169|10@0+ (0.1,0.0) [0.0|102.30000000000001] "dB" ASDM
 SG_ FourDRadarObjSts42ObjXAccRel : 193|10@0+ (0.125,-44.5) [-44.5|44.5] "m/s^2" ASDM
 SG_ FourDRadarObjSts42ObjYAccRel : 215|10@0+ (0.125,-44.5) [-44.5|44.5] "m/s^2" ASDM
 SG_ FourDRadarObjSts42ObstacleProbability : 236|5@0+ (3.2258,0.0) [0.0|99.9998] "%" ASDM
 SG_ FourDRadarObjSts42ProbabilityOfExistence : 247|8@0+ (1.0,0.0) [0.0|100.0] "%" ASDM
 SG_ FourDRadarObjSts42RCS : 231|11@0+ (0.1,-100.0) [-100.0|100.0] "dBm" ASDM
 SG_ FourDRadarObjSts42TargetClassificationConfidence : 221|6@0+ (1.5873,0.0) [0.0|99.9999] "%" ASDM
 SG_ FourDRadarObjSts42UpdateFlag : 32|1@0+ (1,0) [0|1] "" ASDM
 SG_ FourDRadarObjSts42VabsX : 263|11@0+ (0.1,-102.4) [-102.4|102.30000000000001] "m/s" ASDM
 SG_ FourDRadarObjSts42VabsXStd : 255|7@0+ (0.05,0.0) [0.0|6.3500000000000005] "m/s" ASDM
 SG_ FourDRadarObjSts42VabsY : 266|11@0+ (0.1,-102.4) [-102.4|102.30000000000001] "m/s" ASDM
 SG_ FourDRadarObjSts42VabsYStd : 287|7@0+ (0.05,0.0) [0.0|6.3500000000000005] "m/s" ASDM
 SG_ FourDRadarObjSts42ValidFlag : 64|1@0+ (1,0) [0|1] "" ASDM

BO_ 880 FLRSafetyCANFD2Frame65 : 64 FLR4
 SG_ FourDRadarECUSts_UB : 88|1@0+ (1,0) [0|1] "" ASDM
 SG_ FourDRadarECUStsCalibrationSts : 23|3@0+ (1,0) [0|7] "" ASDM
 SG_ FourDRadarECUStsChks : 7|8@0+ (1.0,0.0) [0.0|255.0] "Unitless" ASDM
 SG_ FourDRadarECUStsCntr : 20|4@0+ (1.0,0.0) [0.0|15.0] "Unitless" ASDM
 SG_ FourDRadarECUStsECUFailureE2E : 16|1@0+ (1,0) [0|1] "" ASDM
 SG_ FourDRadarECUStsECUFailureNVM : 31|1@0+ (1,0) [0|1] "" ASDM
 SG_ FourDRadarECUStsECUFailurePlausibility : 30|1@0+ (1,0) [0|1] "" ASDM
 SG_ FourDRadarECUStsECUFailureQF : 29|1@0+ (1,0) [0|1] "" ASDM
 SG_ FourDRadarECUStsECUFailureTemperature : 28|1@0+ (1,0) [0|1] "" ASDM
 SG_ FourDRadarECUStsECUFailureUB : 27|1@0+ (1,0) [0|1] "" ASDM
 SG_ FourDRadarECUStsECUFailureVCS : 26|1@0+ (1,0) [0|1] "" ASDM
 SG_ FourDRadarECUStsECUFailureVDY : 25|1@0+ (1,0) [0|1] "" ASDM
 SG_ FourDRadarECUStsECUFailureVoltage : 24|1@0+ (1,0) [0|1] "" ASDM
 SG_ FourDRadarECUStsOperationMode : 15|8@0+ (1,0) [0|255] "" ASDM
 SG_ FrontFourDRadarSts_UB : 243|1@0+ (1,0) [0|1] "" ASDM
 SG_ FrontFourDRadarStsForDim : 39|3@0+ (1,0) [0|7] "" ASDM
 SG_ FrontFourDRadarStsForDim_UB : 36|1@0+ (1,0) [0|1] "" ASDM
 SG_ FrontFourDRadarStsRdrNrDetn : 103|8@0+ (1.0,0.0) [0.0|255.0] "Unitless" ASDM
 SG_ FrontFourDRadarStsRdrNrObj : 151|8@0+ (1.0,0.0) [0.0|255.0] "Unitless" ASDM
 SG_ FrontFourDRadarStsRdrStsBlkd0bin : 111|1@0+ (1,0) [0|1] "" ASDM
 SG_ FrontFourDRadarStsRdrStsBlkdConf : 110|7@0+ (1.0,0.0) [0.0|100.0] "%" ASDM
 SG_ FrontFourDRadarStsRdrStsChks : 159|8@0+ (1.0,0.0) [0.0|255.0] "Unitless" ASDM
 SG_ FrontFourDRadarStsRdrStsCntr : 135|4@0+ (1.0,0.0) [0.0|15.0] "Unitless" ASDM
 SG_ FrontFourDRadarStsRdrStsDstbc : 118|7@0+ (1.0,0.0) [0.0|100.0] "%" ASDM
 SG_ FrontFourDRadarStsRdrStsEna : 119|1@0+ (1,0) [0|1] "" ASDM
 SG_ FrontFourDRadarStsRdrStsFaulty : 131|1@0+ (1,0) [0|1] "" ASDM
 SG_ FrontFourDRadarStsRdrStsIfVersMajor : 127|4@0+ (1.0,0.0) [0.0|15.0] "Unitless" ASDM
 SG_ FrontFourDRadarStsRdrStsIfVersMinor : 123|4@0+ (1.0,0.0) [0.0|15.0] "Unitless" ASDM
 SG_ FrontFourDRadarStsRdrStsLatency : 167|16@0+ (1.0,0.0) [0.0|65535.0] "Unitless" ASDM
 SG_ FrontFourDRadarStsRdrStsMisAlign : 130|3@0+ (1,0) [0|7] "" ASDM
 SG_ FrontFourDRadarStsRdrStsMissCom : 143|1@0+ (1,0) [0|1] "" ASDM
 SG_ FrontFourDRadarStsRdrStsSftyFlt : 142|2@0+ (1,0) [0|3] "" ASDM
 SG_ FrontFourDRadarStsRdrStsTiStampH : 183|32@0+ (429496729.6,0.0) [0.0|1844674406941458430.0] "Milliseconds" ASDM
 SG_ FrontFourDRadarStsRdrStsTiStampL : 215|32@0+ (0.0001,0.0) [0.0|429496.7295] "s" ASDM
 SG_ FrontFourDRadarStsRdrStsTiStampStsGlbTiBas : 247|1@0+ (1,0) [0|1] "" ASDM
 SG_ FrontFourDRadarStsRdrStsTiStampStsSyncToGatewy : 246|1@0+ (1,0) [0|1] "" ASDM
 SG_ FrontFourDRadarStsRdrStsTiStampStsTiLeap : 245|1@0+ (1,0) [0|1] "" ASDM
 SG_ FrontFourDRadarStsRdrStsTiStampStsTiOut : 244|1@0+ (1,0) [0|1] "" ASDM
 SG_ FrontFourDRadarStsRdrStsWhlSpdCmpFac : 140|5@0+ (0.005,0.92) [0.92|1.075] "Unitless" ASDM
 SG_ FrontFourDRadarVDY_UB : 324|1@0+ (1,0) [0|1] "" ASDM
 SG_ FrontFourDRadarVDYChks : 255|8@0+ (1.0,0.0) [0.0|255.0] "Unitless" ASDM
 SG_ FrontFourDRadarVDYCntr : 263|4@0+ (1.0,0.0) [0.0|15.0] "Unitless" ASDM
 SG_ FrontFourDRadarVDYuiTimeStamp : 279|32@0+ (1.0,0.0) [0.0|4294967295.0] "Microseconds" ASDM
 SG_ FrontFourDRadarVDYVelocity : 259|12@0+ (0.025,-20.0) [-20.0|82.375] "m/s" ASDM
 SG_ FrontFourDRadarVDYYawRate : 311|19@0+ (0.00001,-2.0) [-2.0|1.9999900000000004] "rad/s" ASDM

// Node Comments
CM_ BU_ ETC "External Tester Connector";

// Signal Comments
CM_ SG_ 101 AgDataRawSafeChks "IMU angular rate data. Check summa";
CM_ SG_ 101 AgDataRawSafeCntr "IMU angular rate data. Counter";
CM_ SG_ 101 AgDataRawSafeRollRate "IMU angular rate data. Roll Rate";
CM_ SG_ 101 AgDataRawSafeRollRateQf "IMU angular rate data. Quality factor for Roll Rate";
CM_ SG_ 101 AgDataRawSafeYawRate "IMU angular rate data. Yaw Rate";
CM_ SG_ 101 AgDataRawSafeYawRateQf "IMU angular rate data. Quality Factor for Yaw Rate";
CM_ SG_ 848 AbsCtrlActvChks "checksum";
CM_ SG_ 848 AbsCtrlActvCntr "counter";
CM_ SG_ 848 AbsCtrlActvCtrlSts1 "Anti Blocking Systems (ABS) control is active (at least one wheel)
0 = No wheel is in Anti Blocking Systems (ABS) control
1 = At least one wheel is in Anti Blocking Systems (ABS) control";
CM_ SG_ 848 AsySftyEnaDecelAckd "Acknowledged signal from receiver for Brake gain enable signal. Acknowledged signal from receiver for enable signal for deceleration in safety critical situation.";
CM_ SG_ 848 BrkSysCylPMstAct "Brake system master cylinder pressure information Actual pressure, raw value";
CM_ SG_ 848 BrkSysCylPMstActQf "Brake system master cylinder pressure information Actual pressure quality factor";
CM_ SG_ 848 BrkSysCylPMstChks "Brake system master cylinder pressure information Checksum";
CM_ SG_ 848 BrkSysCylPMstCntr "Brake system master cylinder pressure information Counter";
CM_ SG_ 848 BrkSysCylPMstTar "Brake system master cylinder pressure information Target pressure";
CM_ SG_ 848 BrkSysCylPMstVirt "Brake system master cylinder pressure information Virtual pressure";
CM_ SG_ 848 BrkSysCylPMstVirtQf "Brake system master cylinder pressure information Virtual pressure quality factor";
CM_ SG_ 848 EpbStsChks "Electrical Park Brake system status information Status for the rear wheel park actuator";
CM_ SG_ 848 EpbStsCntr "Electrical Park Brake system status information Counter for EPB status";
CM_ SG_ 848 EpbStsEpbSts "Electrical Park Brake system status information Status for the rear wheel park actuator";
CM_ SG_ 848 EscCtrlIndcn "Indicates that an Electronic stability control (ESC) controller is active";
CM_ SG_ 848 EscStChks "Information on activation/ deactivation of Electronic Stability Control (ESC) Checksum for Esc state";
CM_ SG_ 848 EscStCntr "Information on activation/ deactivation of Electronic Stability Control (ESC) Counter for Esc state";
CM_ SG_ 848 EscStEscSt "Information on activation/ deactivation of Electronic Stability Control (ESC) Esc state information for Esc ON, Esc OFF or Esc Sport";
CM_ SG_ 848 GearLvrIndcn "Gear lever indication (drivetrain position) to the driver. If drivetrain position is not possible to decide signal is set to undefined. Valid for automatic vehicles.
";
CM_ SG_ 848 StandStillMgrStsForHld1 "Brake systen hold status";
CM_ SG_ 848 StandStillMgrStsForHldChks "chks";
CM_ SG_ 848 StandStillMgrStsForHldCntr "cntr";
CM_ SG_ 848 VehTiAndDataDataValid "Vehicle time (Hr, Min and Sec) and date (Year, Months and days) data for indication. See requirement for more information about the signals. Signal qualifier, No means values should be ignored.";
CM_ SG_ 848 VehTiAndDataDay "Vehicle time (Hr, Min and Sec) and date (Year, Months and days) data for indication. See requirement for more information about the signals. Day";
CM_ SG_ 848 VehTiAndDataHr1 "Vehicle time (Hr, Min and Sec) and date (Year, Months and days) data for indication. See requirement for more information about the signals. Hour";
CM_ SG_ 848 VehTiAndDataMins1 "Vehicle time (Hr, Min and Sec) and date (Year, Months and days) data for indication. See requirement for more information about the signals. Minutes";
CM_ SG_ 848 VehTiAndDataMth1 "Vehicle time (Hr, Min and Sec) and date (Year, Months and days) data for indication. See requirement for more information about the signals. Month, 1-12";
CM_ SG_ 848 VehTiAndDataSec1 "Vehicle time (Hr, Min and Sec) and date (Year, Months and days) data for indication. See requirement for more information about the signals. Seconds";
CM_ SG_ 848 VehTiAndDataYr1 "Vehicle time (Hr, Min and Sec) and date (Year, Months and days) data for indication. See requirement for more information about the signals. Year, 0-99";
CM_ SG_ 848 WhlDirRotlFrntChks "check sum";
CM_ SG_ 848 WhlDirRotlFrntCntr "counter";
CM_ SG_ 848 WhlDirRotlFrntLe "Rotational direction for the front individual wheels. Wheel rotation direction of front left wheel.";
CM_ SG_ 848 WhlDirRotlFrntRi "Rotational direction for the front individual wheels. Wheel rotation direction of front right wheel.";
CM_ SG_ 848 WhlDirRotlReChks "checksum";
CM_ SG_ 848 WhlDirRotlReCntr "counter";
CM_ SG_ 848 WhlDirRotlReLe "Rotational direction for the rear individual wheels. Wheel rotation direction of rear left wheel.";
CM_ SG_ 848 WhlDirRotlReRi "Rotational direction for the rear individual wheels. Wheel rotation direction of rear right wheel.";
CM_ SG_ 848 WhlSpdCircumlFrntChks "Individual wheel speed from front wheel speed sensors. Checksum";
CM_ SG_ 848 WhlSpdCircumlFrntCntr "Individual wheel speed from front wheel speed sensors. Counter";
CM_ SG_ 848 WhlSpdCircumlFrntLe "Individual wheel speed from front wheel speed sensors. Wheel speed from front left wheel speed sensor using nominal value of wheel radius.";
CM_ SG_ 848 WhlSpdCircumlFrntLeQf "Individual wheel speed from front wheel speed sensors. Qf for wheel speed sensor";
CM_ SG_ 848 WhlSpdCircumlFrntRiQf "Individual wheel speed from front wheel speed sensors. Qf for wheel speed sensor";
CM_ SG_ 848 WhlSpdCircumlFrntWhlSpdCircumlFrntRi "Individual wheel speed from front wheel speed sensors. Wheel speed from front right wheel speed sensor using nominal value of wheel radius";
CM_ SG_ 848 WhlSpdCircumlReChks "Individual wheel speed from rear wheel speed sensors. Checksum";
CM_ SG_ 848 WhlSpdCircumlReCntr "Individual wheel speed from rear wheel speed sensors. Counter";
CM_ SG_ 848 WhlSpdCircumlReLe "Individual wheel speed from rear wheel speed sensors. Wheel speed from rear left wheel speed sensor using nominal value of wheel radius.";
CM_ SG_ 848 WhlSpdCircumlReLeQf "Individual wheel speed from rear wheel speed sensors. Qf for wheel speed sensor";
CM_ SG_ 848 WhlSpdCircumlReRi "Individual wheel speed from rear wheel speed sensors. Wheel speed from rear right wheel speed sensor using nominal value of wheel radius.";
CM_ SG_ 848 WhlSpdCircumlReRiQf "Individual wheel speed from rear wheel speed sensors. Qf for wheel speed sensor";
CM_ SG_ 405 AgDataCmpQualityPitchRateCmpQuality "Quality of offset compensation for pitchrate";
CM_ SG_ 405 AgDataCmpQualityRollRateCmpQuality "Quality of offset compensation for rollrate";
CM_ SG_ 405 AgDataCmpQualityYawRateCmpQuality "Quality of offset compensation for yawrate";
CM_ SG_ 405 BrkTracCtrlActv "Indicates InCtrl if brake traction control (TC) is active on at least one wheel.";
CM_ SG_ 405 ExtrLtgStsAFS "AFS status";
CM_ SG_ 405 ExtrLtgStsAHBC "AHBC Status";
CM_ SG_ 405 ExtrLtgStsAHL "AHL Status";
CM_ SG_ 405 ExtrLtgStsAllWL "All Weather Light Status";
CM_ SG_ 405 ExtrLtgStsApproach "Approach Light Status";
CM_ SG_ 405 ExtrLtgStsChks "Checksum";
CM_ SG_ 405 ExtrLtgStsCntr "Counter";
CM_ SG_ 405 ExtrLtgStsCornrgLi "Cornering Light Status";
CM_ SG_ 405 ExtrLtgStsDBL "DBL Stataus";
CM_ SG_ 405 ExtrLtgStsDRL "DRL Status";
CM_ SG_ 405 ExtrLtgStsFlash "Flash Light Status";
CM_ SG_ 405 ExtrLtgStsFrntFog "Front Fog Light Status";
CM_ SG_ 405 ExtrLtgStsGoodbye "Good Bye Light Status";
CM_ SG_ 405 ExtrLtgStsHiBeam "Hi Beam Status";
CM_ SG_ 405 ExtrLtgStsHomeSafe "Home Safe Light Status";
CM_ SG_ 405 ExtrLtgStsHWL "HWL Status";
CM_ SG_ 405 ExtrLtgStsLoBeam "Low Beam Status";
CM_ SG_ 405 ExtrLtgStsLtgShow "Light Show Status";
CM_ SG_ 405 ExtrLtgStsPosLiFrnt "Position Light Front Status";
CM_ SG_ 405 ExtrLtgStsPosLiRe "Position Light Rear Status";
CM_ SG_ 405 ExtrLtgStsReFog "Rear Fog Light Status";
CM_ SG_ 405 ExtrLtgStsReverseLi "Reverse Light Status";
CM_ SG_ 405 ExtrLtgStsStopLi "Stop Light Status";
CM_ SG_ 405 ExtrLtgStsTurnIndrLe "Turn Indicator Left Status";
CM_ SG_ 405 ExtrLtgStsTurnIndrRi "Turn Indicator Right Status
";
CM_ SG_ 405 ExtrLtgStsWelcome "Welcome Light Status";
CM_ SG_ 405 LvlgDirMovmtIndcr "This signal is used for indicating the movement direction in the air suspension during its change.";
CM_ SG_ 837 VehCfgPrmExtBlkIDBytePosn1 "CarConfigExtended BlockID";
CM_ SG_ 837 VehCfgPrmExtCCPBytePosn2 "CarConfigExtended BytePos2";
CM_ SG_ 837 VehCfgPrmExtCCPBytePosn3 "CarConfigExtended BytePos3";
CM_ SG_ 837 VehCfgPrmExtCCPBytePosn4 "CarConfigExtended BytePos4";
CM_ SG_ 837 VehCfgPrmExtCCPBytePosn5 "CarConfigExtended BytePos5";
CM_ SG_ 837 VehCfgPrmExtCCPBytePosn6 "CarConfigExtended BytePos6";
CM_ SG_ 837 VehCfgPrmExtCCPBytePosn7 "CarConfigExtended BytePos7";
CM_ SG_ 837 VehCfgPrmExtCCPBytePosn8 "CarConfigExtended BytePos8";
CM_ SG_ 853 AD4HDMapRoadTyp "AD4 HD Map current road type.";
CM_ SG_ 853 AgDataRaw2SafeChks "IMU pitch rate data. Check sum";
CM_ SG_ 853 AgDataRaw2SafeCntr "IMU pitch rate data. Counter";
CM_ SG_ 853 AgDataRaw2SafePitchRate "IMU pitch rate data. Pitch Rate";
CM_ SG_ 853 AgDataRaw2SafePitchRateQf "IMU pitch rate data. Quality factor for Pitch Rate";
CM_ SG_ 853 FrntRdrMdlPrmRdrMountPit "Pitch of radar.";
CM_ SG_ 853 FrntRdrMdlPrmRdrMountPosnInDirX "X coordinate of Radar when measured in aligned coordinate system.";
CM_ SG_ 853 FrntRdrMdlPrmRdrMountPosnInDirY "Y coordinate of Radar when measured in aligned coordinate system.";
CM_ SG_ 853 FrntRdrMdlPrmRdrMountPosnInDirZ "Z coordinate of Radar when measured in aligned coordinate system.";
CM_ SG_ 853 FrntRdrMdlPrmRdrMountRoll "Roll of radar.";
CM_ SG_ 853 FrntRdrMdlPrmRdrMountYaw "Yaw of radar.";
CM_ SG_ 853 FrntRdrMdlPrmVehBas "Vehicle Base";
CM_ SG_ 853 FrntRdrMdlPrmVehFrntPosnInDirX "The distance from Vehicle Front Position to zOy in aligned coordinate system.";
CM_ SG_ 853 FrntRdrMdlPrmVehLen "Vehicle Length";
CM_ SG_ 853 FrntRdrMdlPrmVehType "Vehicle Type";
CM_ SG_ 853 FrntRdrMdlPrmVehWidth "Vehicle Width";
CM_ SG_ 18 RainfallAmnt "The signal describe the amount of rain falling";
CM_ SG_ 18 TiAndDateIndcnDataValid "Current time (Hr, Min and Sec) and date (Year, Months and days) data for indication. See requirement for more information about the signals. Signal qualifier, No means values should be ignored.";
CM_ SG_ 18 TiAndDateIndcnDay "Current time (Hr, Min and Sec) and date (Year, Months and days) data for indication. See requirement for more information about the signals. Day";
CM_ SG_ 18 TiAndDateIndcnHr1 "Current time (Hr, Min and Sec) and date (Year, Months and days) data for indication. See requirement for more information about the signals. Hour";
CM_ SG_ 18 TiAndDateIndcnMins1 "Current time (Hr, Min and Sec) and date (Year, Months and days) data for indication. See requirement for more information about the signals. Minutes";
CM_ SG_ 18 TiAndDateIndcnMth1 "Current time (Hr, Min and Sec) and date (Year, Months and days) data for indication. See requirement for more information about the signals. Month, 1-12";
CM_ SG_ 18 TiAndDateIndcnSec1 "Current time (Hr, Min and Sec) and date (Year, Months and days) data for indication. See requirement for more information about the signals. Seconds";
CM_ SG_ 18 TiAndDateIndcnYr1 "Current time (Hr, Min and Sec) and date (Year, Months and days) data for indication. See requirement for more information about the signals. Year, 0-99";
CM_ SG_ 288 ADataRawSafeALat "IMU acceleration data Lateral acceleration";
CM_ SG_ 288 ADataRawSafeALat1Qf "IMU acceleration data Quality factor for Lateral acceleration signal";
CM_ SG_ 288 ADataRawSafeALgt "IMU acceleration data Longitudinal acceleration";
CM_ SG_ 288 ADataRawSafeALgt1Qf "IMU acceleration data Quality factor for Longitudinal acceleration";
CM_ SG_ 288 ADataRawSafeAVert "IMU acceleration data Vertical acceleration";
CM_ SG_ 288 ADataRawSafeAVertQf "IMU acceleration data Quality factor for Vertical acceleration";
CM_ SG_ 288 ADataRawSafeChks "IMU acceleration data Check sum";
CM_ SG_ 288 ADataRawSafeCntr "IMU acceleration data Counter";
CM_ SG_ 288 ALgtStdFromWhlSpdALgtStdFromWhlSpd "Longitudinal acceleration over ground.
end2endprotection=profile1A dataid= 12345 Longitudinal acceleration over ground";
CM_ SG_ 288 ALgtStdFromWhlSpdChks "Longitudinal acceleration over ground.
end2endprotection=profile1A dataid=12345 Checksum for longitudinal acceleration over ground";
CM_ SG_ 288 ALgtStdFromWhlSpdCntr "Longitudinal acceleration over ground.
end2endprotection=profile1A dataid=12345 Counter for longitudinal acceleration over ground";
CM_ SG_ 288 ALgtStdFromWhlSpdQf "Longitudinal acceleration over ground.
end2endprotection=profile1A dataid=12345 Qf for longitudinal acceleration over ground";
CM_ SG_ 288 AmbTRawAmbTVal "Unfiltered ambient temp raw data in deg C. Ambient temp value";
CM_ SG_ 288 AmbTRawQly "Unfiltered ambient temp raw data in deg C. Quality Factor of the ambient temp";
CM_ SG_ 288 AsyDataWithCmpSafeALat1Qf "IMU processed special data. Quality factor for Lateral acceleration signal";
CM_ SG_ 288 AsyDataWithCmpSafeALatWithCmp "IMU processed special data.  Compensated Lateral acceleration";
CM_ SG_ 288 AsyDataWithCmpSafeALgt1Qf "IMU processed special data. Quality factor for Longitudinal acceleration";
CM_ SG_ 288 AsyDataWithCmpSafeChks "IMU processed special data. Check sum";
CM_ SG_ 288 AsyDataWithCmpSafeCntr "IMU processed special data. Counter";
CM_ SG_ 288 AsyDataWithCmpSafeGrdtOfALgt "IMU processed special data. Derivative of Longitudinal acceleration";
CM_ SG_ 288 AsyDataWithCmpSafeYawRateQf "IMU processed special data. Quality Factor for Yaw Rate";
CM_ SG_ 288 AsyDataWithCmpSafeYawRateWithCmp "IMU processed special data. Compensated Yaw rate";
CM_ SG_ 288 BkpOfDstTrvld "total traveled distance.";
CM_ SG_ 288 BodyHei "Body height is a calculated average value from the four level sensors at each wheel.";
CM_ SG_ 288 CarTiGlb "Presents a tiime value that shall be used by all ECUs to time-stamp diagnsotic trouble codes (DTC) according to the requirements for Global DTC snapshot data.";
CM_ SG_ 288 DrvModReq "drive mode";
CM_ SG_ 288 PinionSteerAgGroupChks "Checksum for PinionSteerAgGroup";
CM_ SG_ 288 PinionSteerAgGroupCntr "Counter for PinionSteerAgGroup";
CM_ SG_ 288 PinionSteerAgGroupPinionSteerAg1 "Calculated pinion steer angle at the front steering device";
CM_ SG_ 288 PinionSteerAgGroupPinionSteerAg1Qf "Quality factor for PinionSteerAg1";
CM_ SG_ 288 PinionSteerAgGroupPinionSteerAgSpd1 "Calculated pinion steer angle speed at the front steering device ";
CM_ SG_ 288 PinionSteerAgGroupPinionSteerAgSpd1Qf "Quality factor for PinionSteerAgSpd1";
CM_ SG_ 288 PinionSteerAgGroupSteerWhlTq "Torque on steering wheel";
CM_ SG_ 288 PinionSteerAgGroupSteerWhlTqQf "Quality factor for SteerWhlTq";
CM_ SG_ 288 SteerWhlSnsrAg "Actual steering wheel angle from the actual centre position of the steering wheel. ";
CM_ SG_ 288 SteerWhlSnsrAgSpd "Actual steering wheel angle from the actual centre position of the steering wheel. Steering angle speed with steering wheel rotation direction.  ";
CM_ SG_ 288 SteerWhlSnsrChks "Checksum for steering wheel sensor data.";
CM_ SG_ 288 SteerWhlSnsrCntr "Counter value for steering wheel sensor data.";
CM_ SG_ 288 SteerWhlSnsrQf "Qf for steering wheel sensor information";
CM_ SG_ 288 SuspHeiLvlIndcn "This signal specifies which height the body has reached.";
CM_ SG_ 288 VehBattUSysU "Vehicle System Voltage At 12V side";
CM_ SG_ 288 VehBattUSysUQf "Present vehicle voltage measured by CEM with QF";
CM_ SG_ 288 VehModMngtGlbSafe1CarModSts1 "CarMode Status";
CM_ SG_ 288 VehModMngtGlbSafe1CarModSubtypWdCarModSubtyp "CarMode substate status";
CM_ SG_ 288 VehModMngtGlbSafe1Chks "Checksum";
CM_ SG_ 288 VehModMngtGlbSafe1Cntr "Counter";
CM_ SG_ 288 VehModMngtGlbSafe1EgyLvlElecMai "Main energy level in the vehicle.";
CM_ SG_ 288 VehModMngtGlbSafe1EgyLvlElecSubtyp "Substate of the energy level in the vehicle.";
CM_ SG_ 288 VehModMngtGlbSafe1FltEgyCnsWdSts "High quiescent current detected by CEM via BMS.";
CM_ SG_ 288 VehModMngtGlbSafe1PwrLvlElecMai "Main Power level in the vehicle.";
CM_ SG_ 288 VehModMngtGlbSafe1PwrLvlElecSubtyp "Substate of the power level in the vehicle.";
CM_ SG_ 288 VehModMngtGlbSafe1UsgModSts "UsageMode Status";
CM_ SG_ 288 VehMtnStChks "Vehicle motion state information based on wheel speed sensors. Provides information about vehicle stand still and vehicle rolling direction. Checksum for vehicle motion state";
CM_ SG_ 288 VehMtnStCntr "Vehicle motion state information based on wheel speed sensors. Provides information about vehicle stand still and vehicle rolling direction. Counter for vehicle motion state";
CM_ SG_ 288 VehMtnStVehMtnSt "Vehicle motion state information based on wheel speed sensors. Provides information about vehicle stand still and vehicle rolling direction. Vehicle motion state";
CM_ SG_ 288 VehSpdLgtA "Vehicle speed longitudinal based on wheel speed sensors and longitudinal acceleration.";
CM_ SG_ 288 VehSpdLgtChks "Checksum";
CM_ SG_ 288 VehSpdLgtCntr "Counter";
CM_ SG_ 288 VehSpdLgtQf "Quality factor for vehicle speed as measured by wheel speed sensors and longitudinal acceleration.";
CM_ SG_ 288 WipgInfoWipgSpdInfo "Information regarding how the wipers are run";
CM_ SG_ 288 WipgInfoWiprActv " 0 No wiping, 1 Wiping";
CM_ SG_ 288 WipgInfoWiprInWipgAr " 0 Wiper in lower reversing area or parked, 1 Wiper in wiping area";
CM_ SG_ 1007 SuspPosnVertLe1Chks "Checksum on height information and QFs for front and rear.";
CM_ SG_ 1007 SuspPosnVertLe1Frnt "Height information from left front";
CM_ SG_ 1007 SuspPosnVertLe1FrntQf "QF on height information from left front";
CM_ SG_ 1007 SuspPosnVertLe1Re "Height information from left rear";
CM_ SG_ 1007 SuspPosnVertLe1ReQf "QF on height information from left rear";
CM_ SG_ 1007 SuspPosnVertRi1SuspPosnVertRiChks "External CAN signal to inform the right body height (include both front and rear) with ASIL-A leve(A CRC is added)l. Checksum on height information and QF for front and rear.";
CM_ SG_ 1007 SuspPosnVertRi1SuspPosnVertRiFrnt "External CAN signal to inform the right body height (include both front and rear) with ASIL-A leve(A CRC is added)l. Height information from right front";
CM_ SG_ 1007 SuspPosnVertRi1SuspPosnVertRiFrntQf "External CAN signal to inform the right body height (include both front and rear) with ASIL-A leve(A CRC is added)l. QF on height information from right front";
CM_ SG_ 1007 SuspPosnVertRi1SuspPosnVertRiRe "External CAN signal to inform the right body height (include both front and rear) with ASIL-A leve(A CRC is added)l. Height information from right rear";
CM_ SG_ 1007 SuspPosnVertRi1SuspPosnVertRiReQf "External CAN signal to inform the right body height (include both front and rear) with ASIL-A leve(A CRC is added)l. QF on height information from right rear";
CM_ SG_ 1007 SuspSetgLvlCtrlSetg "User setting for LevellingControl";
CM_ SG_ 1007 SuspSetgSuspIdPen "Select user ID for save setting for";
CM_ SG_ 16 BrkPedlTrvlAct "Information about driver brake request derived from the travel sensor in the brake booster. Actual value for the output rod";
CM_ SG_ 16 BrkPedlTrvlChks "Information about driver brake request derived from the travel sensor in the brake booster. Checksum";
CM_ SG_ 16 BrkPedlTrvlCntr "Information about driver brake request derived from the travel sensor in the brake booster. Counter";
CM_ SG_ 16 BrkPedlTrvlQf "Information about driver brake request derived from the travel sensor in the brake booster. Travel sensor quality factor";
CM_ SG_ 16 BrkPedlTrvlSt "Information about driver brake request derived from the travel sensor in the brake booster. Brake pedal applied information";
CM_ SG_ 16 BrkPedlTrvlStQf "Information about driver brake request derived from the travel sensor in the brake booster. Brake pedal applied information quality factor";
CM_ SG_ 16 BrkPedlTrvlTar "Information about driver brake request derived from the travel sensor in the brake booster. Target value for the output rod";
CM_ SG_ 16 WhlDirRotlFrntForBkpChks "check sum";
CM_ SG_ 16 WhlDirRotlFrntForBkpCntr "counter";
CM_ SG_ 16 WhlDirRotlFrntForBkpLe "Rotational direction for the front individual wheels. Wheel rotation direction of front left wheel.";
CM_ SG_ 16 WhlDirRotlFrntForBkpRi "Rotational direction for the front individual wheels. Wheel rotation direction of front right wheel.";
CM_ SG_ 16 WhlDirRotlReForBkpChks "checksum";
CM_ SG_ 16 WhlDirRotlReForBkpCntr "counter";
CM_ SG_ 16 WhlDirRotlReForBkpLe "Rotational direction for the rear individual wheels. Wheel rotation direction of rear left wheel.";
CM_ SG_ 16 WhlDirRotlReForBkpRi "Rotational direction for the rear individual wheels. Wheel rotation direction of rear right wheel.";
CM_ SG_ 16 WhlSpdCircumlFrntForBkpWhlSpdCircumlFrntChks "Individual wheel speed from front wheel speed sensors. Checksum";
CM_ SG_ 16 WhlSpdCircumlFrntForBkpWhlSpdCircumlFrntCntr "Individual wheel speed from front wheel speed sensors. Counter";
CM_ SG_ 16 WhlSpdCircumlFrntForBkpWhlSpdCircumlFrntLe "Individual wheel speed from front wheel speed sensors. Wheel speed from front left wheel speed sensor using nominal value of wheel radius.";
CM_ SG_ 16 WhlSpdCircumlFrntForBkpWhlSpdCircumlFrntLeQf "Individual wheel speed from front wheel speed sensors. Qf for wheel speed sensor";
CM_ SG_ 16 WhlSpdCircumlFrntForBkpWhlSpdCircumlFrntRiQf "Individual wheel speed from front wheel speed sensors. Qf for wheel speed sensor";
CM_ SG_ 16 WhlSpdCircumlFrntForBkpWhlSpdCircumlFrntWhlSpdCircumlFrntRi "Individual wheel speed from front wheel speed sensors. Wheel speed from front right wheel speed sensor using nominal value of wheel radius
";
CM_ SG_ 16 WhlSpdCircumlReForBkpWhlSpdCircumlReChks "Individual wheel speed from rear wheel speed sensors. Checksum";
CM_ SG_ 16 WhlSpdCircumlReForBkpWhlSpdCircumlReCntr "Individual wheel speed from rear wheel speed sensors. Counter";
CM_ SG_ 16 WhlSpdCircumlReForBkpWhlSpdCircumlReLe "Individual wheel speed from rear wheel speed sensors. Wheel speed from rear left wheel speed sensor using nominal value of wheel radius.";
CM_ SG_ 16 WhlSpdCircumlReForBkpWhlSpdCircumlReLeQf "Individual wheel speed from rear wheel speed sensors. Qf for wheel speed sensor";
CM_ SG_ 16 WhlSpdCircumlReForBkpWhlSpdCircumlReRi "Individual wheel speed from rear wheel speed sensors. Wheel speed from rear right wheel speed sensor using nominal value of wheel radius.";
CM_ SG_ 16 WhlSpdCircumlReForBkpWhlSpdCircumlReRiQf "Individual wheel speed from rear wheel speed sensors. Qf for wheel speed sensor";
CM_ SG_ 955 FourDRadarObjSts28Chks "4d Radar attributes";
CM_ SG_ 955 FourDRadarObjSts28Classification "4d Radar attributes";
CM_ SG_ 955 FourDRadarObjSts28Cntr "Counter";
CM_ SG_ 955 FourDRadarObjSts28DistX "4d Radar attributes";
CM_ SG_ 955 FourDRadarObjSts28DistXStd "4d Radar attributes";
CM_ SG_ 955 FourDRadarObjSts28DistY "4d Radar attributes";
CM_ SG_ 955 FourDRadarObjSts28DistYStd "4d Radar attributes";
CM_ SG_ 955 FourDRadarObjSts28DistZ "4d Radar attributes";
CM_ SG_ 955 FourDRadarObjSts28DistZStd "4d Radar attributes";
CM_ SG_ 955 FourDRadarObjSts28DynamicProperty "4d Radar attributes";
CM_ SG_ 955 FourDRadarObjSts28HeadingAngle "4d Radar attributes";
CM_ SG_ 955 FourDRadarObjSts28ID "4d Radar attributes";
CM_ SG_ 955 FourDRadarObjSts28LifeCycles "4d Radar attributes";
CM_ SG_ 955 FourDRadarObjSts28ObjBoundingBoxHeight "4d Radar attributes";
CM_ SG_ 955 FourDRadarObjSts28ObjBoundingBoxLength "4d Radar attributes";
CM_ SG_ 955 FourDRadarObjSts28ObjBoundingBoxWidth "4d Radar attributes";
CM_ SG_ 955 FourDRadarObjSts28ObjNearestPtX "4d Radar attributes";
CM_ SG_ 955 FourDRadarObjSts28ObjNearestPtY "4d Radar attributes";
CM_ SG_ 955 FourDRadarObjSts28ObjNearestPtZ "4d Radar attributes";
CM_ SG_ 955 FourDRadarObjSts28ObjSNR "4d Radar attributes";
CM_ SG_ 955 FourDRadarObjSts28ObjXAccRel "4d Radar attributes";
CM_ SG_ 955 FourDRadarObjSts28ObjYAccRel "4d Radar attributes";
CM_ SG_ 955 FourDRadarObjSts28ObstacleProbability "4d Radar attributes";
CM_ SG_ 955 FourDRadarObjSts28ProbabilityOfExistence "4d Radar attributes";
CM_ SG_ 955 FourDRadarObjSts28RCS "4d Radar attributes";
CM_ SG_ 955 FourDRadarObjSts28TargetClassificationConfidence "4d Radar attributes";
CM_ SG_ 955 FourDRadarObjSts28UpdateFlag "4d Radar attributes";
CM_ SG_ 955 FourDRadarObjSts28VabsX "4d Radar attributes";
CM_ SG_ 955 FourDRadarObjSts28VabsXStd "4d Radar attributes";
CM_ SG_ 955 FourDRadarObjSts28VabsY "4d Radar attributes";
CM_ SG_ 955 FourDRadarObjSts28VabsYStd "4d Radar attributes";
CM_ SG_ 955 FourDRadarObjSts28ValidFlag "4d Radar attributes";
CM_ SG_ 956 FourDRadarObjSts30Chks "4d Radar attributes";
CM_ SG_ 956 FourDRadarObjSts30Classification "4d Radar attributes";
CM_ SG_ 956 FourDRadarObjSts30Cntr "Counter";
CM_ SG_ 956 FourDRadarObjSts30DistX "4d Radar attributes";
CM_ SG_ 956 FourDRadarObjSts30DistXStd "4d Radar attributes";
CM_ SG_ 956 FourDRadarObjSts30DistY "4d Radar attributes";
CM_ SG_ 956 FourDRadarObjSts30DistYStd "4d Radar attributes";
CM_ SG_ 956 FourDRadarObjSts30DistZ "4d Radar attributes";
CM_ SG_ 956 FourDRadarObjSts30DistZStd "4d Radar attributes";
CM_ SG_ 956 FourDRadarObjSts30DynamicProperty "4d Radar attributes";
CM_ SG_ 956 FourDRadarObjSts30HeadingAngle "4d Radar attributes";
CM_ SG_ 956 FourDRadarObjSts30ID "4d Radar attributes";
CM_ SG_ 956 FourDRadarObjSts30LifeCycles "4d Radar attributes";
CM_ SG_ 956 FourDRadarObjSts30ObjBoundingBoxHeight "4d Radar attributes";
CM_ SG_ 956 FourDRadarObjSts30ObjBoundingBoxLength "4d Radar attributes";
CM_ SG_ 956 FourDRadarObjSts30ObjBoundingBoxWidth "4d Radar attributes";
CM_ SG_ 956 FourDRadarObjSts30ObjNearestPtX "4d Radar attributes";
CM_ SG_ 956 FourDRadarObjSts30ObjNearestPtY "4d Radar attributes";
CM_ SG_ 956 FourDRadarObjSts30ObjNearestPtZ "4d Radar attributes";
CM_ SG_ 956 FourDRadarObjSts30ObjSNR "4d Radar attributes";
CM_ SG_ 956 FourDRadarObjSts30ObjXAccRel "4d Radar attributes";
CM_ SG_ 956 FourDRadarObjSts30ObjYAccRel "4d Radar attributes";
CM_ SG_ 956 FourDRadarObjSts30ObstacleProbability "4d Radar attributes";
CM_ SG_ 956 FourDRadarObjSts30ProbabilityOfExistence "4d Radar attributes";
CM_ SG_ 956 FourDRadarObjSts30RCS "4d Radar attributes";
CM_ SG_ 956 FourDRadarObjSts30TargetClassificationConfidence "4d Radar attributes";
CM_ SG_ 956 FourDRadarObjSts30UpdateFlag "4d Radar attributes";
CM_ SG_ 956 FourDRadarObjSts30VabsX "4d Radar attributes";
CM_ SG_ 956 FourDRadarObjSts30VabsXStd "4d Radar attributes";
CM_ SG_ 956 FourDRadarObjSts30VabsY "4d Radar attributes";
CM_ SG_ 956 FourDRadarObjSts30VabsYStd "4d Radar attributes";
CM_ SG_ 956 FourDRadarObjSts30ValidFlag "4d Radar attributes";
CM_ SG_ 994 FrtFourDRadarAligStsRdrLearntSts "Radar Learnt Status to share to tell the ADC the next step";
CM_ SG_ 994 FrtFourDRadarAligStsRdrStsAligPit "Radar Alignment Result-Pitch";
CM_ SG_ 994 FrtFourDRadarAligStsRdrStsAligYaw "Radar Alignment Result-Yaw";
CM_ SG_ 994 FrtFourDRadarAligStsRdrStsSN "Radar SN number";
CM_ SG_ 957 FourDRadarObjSts32Chks "4d Radar attributes";
CM_ SG_ 957 FourDRadarObjSts32Classification "4d Radar attributes";
CM_ SG_ 957 FourDRadarObjSts32Cntr "Counter";
CM_ SG_ 957 FourDRadarObjSts32DistX "4d Radar attributes";
CM_ SG_ 957 FourDRadarObjSts32DistXStd "4d Radar attributes";
CM_ SG_ 957 FourDRadarObjSts32DistY "4d Radar attributes";
CM_ SG_ 957 FourDRadarObjSts32DistYStd "4d Radar attributes";
CM_ SG_ 957 FourDRadarObjSts32DistZ "4d Radar attributes";
CM_ SG_ 957 FourDRadarObjSts32DistZStd "4d Radar attributes";
CM_ SG_ 957 FourDRadarObjSts32DynamicProperty "4d Radar attributes";
CM_ SG_ 957 FourDRadarObjSts32HeadingAngle "4d Radar attributes";
CM_ SG_ 957 FourDRadarObjSts32ID "4d Radar attributes";
CM_ SG_ 957 FourDRadarObjSts32LifeCycles "4d Radar attributes";
CM_ SG_ 957 FourDRadarObjSts32ObjBoundingBoxHeight "4d Radar attributes";
CM_ SG_ 957 FourDRadarObjSts32ObjBoundingBoxLength "4d Radar attributes";
CM_ SG_ 957 FourDRadarObjSts32ObjBoundingBoxWidth "4d Radar attributes";
CM_ SG_ 957 FourDRadarObjSts32ObjNearestPtX "4d Radar attributes";
CM_ SG_ 957 FourDRadarObjSts32ObjNearestPtY "4d Radar attributes";
CM_ SG_ 957 FourDRadarObjSts32ObjNearestPtZ "4d Radar attributes";
CM_ SG_ 957 FourDRadarObjSts32ObjSNR "4d Radar attributes";
CM_ SG_ 957 FourDRadarObjSts32ObjXAccRel "4d Radar attributes";
CM_ SG_ 957 FourDRadarObjSts32ObjYAccRel "4d Radar attributes";
CM_ SG_ 957 FourDRadarObjSts32ObstacleProbability "4d Radar attributes";
CM_ SG_ 957 FourDRadarObjSts32ProbabilityOfExistence "4d Radar attributes";
CM_ SG_ 957 FourDRadarObjSts32RCS "4d Radar attributes";
CM_ SG_ 957 FourDRadarObjSts32TargetClassificationConfidence "4d Radar attributes";
CM_ SG_ 957 FourDRadarObjSts32UpdateFlag "4d Radar attributes";
CM_ SG_ 957 FourDRadarObjSts32VabsX "4d Radar attributes";
CM_ SG_ 957 FourDRadarObjSts32VabsXStd "4d Radar attributes";
CM_ SG_ 957 FourDRadarObjSts32VabsY "4d Radar attributes";
CM_ SG_ 957 FourDRadarObjSts32VabsYStd "4d Radar attributes";
CM_ SG_ 957 FourDRadarObjSts32ValidFlag "4d Radar attributes";
CM_ SG_ 958 FourDRadarObjSts34Chks "4d Radar attributes";
CM_ SG_ 958 FourDRadarObjSts34Classification "4d Radar attributes";
CM_ SG_ 958 FourDRadarObjSts34Cntr "Counter";
CM_ SG_ 958 FourDRadarObjSts34DistX "4d Radar attributes";
CM_ SG_ 958 FourDRadarObjSts34DistXStd "4d Radar attributes";
CM_ SG_ 958 FourDRadarObjSts34DistY "4d Radar attributes";
CM_ SG_ 958 FourDRadarObjSts34DistYStd "4d Radar attributes";
CM_ SG_ 958 FourDRadarObjSts34DistZ "4d Radar attributes";
CM_ SG_ 958 FourDRadarObjSts34DistZStd "4d Radar attributes";
CM_ SG_ 958 FourDRadarObjSts34DynamicProperty "4d Radar attributes";
CM_ SG_ 958 FourDRadarObjSts34HeadingAngle "4d Radar attributes";
CM_ SG_ 958 FourDRadarObjSts34ID "4d Radar attributes";
CM_ SG_ 958 FourDRadarObjSts34LifeCycles "4d Radar attributes";
CM_ SG_ 958 FourDRadarObjSts34ObjBoundingBoxHeight "4d Radar attributes";
CM_ SG_ 958 FourDRadarObjSts34ObjBoundingBoxLength "4d Radar attributes";
CM_ SG_ 958 FourDRadarObjSts34ObjBoundingBoxWidth "4d Radar attributes";
CM_ SG_ 958 FourDRadarObjSts34ObjNearestPtX "4d Radar attributes";
CM_ SG_ 958 FourDRadarObjSts34ObjNearestPtY "4d Radar attributes";
CM_ SG_ 958 FourDRadarObjSts34ObjNearestPtZ "4d Radar attributes";
CM_ SG_ 958 FourDRadarObjSts34ObjSNR "4d Radar attributes";
CM_ SG_ 958 FourDRadarObjSts34ObjXAccRel "4d Radar attributes";
CM_ SG_ 958 FourDRadarObjSts34ObjYAccRel "4d Radar attributes";
CM_ SG_ 958 FourDRadarObjSts34ObstacleProbability "4d Radar attributes";
CM_ SG_ 958 FourDRadarObjSts34ProbabilityOfExistence "4d Radar attributes";
CM_ SG_ 958 FourDRadarObjSts34RCS "4d Radar attributes";
CM_ SG_ 958 FourDRadarObjSts34TargetClassificationConfidence "4d Radar attributes";
CM_ SG_ 958 FourDRadarObjSts34UpdateFlag "4d Radar attributes";
CM_ SG_ 958 FourDRadarObjSts34VabsX "4d Radar attributes";
CM_ SG_ 958 FourDRadarObjSts34VabsXStd "4d Radar attributes";
CM_ SG_ 958 FourDRadarObjSts34VabsY "4d Radar attributes";
CM_ SG_ 958 FourDRadarObjSts34VabsYStd "4d Radar attributes";
CM_ SG_ 958 FourDRadarObjSts34ValidFlag "4d Radar attributes";
CM_ SG_ 959 FourDRadarObjSts36Chks "4d Radar attributes";
CM_ SG_ 959 FourDRadarObjSts36Classification "4d Radar attributes";
CM_ SG_ 959 FourDRadarObjSts36Cntr "Counter";
CM_ SG_ 959 FourDRadarObjSts36DistX "4d Radar attributes";
CM_ SG_ 959 FourDRadarObjSts36DistXStd "4d Radar attributes";
CM_ SG_ 959 FourDRadarObjSts36DistY "4d Radar attributes";
CM_ SG_ 959 FourDRadarObjSts36DistYStd "4d Radar attributes";
CM_ SG_ 959 FourDRadarObjSts36DistZ "4d Radar attributes";
CM_ SG_ 959 FourDRadarObjSts36DistZStd "4d Radar attributes";
CM_ SG_ 959 FourDRadarObjSts36DynamicProperty "4d Radar attributes";
CM_ SG_ 959 FourDRadarObjSts36HeadingAngle "4d Radar attributes";
CM_ SG_ 959 FourDRadarObjSts36ID "4d Radar attributes";
CM_ SG_ 959 FourDRadarObjSts36LifeCycles "4d Radar attributes";
CM_ SG_ 959 FourDRadarObjSts36ObjBoundingBoxHeight "4d Radar attributes";
CM_ SG_ 959 FourDRadarObjSts36ObjBoundingBoxLength "4d Radar attributes";
CM_ SG_ 959 FourDRadarObjSts36ObjBoundingBoxWidth "4d Radar attributes";
CM_ SG_ 959 FourDRadarObjSts36ObjNearestPtX "4d Radar attributes";
CM_ SG_ 959 FourDRadarObjSts36ObjNearestPtY "4d Radar attributes";
CM_ SG_ 959 FourDRadarObjSts36ObjNearestPtZ "4d Radar attributes";
CM_ SG_ 959 FourDRadarObjSts36ObjSNR "4d Radar attributes";
CM_ SG_ 959 FourDRadarObjSts36ObjXAccRel "4d Radar attributes";
CM_ SG_ 959 FourDRadarObjSts36ObjYAccRel "4d Radar attributes";
CM_ SG_ 959 FourDRadarObjSts36ObstacleProbability "4d Radar attributes";
CM_ SG_ 959 FourDRadarObjSts36ProbabilityOfExistence "4d Radar attributes";
CM_ SG_ 959 FourDRadarObjSts36RCS "4d Radar attributes";
CM_ SG_ 959 FourDRadarObjSts36TargetClassificationConfidence "4d Radar attributes";
CM_ SG_ 959 FourDRadarObjSts36UpdateFlag "4d Radar attributes";
CM_ SG_ 959 FourDRadarObjSts36VabsX "4d Radar attributes";
CM_ SG_ 959 FourDRadarObjSts36VabsXStd "4d Radar attributes";
CM_ SG_ 959 FourDRadarObjSts36VabsY "4d Radar attributes";
CM_ SG_ 959 FourDRadarObjSts36VabsYStd "4d Radar attributes";
CM_ SG_ 959 FourDRadarObjSts36ValidFlag "4d Radar attributes";
CM_ SG_ 961 FourDRadarObjSts38Chks "4d Radar attributes";
CM_ SG_ 961 FourDRadarObjSts38Classification "4d Radar attributes";
CM_ SG_ 961 FourDRadarObjSts38Cntr "Counter";
CM_ SG_ 961 FourDRadarObjSts38DistX "4d Radar attributes";
CM_ SG_ 961 FourDRadarObjSts38DistXStd "4d Radar attributes";
CM_ SG_ 961 FourDRadarObjSts38DistY "4d Radar attributes";
CM_ SG_ 961 FourDRadarObjSts38DistYStd "4d Radar attributes";
CM_ SG_ 961 FourDRadarObjSts38DistZ "4d Radar attributes";
CM_ SG_ 961 FourDRadarObjSts38DistZStd "4d Radar attributes";
CM_ SG_ 961 FourDRadarObjSts38DynamicProperty "4d Radar attributes";
CM_ SG_ 961 FourDRadarObjSts38HeadingAngle "4d Radar attributes";
CM_ SG_ 961 FourDRadarObjSts38ID "4d Radar attributes";
CM_ SG_ 961 FourDRadarObjSts38LifeCycles "4d Radar attributes";
CM_ SG_ 961 FourDRadarObjSts38ObjBoundingBoxHeight "4d Radar attributes";
CM_ SG_ 961 FourDRadarObjSts38ObjBoundingBoxLength "4d Radar attributes";
CM_ SG_ 961 FourDRadarObjSts38ObjBoundingBoxWidth "4d Radar attributes";
CM_ SG_ 961 FourDRadarObjSts38ObjNearestPtX "4d Radar attributes";
CM_ SG_ 961 FourDRadarObjSts38ObjNearestPtY "4d Radar attributes";
CM_ SG_ 961 FourDRadarObjSts38ObjNearestPtZ "4d Radar attributes";
CM_ SG_ 961 FourDRadarObjSts38ObjSNR "4d Radar attributes";
CM_ SG_ 961 FourDRadarObjSts38ObjXAccRel "4d Radar attributes";
CM_ SG_ 961 FourDRadarObjSts38ObjYAccRel "4d Radar attributes";
CM_ SG_ 961 FourDRadarObjSts38ObstacleProbability "4d Radar attributes";
CM_ SG_ 961 FourDRadarObjSts38ProbabilityOfExistence "4d Radar attributes";
CM_ SG_ 961 FourDRadarObjSts38RCS "4d Radar attributes";
CM_ SG_ 961 FourDRadarObjSts38TargetClassificationConfidence "4d Radar attributes";
CM_ SG_ 961 FourDRadarObjSts38UpdateFlag "4d Radar attributes";
CM_ SG_ 961 FourDRadarObjSts38VabsX "4d Radar attributes";
CM_ SG_ 961 FourDRadarObjSts38VabsXStd "4d Radar attributes";
CM_ SG_ 961 FourDRadarObjSts38VabsY "4d Radar attributes";
CM_ SG_ 961 FourDRadarObjSts38VabsYStd "4d Radar attributes";
CM_ SG_ 961 FourDRadarObjSts38ValidFlag "4d Radar attributes";
CM_ SG_ 962 FourDRadarObjSts40Chks "4d Radar attributes";
CM_ SG_ 962 FourDRadarObjSts40Classification "4d Radar attributes";
CM_ SG_ 962 FourDRadarObjSts40Cntr "Counter";
CM_ SG_ 962 FourDRadarObjSts40DistX "4d Radar attributes";
CM_ SG_ 962 FourDRadarObjSts40DistXStd "4d Radar attributes";
CM_ SG_ 962 FourDRadarObjSts40DistY "4d Radar attributes";
CM_ SG_ 962 FourDRadarObjSts40DistYStd "4d Radar attributes";
CM_ SG_ 962 FourDRadarObjSts40DistZ "4d Radar attributes";
CM_ SG_ 962 FourDRadarObjSts40DistZStd "4d Radar attributes";
CM_ SG_ 962 FourDRadarObjSts40DynamicProperty "4d Radar attributes";
CM_ SG_ 962 FourDRadarObjSts40HeadingAngle "4d Radar attributes";
CM_ SG_ 962 FourDRadarObjSts40ID "4d Radar attributes";
CM_ SG_ 962 FourDRadarObjSts40LifeCycles "4d Radar attributes";
CM_ SG_ 962 FourDRadarObjSts40ObjBoundingBoxHeight "4d Radar attributes";
CM_ SG_ 962 FourDRadarObjSts40ObjBoundingBoxLength "4d Radar attributes";
CM_ SG_ 962 FourDRadarObjSts40ObjBoundingBoxWidth "4d Radar attributes";
CM_ SG_ 962 FourDRadarObjSts40ObjNearestPtX "4d Radar attributes";
CM_ SG_ 962 FourDRadarObjSts40ObjNearestPtY "4d Radar attributes";
CM_ SG_ 962 FourDRadarObjSts40ObjNearestPtZ "4d Radar attributes";
CM_ SG_ 962 FourDRadarObjSts40ObjSNR "4d Radar attributes";
CM_ SG_ 962 FourDRadarObjSts40ObjXAccRel "4d Radar attributes";
CM_ SG_ 962 FourDRadarObjSts40ObjYAccRel "4d Radar attributes";
CM_ SG_ 962 FourDRadarObjSts40ObstacleProbability "4d Radar attributes";
CM_ SG_ 962 FourDRadarObjSts40ProbabilityOfExistence "4d Radar attributes";
CM_ SG_ 962 FourDRadarObjSts40RCS "4d Radar attributes";
CM_ SG_ 962 FourDRadarObjSts40TargetClassificationConfidence "4d Radar attributes";
CM_ SG_ 962 FourDRadarObjSts40UpdateFlag "4d Radar attributes";
CM_ SG_ 962 FourDRadarObjSts40VabsX "4d Radar attributes";
CM_ SG_ 962 FourDRadarObjSts40VabsXStd "4d Radar attributes";
CM_ SG_ 962 FourDRadarObjSts40VabsY "4d Radar attributes";
CM_ SG_ 962 FourDRadarObjSts40VabsYStd "4d Radar attributes";
CM_ SG_ 962 FourDRadarObjSts40ValidFlag "4d Radar attributes";
CM_ SG_ 965 FourDRadarObjSts42Chks "4d Radar attributes";
CM_ SG_ 965 FourDRadarObjSts42Classification "4d Radar attributes";
CM_ SG_ 965 FourDRadarObjSts42Cntr "Counter";
CM_ SG_ 965 FourDRadarObjSts42DistX "4d Radar attributes";
CM_ SG_ 965 FourDRadarObjSts42DistXStd "4d Radar attributes";
CM_ SG_ 965 FourDRadarObjSts42DistY "4d Radar attributes";
CM_ SG_ 965 FourDRadarObjSts42DistYStd "4d Radar attributes";
CM_ SG_ 965 FourDRadarObjSts42DistZ "4d Radar attributes";
CM_ SG_ 965 FourDRadarObjSts42DistZStd "4d Radar attributes";
CM_ SG_ 965 FourDRadarObjSts42DynamicProperty "4d Radar attributes";
CM_ SG_ 965 FourDRadarObjSts42HeadingAngle "4d Radar attributes";
CM_ SG_ 965 FourDRadarObjSts42ID "4d Radar attributes";
CM_ SG_ 965 FourDRadarObjSts42LifeCycles "4d Radar attributes";
CM_ SG_ 965 FourDRadarObjSts42ObjBoundingBoxHeight "4d Radar attributes";
CM_ SG_ 965 FourDRadarObjSts42ObjBoundingBoxLength "4d Radar attributes";
CM_ SG_ 965 FourDRadarObjSts42ObjBoundingBoxWidth "4d Radar attributes";
CM_ SG_ 965 FourDRadarObjSts42ObjNearestPtX "4d Radar attributes";
CM_ SG_ 965 FourDRadarObjSts42ObjNearestPtY "4d Radar attributes";
CM_ SG_ 965 FourDRadarObjSts42ObjNearestPtZ "4d Radar attributes";
CM_ SG_ 965 FourDRadarObjSts42ObjSNR "4d Radar attributes";
CM_ SG_ 965 FourDRadarObjSts42ObjXAccRel "4d Radar attributes";
CM_ SG_ 965 FourDRadarObjSts42ObjYAccRel "4d Radar attributes";
CM_ SG_ 965 FourDRadarObjSts42ObstacleProbability "4d Radar attributes";
CM_ SG_ 965 FourDRadarObjSts42ProbabilityOfExistence "4d Radar attributes";
CM_ SG_ 965 FourDRadarObjSts42RCS "4d Radar attributes";
CM_ SG_ 965 FourDRadarObjSts42TargetClassificationConfidence "4d Radar attributes";
CM_ SG_ 965 FourDRadarObjSts42UpdateFlag "4d Radar attributes";
CM_ SG_ 965 FourDRadarObjSts42VabsX "4d Radar attributes";
CM_ SG_ 965 FourDRadarObjSts42VabsXStd "4d Radar attributes";
CM_ SG_ 965 FourDRadarObjSts42VabsY "4d Radar attributes";
CM_ SG_ 965 FourDRadarObjSts42VabsYStd "4d Radar attributes";
CM_ SG_ 965 FourDRadarObjSts42ValidFlag "4d Radar attributes";
CM_ SG_ 880 FourDRadarECUStsCalibrationSts "calibration Sts";
CM_ SG_ 880 FourDRadarECUStsChks "checksum";
CM_ SG_ 880 FourDRadarECUStsCntr "cntr";
CM_ SG_ 880 FourDRadarECUStsECUFailureE2E "FourDradarsts";
CM_ SG_ 880 FourDRadarECUStsECUFailureNVM "FourDradarsts";
CM_ SG_ 880 FourDRadarECUStsECUFailurePlausibility "FourDradarsts";
CM_ SG_ 880 FourDRadarECUStsECUFailureQF "FourDradarsts";
CM_ SG_ 880 FourDRadarECUStsECUFailureTemperature "FourDradarsts";
CM_ SG_ 880 FourDRadarECUStsECUFailureUB "FourDradarsts";
CM_ SG_ 880 FourDRadarECUStsECUFailureVCS "FourDradarsts";
CM_ SG_ 880 FourDRadarECUStsECUFailureVDY "FourDradarsts";
CM_ SG_ 880 FourDRadarECUStsECUFailureVoltage "EcuHW failure";
CM_ SG_ 880 FourDRadarECUStsOperationMode "Operation Mode";
CM_ SG_ 880 FrontFourDRadarStsForDim "FourD radar sts";
CM_ SG_ 880 FrontFourDRadarStsRdrNrDetn "Radar detection number";
CM_ SG_ 880 FrontFourDRadarStsRdrNrObj "Radar Object number";
CM_ SG_ 880 FrontFourDRadarStsRdrStsBlkd0bin "Radar blocked status to bin";
CM_ SG_ 880 FrontFourDRadarStsRdrStsBlkdConf "Radar Status blockage confidence";
CM_ SG_ 880 FrontFourDRadarStsRdrStsChks "Radar status check sum";
CM_ SG_ 880 FrontFourDRadarStsRdrStsCntr "Radar Status Counter";
CM_ SG_ 880 FrontFourDRadarStsRdrStsDstbc "RdrStsDstBc";
CM_ SG_ 880 FrontFourDRadarStsRdrStsEna "Radar RF status";
CM_ SG_ 880 FrontFourDRadarStsRdrStsFaulty "Radar Status";
CM_ SG_ 880 FrontFourDRadarStsRdrStsIfVersMajor "RdrStslfVersMajor";
CM_ SG_ 880 FrontFourDRadarStsRdrStsIfVersMinor "RadarStatusVerMinor";
CM_ SG_ 880 FrontFourDRadarStsRdrStsLatency "Radar time syne latency";
CM_ SG_ 880 FrontFourDRadarStsRdrStsMisAlign "Radar alignment states";
CM_ SG_ 880 FrontFourDRadarStsRdrStsMissCom "Radar miss communication status";
CM_ SG_ 880 FrontFourDRadarStsRdrStsSftyFlt "radar functional safety status";
CM_ SG_ 880 FrontFourDRadarStsRdrStsTiStampH "radar time syn high";
CM_ SG_ 880 FrontFourDRadarStsRdrStsTiStampL "radar time syn low ";
CM_ SG_ 880 FrontFourDRadarStsRdrStsTiStampStsGlbTiBas "RadarstatusTimestampeGlbTibas";
CM_ SG_ 880 FrontFourDRadarStsRdrStsTiStampStsSyncToGatewy "RdrStsTiStampStsSyncToGatewy";
CM_ SG_ 880 FrontFourDRadarStsRdrStsTiStampStsTiLeap "RdrStsTiStampStsTiLeap";
CM_ SG_ 880 FrontFourDRadarStsRdrStsTiStampStsTiOut "RdrStsTiStampStsTiOut";
CM_ SG_ 880 FrontFourDRadarStsRdrStsWhlSpdCmpFac "RdrStsWhlSpdCmpFac";
CM_ SG_ 880 FrontFourDRadarVDYChks "checksum";
CM_ SG_ 880 FrontFourDRadarVDYCntr "counter";
CM_ SG_ 880 FrontFourDRadarVDYuiTimeStamp "Timestamp
";
CM_ SG_ 880 FrontFourDRadarVDYVelocity "Velocity
";
CM_ SG_ 880 FrontFourDRadarVDYYawRate "Yawrate
";

// Attribute definitions
BA_DEF_  "BaudRateCANFD" FLOAT 1000 10000000; // [bps]
BA_DEF_  "Baudrate" INT 1000 1000000; // [bps]
BA_DEF_  "BusType" STRING;
BA_DEF_  "DBName" STRING;
BA_DEF_  "ProtocolType" STRING;
BA_DEF_ BU_ "NmAsrNode" ENUM "No","Yes";
BA_DEF_ BU_ "NmAsrNodeIdentifier" INT 0 255;
BA_DEF_ BO_ "CANFD_BRS" ENUM "0","1";
BA_DEF_ BO_ "GenMsgCycleTime" INT 0 65536; // [ms]
BA_DEF_ BO_ "GenMsgDelayTime" INT 0 65536; // [ms]
BA_DEF_ BO_ "GenMsgSendType" ENUM "cyclic", "spontaneous", "not-used", "not-used", "not-used", "cyclicAndSpontaneous", "not-used", "cyclicIfActive", "NoMsgSendType"; // [us]
BA_DEF_ BO_ "GenMsgStartDelayTime" INT 0 65536; // [ms]
BA_DEF_ BO_ "VFrameFormat" ENUM "StandardCAN","ExtendedCAN","reserved","J1939PG","reserved","reserved","reserved","reserved","reserved","reserved","reserved","reserved","reserved","reserved","StandardCAN_FD","ExtendedCAN_FD";
BA_DEF_ SG_ "GenSigSendType" ENUM "Cyclic","OnWrite","OnWriteWithRepetition","OnChange","OnChangeWithRepetition","IfActive","IfActiveWithRepetition","NoSigSendType";
BA_DEF_ SG_ "GenSigStartValue" HEX 0 80000000;
BA_DEF_ BO_ "GenMsgILSupport" ENUM "No","Yes";
BA_DEF_ BO_ "NmAsrMessage" ENUM "No","Yes";
BA_DEF_  "NmAsrBaseAddress" HEX 0 536870911;
BA_DEF_  "NmAsrMessageCount" INT 0 255;
BA_DEF_ BU_ "NodeLayerModules" STRING;
BA_DEF_ BU_ "ILused" ENUM "No","Yes";
BA_DEF_ SG_ "GenSigFuncType" ENUM "NoFunction","n/a","n/a","n/a","n/a","n/a","n/a","n/a","n/a","n/a","n/a","n/a","n/a","n/a","n/a","CHK","CNTR","n/a","n/a","n/a","CNTR_AR_01","CRC_AR_01_BOTH","CRC_AR_01_ALT","CRC_AR_01_LOW","CRC_AR_01_NIBBLE","CNTR_AR_04","CRC_AR_04A","CNTR_AR_05","CRC_AR_05";
BA_DEF_ SG_ "GenSigDataID" STRING;

BA_DEF_DEF_ "BusType" "";
BA_DEF_DEF_ "DBName" "";
BA_DEF_DEF_ "ProtocolType" "";
BA_DEF_DEF_ "NmAsrNode" "No";
BA_DEF_DEF_ "NmAsrNodeIdentifier" 0;
BA_DEF_DEF_ "CANFD_BRS" "1";
BA_DEF_DEF_ "GenSigStartValue" 0;
BA_DEF_DEF_ "VFrameFormat" "J1939PG";
BA_DEF_DEF_ "GenSigSendType" "NoSigSendType";
BA_DEF_DEF_ "GenMsgCycleTime" 0;
BA_DEF_DEF_ "GenMsgDelayTime" 0;
BA_DEF_DEF_ "GenMsgStartDelayTime" 0;
BA_DEF_DEF_ "GenMsgSendType" "NoMsgSendType";
BA_DEF_DEF_ "GenMsgILSupport" "Yes";
BA_DEF_DEF_ "NmAsrMessage" "No";
BA_DEF_DEF_ "NmAsrBaseAddress" 1280;
BA_DEF_DEF_ "NmAsrMessageCount" 64;
BA_DEF_DEF_ "NodeLayerModules" "CANoeILNLSPA.dll";
BA_DEF_DEF_ "ILused" "Yes";
BA_DEF_DEF_ "GenSigFuncType" "NoFunction";
BA_DEF_DEF_ "GenSigDataID" "";

BA_ "BaudRateCANFD" 2000000;
BA_ "Baudrate" 500000;
BA_ "BusType" "CAN FD";
BA_ "DBName" "SafetyCANFD2";
BA_ "ProtocolType" "CAN";
// Network
// ECU: ASDM
BA_ "NmAsrNode" BU_ ASDM 1;
BA_ "NmAsrNodeIdentifier" BU_ ASDM 1;
BA_ "NodeLayerModules" BU_ ASDM "CANoeILNLSPA.dll,AsrNM33.dll";
// ECU: ETC
BA_ "ILused" BU_ ETC 0;
// ECU: FLR4
BA_ "NmAsrNode" BU_ FLR4 1;
BA_ "NmAsrNodeIdentifier" BU_ FLR4 2;
BA_ "NodeLayerModules" BU_ FLR4 "CANoeILNLSPA.dll,AsrNM33.dll";
// Frame: ASDMCanFD2TimeSynchFr
BA_ "GenMsgDelayTime" BO_ 33 20.000;
BA_ "GenMsgSendType" BO_ 33 1;
BA_ "VFrameFormat" BO_ 33 14;
// Frame: ASDMSafetyCANFD2Frame3
BA_ "GenMsgCycleTime" BO_ 18 20.000;
BA_ "GenMsgSendType" BO_ 18 0;
BA_ "VFrameFormat" BO_ 18 14;
// Frame: ASDMSafetyCANFD2Frame4
BA_ "GenMsgCycleTime" BO_ 288 20.000;
BA_ "GenMsgSendType" BO_ 288 0;
BA_ "VFrameFormat" BO_ 288 14;
// Frame: ASDMSafetyCANFD2Frame7
BA_ "GenMsgCycleTime" BO_ 1007 500.000;
BA_ "GenMsgSendType" BO_ 1007 0;
BA_ "VFrameFormat" BO_ 1007 14;
// Frame: AdmcSafetyCANFD2Frame01
BA_ "GenMsgCycleTime" BO_ 101 10.000;
BA_ "GenMsgSendType" BO_ 101 0;
BA_ "VFrameFormat" BO_ 101 14;
// Frame: AdmcSafetyCANFD2Frame02
BA_ "GenMsgCycleTime" BO_ 848 20.000;
BA_ "GenMsgSendType" BO_ 848 0;
BA_ "VFrameFormat" BO_ 848 14;
// Frame: AdmcSafetyCANFD2Frame03
BA_ "GenMsgCycleTime" BO_ 405 50.000;
BA_ "GenMsgSendType" BO_ 405 0;
BA_ "VFrameFormat" BO_ 405 14;
// Frame: AdmcSafetyCANFD2Frame04
BA_ "GenMsgDelayTime" BO_ 837 80.000;
BA_ "GenMsgSendType" BO_ 837 1;
BA_ "VFrameFormat" BO_ 837 14;
// Frame: AdmcSafetyCANFD2Frame05
BA_ "GenMsgCycleTime" BO_ 853 160.000;
BA_ "GenMsgSendType" BO_ 853 0;
BA_ "VFrameFormat" BO_ 853 14;
// Frame: AsdmSafetyCanFD2NmFr
BA_ "GenMsgDelayTime" BO_ 1281 20.000;
BA_ "GenMsgSendType" BO_ 1281 1;
BA_ "VFrameFormat" BO_ 1281 0;
// Frame: AsdmToAllFuncSafetyCanFD2DiagReqFrame1
BA_ "GenMsgDelayTime" BO_ 2047 5.000;
BA_ "GenMsgSendType" BO_ 2047 1;
BA_ "VFrameFormat" BO_ 2047 14;
// Frame: AsdmToFlrSafetyCanFD2DiagReqFrame1
BA_ "GenMsgDelayTime" BO_ 1860 5.000;
BA_ "GenMsgSendType" BO_ 1860 1;
BA_ "VFrameFormat" BO_ 1860 14;
// Frame: EtctoFlrXcpFr01
BA_ "GenMsgDelayTime" BO_ 1410 5.000;
BA_ "GenMsgSendType" BO_ 1410 1;
BA_ "VFrameFormat" BO_ 1410 0;
// Frame: FLRSafetyCANFD2Frame100
BA_ "GenMsgCycleTime" BO_ 955 60.000;
BA_ "GenMsgSendType" BO_ 955 0;
BA_ "VFrameFormat" BO_ 955 14;
// Frame: FLRSafetyCANFD2Frame101
BA_ "GenMsgCycleTime" BO_ 956 60.000;
BA_ "GenMsgSendType" BO_ 956 0;
BA_ "VFrameFormat" BO_ 956 14;
// Frame: FLRSafetyCANFD2Frame102
BA_ "GenMsgCycleTime" BO_ 994 60.000;
BA_ "GenMsgSendType" BO_ 994 0;
BA_ "VFrameFormat" BO_ 994 14;
// Frame: FLRSafetyCANFD2Frame103
BA_ "GenMsgCycleTime" BO_ 957 60.000;
BA_ "GenMsgSendType" BO_ 957 0;
BA_ "VFrameFormat" BO_ 957 14;
// Frame: FLRSafetyCANFD2Frame104
BA_ "GenMsgCycleTime" BO_ 958 60.000;
BA_ "GenMsgSendType" BO_ 958 0;
BA_ "VFrameFormat" BO_ 958 14;
// Frame: FLRSafetyCANFD2Frame105
BA_ "GenMsgCycleTime" BO_ 959 60.000;
BA_ "GenMsgSendType" BO_ 959 0;
BA_ "VFrameFormat" BO_ 959 14;
// Frame: FLRSafetyCANFD2Frame106
BA_ "GenMsgCycleTime" BO_ 961 60.000;
BA_ "GenMsgSendType" BO_ 961 0;
BA_ "VFrameFormat" BO_ 961 14;
// Frame: FLRSafetyCANFD2Frame107
BA_ "GenMsgCycleTime" BO_ 962 60.000;
BA_ "GenMsgSendType" BO_ 962 0;
BA_ "VFrameFormat" BO_ 962 14;
// Frame: FLRSafetyCANFD2Frame108
BA_ "GenMsgCycleTime" BO_ 965 60.000;
BA_ "GenMsgSendType" BO_ 965 0;
BA_ "VFrameFormat" BO_ 965 14;
// Frame: FLRSafetyCANFD2Frame65
BA_ "GenMsgCycleTime" BO_ 880 60.000;
BA_ "GenMsgSendType" BO_ 880 0;
BA_ "VFrameFormat" BO_ 880 14;
// Frame: FlcSafetyCANFD2Fr01
BA_ "GenMsgCycleTime" BO_ 16 20.000;
BA_ "GenMsgSendType" BO_ 16 0;
BA_ "VFrameFormat" BO_ 16 14;
BA_ "GenMsgILSupport" BO_ 1281 0;
BA_ "NmAsrMessage" BO_ 1281 1;
BA_ "GenSigSendType" SG_ 853 AD4HDMapRoadTyp 0;
BA_ "GenSigSendType" SG_ 288 ADataRawSafeALat 0;
BA_ "GenSigSendType" SG_ 288 ADataRawSafeALat1Qf 0;
BA_ "GenSigStartValue" SG_ 288 ADataRawSafeALat1Qf 1;
BA_ "GenSigSendType" SG_ 288 ADataRawSafeALgt 0;
BA_ "GenSigSendType" SG_ 288 ADataRawSafeALgt1Qf 0;
BA_ "GenSigStartValue" SG_ 288 ADataRawSafeALgt1Qf 1;
BA_ "GenSigSendType" SG_ 288 ADataRawSafeAVert 0;
BA_ "GenSigStartValue" SG_ 288 ADataRawSafeAVert 1155;
BA_ "GenSigSendType" SG_ 288 ADataRawSafeAVertQf 0;
BA_ "GenSigStartValue" SG_ 288 ADataRawSafeAVertQf 1;
BA_ "GenSigDataID" SG_ 288 ADataRawSafeChks "0x22";
BA_ "GenSigFuncType" SG_ 288 ADataRawSafeChks 15;
BA_ "GenSigSendType" SG_ 288 ADataRawSafeChks 0;
BA_ "GenSigStartValue" SG_ 288 ADataRawSafeChks 255;
BA_ "GenSigFuncType" SG_ 288 ADataRawSafeCntr 16;
BA_ "GenSigSendType" SG_ 288 ADataRawSafeCntr 0;
BA_ "GenSigSendType" SG_ 288 ALgtStdFromWhlSpdALgtStdFromWhlSpd 0;
BA_ "GenSigDataID" SG_ 288 ALgtStdFromWhlSpdChks "0x34";
BA_ "GenSigFuncType" SG_ 288 ALgtStdFromWhlSpdChks 15;
BA_ "GenSigSendType" SG_ 288 ALgtStdFromWhlSpdChks 0;
BA_ "GenSigFuncType" SG_ 288 ALgtStdFromWhlSpdCntr 16;
BA_ "GenSigSendType" SG_ 288 ALgtStdFromWhlSpdCntr 0;
BA_ "GenSigSendType" SG_ 288 ALgtStdFromWhlSpdQf 0;
BA_ "GenSigStartValue" SG_ 288 ALgtStdFromWhlSpdQf 1;
BA_ "GenSigDataID" SG_ 848 AbsCtrlActvChks "0xD06";
BA_ "GenSigFuncType" SG_ 848 AbsCtrlActvChks 15;
BA_ "GenSigSendType" SG_ 848 AbsCtrlActvChks 0;
BA_ "GenSigFuncType" SG_ 848 AbsCtrlActvCntr 16;
BA_ "GenSigSendType" SG_ 848 AbsCtrlActvCntr 0;
BA_ "GenSigSendType" SG_ 848 AbsCtrlActvCtrlSts1 0;
BA_ "GenSigSendType" SG_ 405 AgDataCmpQualityPitchRateCmpQuality 0;
BA_ "GenSigSendType" SG_ 405 AgDataCmpQualityRollRateCmpQuality 0;
BA_ "GenSigSendType" SG_ 405 AgDataCmpQualityYawRateCmpQuality 0;
BA_ "GenSigDataID" SG_ 853 AgDataRaw2SafeChks "0x404";
BA_ "GenSigFuncType" SG_ 853 AgDataRaw2SafeChks 15;
BA_ "GenSigSendType" SG_ 853 AgDataRaw2SafeChks 0;
BA_ "GenSigStartValue" SG_ 853 AgDataRaw2SafeChks 255;
BA_ "GenSigFuncType" SG_ 853 AgDataRaw2SafeCntr 16;
BA_ "GenSigSendType" SG_ 853 AgDataRaw2SafeCntr 0;
BA_ "GenSigSendType" SG_ 853 AgDataRaw2SafePitchRate 0;
BA_ "GenSigSendType" SG_ 853 AgDataRaw2SafePitchRateQf 0;
BA_ "GenSigStartValue" SG_ 853 AgDataRaw2SafePitchRateQf 1;
BA_ "GenSigDataID" SG_ 101 AgDataRawSafeChks "0x23";
BA_ "GenSigFuncType" SG_ 101 AgDataRawSafeChks 15;
BA_ "GenSigSendType" SG_ 101 AgDataRawSafeChks 0;
BA_ "GenSigStartValue" SG_ 101 AgDataRawSafeChks 255;
BA_ "GenSigFuncType" SG_ 101 AgDataRawSafeCntr 16;
BA_ "GenSigSendType" SG_ 101 AgDataRawSafeCntr 0;
BA_ "GenSigSendType" SG_ 101 AgDataRawSafeRollRate 0;
BA_ "GenSigSendType" SG_ 101 AgDataRawSafeRollRateQf 0;
BA_ "GenSigStartValue" SG_ 101 AgDataRawSafeRollRateQf 1;
BA_ "GenSigSendType" SG_ 101 AgDataRawSafeYawRate 0;
BA_ "GenSigSendType" SG_ 101 AgDataRawSafeYawRateQf 0;
BA_ "GenSigStartValue" SG_ 101 AgDataRawSafeYawRateQf 1;
BA_ "GenSigSendType" SG_ 288 AmbTRawAmbTVal 0;
BA_ "GenSigStartValue" SG_ 288 AmbTRawAmbTVal 700;
BA_ "GenSigSendType" SG_ 288 AmbTRawQly 0;
BA_ "GenSigSendType" SG_ 288 AsyDataWithCmpSafeALat1Qf 0;
BA_ "GenSigStartValue" SG_ 288 AsyDataWithCmpSafeALat1Qf 1;
BA_ "GenSigSendType" SG_ 288 AsyDataWithCmpSafeALatWithCmp 0;
BA_ "GenSigSendType" SG_ 288 AsyDataWithCmpSafeALgt1Qf 0;
BA_ "GenSigStartValue" SG_ 288 AsyDataWithCmpSafeALgt1Qf 1;
BA_ "GenSigDataID" SG_ 288 AsyDataWithCmpSafeChks "0x24";
BA_ "GenSigFuncType" SG_ 288 AsyDataWithCmpSafeChks 15;
BA_ "GenSigSendType" SG_ 288 AsyDataWithCmpSafeChks 0;
BA_ "GenSigStartValue" SG_ 288 AsyDataWithCmpSafeChks 255;
BA_ "GenSigFuncType" SG_ 288 AsyDataWithCmpSafeCntr 16;
BA_ "GenSigSendType" SG_ 288 AsyDataWithCmpSafeCntr 0;
BA_ "GenSigSendType" SG_ 288 AsyDataWithCmpSafeGrdtOfALgt 0;
BA_ "GenSigSendType" SG_ 288 AsyDataWithCmpSafeYawRateQf 0;
BA_ "GenSigStartValue" SG_ 288 AsyDataWithCmpSafeYawRateQf 1;
BA_ "GenSigSendType" SG_ 288 AsyDataWithCmpSafeYawRateWithCmp 0;
BA_ "GenSigSendType" SG_ 848 AsySftyEnaDecelAckd 0;
BA_ "GenSigSendType" SG_ 288 BkpOfDstTrvld 0;
BA_ "GenSigSendType" SG_ 288 BodyHei 0;
BA_ "GenSigSendType" SG_ 16 BrkPedlTrvlAct 0;
BA_ "GenSigStartValue" SG_ 16 BrkPedlTrvlAct 500;
BA_ "GenSigDataID" SG_ 16 BrkPedlTrvlChks "0xB3";
BA_ "GenSigFuncType" SG_ 16 BrkPedlTrvlChks 15;
BA_ "GenSigSendType" SG_ 16 BrkPedlTrvlChks 0;
BA_ "GenSigStartValue" SG_ 16 BrkPedlTrvlChks 255;
BA_ "GenSigFuncType" SG_ 16 BrkPedlTrvlCntr 16;
BA_ "GenSigSendType" SG_ 16 BrkPedlTrvlCntr 0;
BA_ "GenSigSendType" SG_ 16 BrkPedlTrvlQf 0;
BA_ "GenSigStartValue" SG_ 16 BrkPedlTrvlQf 1;
BA_ "GenSigSendType" SG_ 16 BrkPedlTrvlSt 0;
BA_ "GenSigSendType" SG_ 16 BrkPedlTrvlStQf 0;
BA_ "GenSigStartValue" SG_ 16 BrkPedlTrvlStQf 1;
BA_ "GenSigSendType" SG_ 16 BrkPedlTrvlTar 0;
BA_ "GenSigStartValue" SG_ 16 BrkPedlTrvlTar 500;
BA_ "GenSigSendType" SG_ 848 BrkSysCylPMstAct 0;
BA_ "GenSigStartValue" SG_ 848 BrkSysCylPMstAct 100;
BA_ "GenSigSendType" SG_ 848 BrkSysCylPMstActQf 0;
BA_ "GenSigStartValue" SG_ 848 BrkSysCylPMstActQf 1;
BA_ "GenSigDataID" SG_ 848 BrkSysCylPMstChks "0xB7";
BA_ "GenSigFuncType" SG_ 848 BrkSysCylPMstChks 15;
BA_ "GenSigSendType" SG_ 848 BrkSysCylPMstChks 0;
BA_ "GenSigFuncType" SG_ 848 BrkSysCylPMstCntr 16;
BA_ "GenSigSendType" SG_ 848 BrkSysCylPMstCntr 0;
BA_ "GenSigSendType" SG_ 848 BrkSysCylPMstTar 0;
BA_ "GenSigSendType" SG_ 848 BrkSysCylPMstVirt 0;
BA_ "GenSigSendType" SG_ 848 BrkSysCylPMstVirtQf 0;
BA_ "GenSigStartValue" SG_ 848 BrkSysCylPMstVirtQf 1;
BA_ "GenSigSendType" SG_ 405 BrkTracCtrlActv 0;
BA_ "GenSigSendType" SG_ 288 CarTiGlb 0;
BA_ "GenSigSendType" SG_ 288 DrvModReq 0;
BA_ "GenSigDataID" SG_ 848 EpbStsChks "0x84";
BA_ "GenSigFuncType" SG_ 848 EpbStsChks 15;
BA_ "GenSigSendType" SG_ 848 EpbStsChks 0;
BA_ "GenSigFuncType" SG_ 848 EpbStsCntr 16;
BA_ "GenSigSendType" SG_ 848 EpbStsCntr 0;
BA_ "GenSigSendType" SG_ 848 EpbStsEpbSts 0;
BA_ "GenSigSendType" SG_ 848 EscCtrlIndcn 0;
BA_ "GenSigStartValue" SG_ 848 EscCtrlIndcn 1;
BA_ "GenSigDataID" SG_ 848 EscStChks "0x7F";
BA_ "GenSigFuncType" SG_ 848 EscStChks 15;
BA_ "GenSigSendType" SG_ 848 EscStChks 0;
BA_ "GenSigFuncType" SG_ 848 EscStCntr 16;
BA_ "GenSigSendType" SG_ 848 EscStCntr 0;
BA_ "GenSigSendType" SG_ 848 EscStEscSt 0;
BA_ "GenSigStartValue" SG_ 848 EscStEscSt 1;
BA_ "GenSigSendType" SG_ 405 ExtrLtgStsAFS 0;
BA_ "GenSigSendType" SG_ 405 ExtrLtgStsAHBC 0;
BA_ "GenSigSendType" SG_ 405 ExtrLtgStsAHL 0;
BA_ "GenSigSendType" SG_ 405 ExtrLtgStsAllWL 0;
BA_ "GenSigSendType" SG_ 405 ExtrLtgStsApproach 0;
BA_ "GenSigDataID" SG_ 405 ExtrLtgStsChks "0x44C";
BA_ "GenSigFuncType" SG_ 405 ExtrLtgStsChks 15;
BA_ "GenSigSendType" SG_ 405 ExtrLtgStsChks 0;
BA_ "GenSigFuncType" SG_ 405 ExtrLtgStsCntr 16;
BA_ "GenSigSendType" SG_ 405 ExtrLtgStsCntr 0;
BA_ "GenSigSendType" SG_ 405 ExtrLtgStsCornrgLi 0;
BA_ "GenSigSendType" SG_ 405 ExtrLtgStsDBL 0;
BA_ "GenSigSendType" SG_ 405 ExtrLtgStsDRL 0;
BA_ "GenSigSendType" SG_ 405 ExtrLtgStsFlash 0;
BA_ "GenSigSendType" SG_ 405 ExtrLtgStsFrntFog 0;
BA_ "GenSigSendType" SG_ 405 ExtrLtgStsGoodbye 0;
BA_ "GenSigSendType" SG_ 405 ExtrLtgStsHWL 0;
BA_ "GenSigSendType" SG_ 405 ExtrLtgStsHiBeam 0;
BA_ "GenSigSendType" SG_ 405 ExtrLtgStsHomeSafe 0;
BA_ "GenSigSendType" SG_ 405 ExtrLtgStsLoBeam 0;
BA_ "GenSigSendType" SG_ 405 ExtrLtgStsLtgShow 0;
BA_ "GenSigSendType" SG_ 405 ExtrLtgStsPosLiFrnt 0;
BA_ "GenSigSendType" SG_ 405 ExtrLtgStsPosLiRe 0;
BA_ "GenSigSendType" SG_ 405 ExtrLtgStsReFog 0;
BA_ "GenSigSendType" SG_ 405 ExtrLtgStsReverseLi 0;
BA_ "GenSigSendType" SG_ 405 ExtrLtgStsStopLi 0;
BA_ "GenSigSendType" SG_ 405 ExtrLtgStsTurnIndrLe 0;
BA_ "GenSigSendType" SG_ 405 ExtrLtgStsTurnIndrRi 0;
BA_ "GenSigSendType" SG_ 405 ExtrLtgStsWelcome 0;
BA_ "GenSigSendType" SG_ 880 FourDRadarECUStsCalibrationSts 0;
BA_ "GenSigDataID" SG_ 880 FourDRadarECUStsChks "0xE03";
BA_ "GenSigFuncType" SG_ 880 FourDRadarECUStsChks 15;
BA_ "GenSigSendType" SG_ 880 FourDRadarECUStsChks 0;
BA_ "GenSigFuncType" SG_ 880 FourDRadarECUStsCntr 16;
BA_ "GenSigSendType" SG_ 880 FourDRadarECUStsCntr 0;
BA_ "GenSigSendType" SG_ 880 FourDRadarECUStsECUFailureE2E 0;
BA_ "GenSigSendType" SG_ 880 FourDRadarECUStsECUFailureNVM 0;
BA_ "GenSigSendType" SG_ 880 FourDRadarECUStsECUFailurePlausibility 0;
BA_ "GenSigSendType" SG_ 880 FourDRadarECUStsECUFailureQF 0;
BA_ "GenSigSendType" SG_ 880 FourDRadarECUStsECUFailureTemperature 0;
BA_ "GenSigSendType" SG_ 880 FourDRadarECUStsECUFailureUB 0;
BA_ "GenSigSendType" SG_ 880 FourDRadarECUStsECUFailureVCS 0;
BA_ "GenSigSendType" SG_ 880 FourDRadarECUStsECUFailureVDY 0;
BA_ "GenSigSendType" SG_ 880 FourDRadarECUStsECUFailureVoltage 0;
BA_ "GenSigSendType" SG_ 880 FourDRadarECUStsOperationMode 0;
BA_ "GenSigDataID" SG_ 955 FourDRadarObjSts28Chks "0xE1E";
BA_ "GenSigFuncType" SG_ 955 FourDRadarObjSts28Chks 15;
BA_ "GenSigSendType" SG_ 955 FourDRadarObjSts28Chks 0;
BA_ "GenSigSendType" SG_ 955 FourDRadarObjSts28Classification 0;
BA_ "GenSigFuncType" SG_ 955 FourDRadarObjSts28Cntr 16;
BA_ "GenSigSendType" SG_ 955 FourDRadarObjSts28Cntr 0;
BA_ "GenSigSendType" SG_ 955 FourDRadarObjSts28DistX 0;
BA_ "GenSigStartValue" SG_ 955 FourDRadarObjSts28DistX 32768;
BA_ "GenSigSendType" SG_ 955 FourDRadarObjSts28DistXStd 0;
BA_ "GenSigSendType" SG_ 955 FourDRadarObjSts28DistY 0;
BA_ "GenSigStartValue" SG_ 955 FourDRadarObjSts28DistY 4096;
BA_ "GenSigSendType" SG_ 955 FourDRadarObjSts28DistYStd 0;
BA_ "GenSigSendType" SG_ 955 FourDRadarObjSts28DistZ 0;
BA_ "GenSigStartValue" SG_ 955 FourDRadarObjSts28DistZ 4096;
BA_ "GenSigSendType" SG_ 955 FourDRadarObjSts28DistZStd 0;
BA_ "GenSigSendType" SG_ 955 FourDRadarObjSts28DynamicProperty 0;
BA_ "GenSigSendType" SG_ 955 FourDRadarObjSts28HeadingAngle 0;
BA_ "GenSigStartValue" SG_ 955 FourDRadarObjSts28HeadingAngle 2047.78157;
BA_ "GenSigSendType" SG_ 955 FourDRadarObjSts28ID 0;
BA_ "GenSigSendType" SG_ 955 FourDRadarObjSts28LifeCycles 0;
BA_ "GenSigSendType" SG_ 955 FourDRadarObjSts28ObjBoundingBoxHeight 0;
BA_ "GenSigSendType" SG_ 955 FourDRadarObjSts28ObjBoundingBoxLength 0;
BA_ "GenSigSendType" SG_ 955 FourDRadarObjSts28ObjBoundingBoxWidth 0;
BA_ "GenSigSendType" SG_ 955 FourDRadarObjSts28ObjNearestPtX 0;
BA_ "GenSigStartValue" SG_ 955 FourDRadarObjSts28ObjNearestPtX 32768;
BA_ "GenSigSendType" SG_ 955 FourDRadarObjSts28ObjNearestPtY 0;
BA_ "GenSigStartValue" SG_ 955 FourDRadarObjSts28ObjNearestPtY 4096;
BA_ "GenSigSendType" SG_ 955 FourDRadarObjSts28ObjNearestPtZ 0;
BA_ "GenSigStartValue" SG_ 955 FourDRadarObjSts28ObjNearestPtZ 4096;
BA_ "GenSigSendType" SG_ 955 FourDRadarObjSts28ObjSNR 0;
BA_ "GenSigSendType" SG_ 955 FourDRadarObjSts28ObjXAccRel 0;
BA_ "GenSigStartValue" SG_ 955 FourDRadarObjSts28ObjXAccRel 356;
BA_ "GenSigSendType" SG_ 955 FourDRadarObjSts28ObjYAccRel 0;
BA_ "GenSigStartValue" SG_ 955 FourDRadarObjSts28ObjYAccRel 356;
BA_ "GenSigSendType" SG_ 955 FourDRadarObjSts28ObstacleProbability 0;
BA_ "GenSigSendType" SG_ 955 FourDRadarObjSts28ProbabilityOfExistence 0;
BA_ "GenSigSendType" SG_ 955 FourDRadarObjSts28RCS 0;
BA_ "GenSigStartValue" SG_ 955 FourDRadarObjSts28RCS 1000;
BA_ "GenSigSendType" SG_ 955 FourDRadarObjSts28TargetClassificationConfidence 0;
BA_ "GenSigSendType" SG_ 955 FourDRadarObjSts28UpdateFlag 0;
BA_ "GenSigSendType" SG_ 955 FourDRadarObjSts28VabsX 0;
BA_ "GenSigStartValue" SG_ 955 FourDRadarObjSts28VabsX 1024;
BA_ "GenSigSendType" SG_ 955 FourDRadarObjSts28VabsXStd 0;
BA_ "GenSigSendType" SG_ 955 FourDRadarObjSts28VabsY 0;
BA_ "GenSigStartValue" SG_ 955 FourDRadarObjSts28VabsY 1024;
BA_ "GenSigSendType" SG_ 955 FourDRadarObjSts28VabsYStd 0;
BA_ "GenSigSendType" SG_ 955 FourDRadarObjSts28ValidFlag 0;
BA_ "GenSigDataID" SG_ 956 FourDRadarObjSts30Chks "0xE20";
BA_ "GenSigFuncType" SG_ 956 FourDRadarObjSts30Chks 15;
BA_ "GenSigSendType" SG_ 956 FourDRadarObjSts30Chks 0;
BA_ "GenSigSendType" SG_ 956 FourDRadarObjSts30Classification 0;
BA_ "GenSigFuncType" SG_ 956 FourDRadarObjSts30Cntr 16;
BA_ "GenSigSendType" SG_ 956 FourDRadarObjSts30Cntr 0;
BA_ "GenSigSendType" SG_ 956 FourDRadarObjSts30DistX 0;
BA_ "GenSigStartValue" SG_ 956 FourDRadarObjSts30DistX 32768;
BA_ "GenSigSendType" SG_ 956 FourDRadarObjSts30DistXStd 0;
BA_ "GenSigSendType" SG_ 956 FourDRadarObjSts30DistY 0;
BA_ "GenSigStartValue" SG_ 956 FourDRadarObjSts30DistY 4096;
BA_ "GenSigSendType" SG_ 956 FourDRadarObjSts30DistYStd 0;
BA_ "GenSigSendType" SG_ 956 FourDRadarObjSts30DistZ 0;
BA_ "GenSigStartValue" SG_ 956 FourDRadarObjSts30DistZ 4096;
BA_ "GenSigSendType" SG_ 956 FourDRadarObjSts30DistZStd 0;
BA_ "GenSigSendType" SG_ 956 FourDRadarObjSts30DynamicProperty 0;
BA_ "GenSigSendType" SG_ 956 FourDRadarObjSts30HeadingAngle 0;
BA_ "GenSigStartValue" SG_ 956 FourDRadarObjSts30HeadingAngle 2047.78157;
BA_ "GenSigSendType" SG_ 956 FourDRadarObjSts30ID 0;
BA_ "GenSigSendType" SG_ 956 FourDRadarObjSts30LifeCycles 0;
BA_ "GenSigSendType" SG_ 956 FourDRadarObjSts30ObjBoundingBoxHeight 0;
BA_ "GenSigSendType" SG_ 956 FourDRadarObjSts30ObjBoundingBoxLength 0;
BA_ "GenSigSendType" SG_ 956 FourDRadarObjSts30ObjBoundingBoxWidth 0;
BA_ "GenSigSendType" SG_ 956 FourDRadarObjSts30ObjNearestPtX 0;
BA_ "GenSigStartValue" SG_ 956 FourDRadarObjSts30ObjNearestPtX 32768;
BA_ "GenSigSendType" SG_ 956 FourDRadarObjSts30ObjNearestPtY 0;
BA_ "GenSigStartValue" SG_ 956 FourDRadarObjSts30ObjNearestPtY 4096;
BA_ "GenSigSendType" SG_ 956 FourDRadarObjSts30ObjNearestPtZ 0;
BA_ "GenSigStartValue" SG_ 956 FourDRadarObjSts30ObjNearestPtZ 4096;
BA_ "GenSigSendType" SG_ 956 FourDRadarObjSts30ObjSNR 0;
BA_ "GenSigSendType" SG_ 956 FourDRadarObjSts30ObjXAccRel 0;
BA_ "GenSigStartValue" SG_ 956 FourDRadarObjSts30ObjXAccRel 356;
BA_ "GenSigSendType" SG_ 956 FourDRadarObjSts30ObjYAccRel 0;
BA_ "GenSigStartValue" SG_ 956 FourDRadarObjSts30ObjYAccRel 356;
BA_ "GenSigSendType" SG_ 956 FourDRadarObjSts30ObstacleProbability 0;
BA_ "GenSigSendType" SG_ 956 FourDRadarObjSts30ProbabilityOfExistence 0;
BA_ "GenSigSendType" SG_ 956 FourDRadarObjSts30RCS 0;
BA_ "GenSigStartValue" SG_ 956 FourDRadarObjSts30RCS 1000;
BA_ "GenSigSendType" SG_ 956 FourDRadarObjSts30TargetClassificationConfidence 0;
BA_ "GenSigSendType" SG_ 956 FourDRadarObjSts30UpdateFlag 0;
BA_ "GenSigSendType" SG_ 956 FourDRadarObjSts30VabsX 0;
BA_ "GenSigStartValue" SG_ 956 FourDRadarObjSts30VabsX 1024;
BA_ "GenSigSendType" SG_ 956 FourDRadarObjSts30VabsXStd 0;
BA_ "GenSigSendType" SG_ 956 FourDRadarObjSts30VabsY 0;
BA_ "GenSigStartValue" SG_ 956 FourDRadarObjSts30VabsY 1024;
BA_ "GenSigSendType" SG_ 956 FourDRadarObjSts30VabsYStd 0;
BA_ "GenSigSendType" SG_ 956 FourDRadarObjSts30ValidFlag 0;
BA_ "GenSigDataID" SG_ 957 FourDRadarObjSts32Chks "0xE22";
BA_ "GenSigFuncType" SG_ 957 FourDRadarObjSts32Chks 15;
BA_ "GenSigSendType" SG_ 957 FourDRadarObjSts32Chks 0;
BA_ "GenSigSendType" SG_ 957 FourDRadarObjSts32Classification 0;
BA_ "GenSigFuncType" SG_ 957 FourDRadarObjSts32Cntr 16;
BA_ "GenSigSendType" SG_ 957 FourDRadarObjSts32Cntr 0;
BA_ "GenSigSendType" SG_ 957 FourDRadarObjSts32DistX 0;
BA_ "GenSigStartValue" SG_ 957 FourDRadarObjSts32DistX 32768;
BA_ "GenSigSendType" SG_ 957 FourDRadarObjSts32DistXStd 0;
BA_ "GenSigSendType" SG_ 957 FourDRadarObjSts32DistY 0;
BA_ "GenSigStartValue" SG_ 957 FourDRadarObjSts32DistY 4096;
BA_ "GenSigSendType" SG_ 957 FourDRadarObjSts32DistYStd 0;
BA_ "GenSigSendType" SG_ 957 FourDRadarObjSts32DistZ 0;
BA_ "GenSigStartValue" SG_ 957 FourDRadarObjSts32DistZ 4096;
BA_ "GenSigSendType" SG_ 957 FourDRadarObjSts32DistZStd 0;
BA_ "GenSigSendType" SG_ 957 FourDRadarObjSts32DynamicProperty 0;
BA_ "GenSigSendType" SG_ 957 FourDRadarObjSts32HeadingAngle 0;
BA_ "GenSigStartValue" SG_ 957 FourDRadarObjSts32HeadingAngle 2047.78157;
BA_ "GenSigSendType" SG_ 957 FourDRadarObjSts32ID 0;
BA_ "GenSigSendType" SG_ 957 FourDRadarObjSts32LifeCycles 0;
BA_ "GenSigSendType" SG_ 957 FourDRadarObjSts32ObjBoundingBoxHeight 0;
BA_ "GenSigSendType" SG_ 957 FourDRadarObjSts32ObjBoundingBoxLength 0;
BA_ "GenSigSendType" SG_ 957 FourDRadarObjSts32ObjBoundingBoxWidth 0;
BA_ "GenSigSendType" SG_ 957 FourDRadarObjSts32ObjNearestPtX 0;
BA_ "GenSigStartValue" SG_ 957 FourDRadarObjSts32ObjNearestPtX 32768;
BA_ "GenSigSendType" SG_ 957 FourDRadarObjSts32ObjNearestPtY 0;
BA_ "GenSigStartValue" SG_ 957 FourDRadarObjSts32ObjNearestPtY 4096;
BA_ "GenSigSendType" SG_ 957 FourDRadarObjSts32ObjNearestPtZ 0;
BA_ "GenSigStartValue" SG_ 957 FourDRadarObjSts32ObjNearestPtZ 4096;
BA_ "GenSigSendType" SG_ 957 FourDRadarObjSts32ObjSNR 0;
BA_ "GenSigSendType" SG_ 957 FourDRadarObjSts32ObjXAccRel 0;
BA_ "GenSigStartValue" SG_ 957 FourDRadarObjSts32ObjXAccRel 356;
BA_ "GenSigSendType" SG_ 957 FourDRadarObjSts32ObjYAccRel 0;
BA_ "GenSigStartValue" SG_ 957 FourDRadarObjSts32ObjYAccRel 356;
BA_ "GenSigSendType" SG_ 957 FourDRadarObjSts32ObstacleProbability 0;
BA_ "GenSigSendType" SG_ 957 FourDRadarObjSts32ProbabilityOfExistence 0;
BA_ "GenSigSendType" SG_ 957 FourDRadarObjSts32RCS 0;
BA_ "GenSigStartValue" SG_ 957 FourDRadarObjSts32RCS 1000;
BA_ "GenSigSendType" SG_ 957 FourDRadarObjSts32TargetClassificationConfidence 0;
BA_ "GenSigSendType" SG_ 957 FourDRadarObjSts32UpdateFlag 0;
BA_ "GenSigSendType" SG_ 957 FourDRadarObjSts32VabsX 0;
BA_ "GenSigStartValue" SG_ 957 FourDRadarObjSts32VabsX 1024;
BA_ "GenSigSendType" SG_ 957 FourDRadarObjSts32VabsXStd 0;
BA_ "GenSigSendType" SG_ 957 FourDRadarObjSts32VabsY 0;
BA_ "GenSigStartValue" SG_ 957 FourDRadarObjSts32VabsY 1024;
BA_ "GenSigSendType" SG_ 957 FourDRadarObjSts32VabsYStd 0;
BA_ "GenSigSendType" SG_ 957 FourDRadarObjSts32ValidFlag 0;
BA_ "GenSigDataID" SG_ 958 FourDRadarObjSts34Chks "0xE24";
BA_ "GenSigFuncType" SG_ 958 FourDRadarObjSts34Chks 15;
BA_ "GenSigSendType" SG_ 958 FourDRadarObjSts34Chks 0;
BA_ "GenSigSendType" SG_ 958 FourDRadarObjSts34Classification 0;
BA_ "GenSigFuncType" SG_ 958 FourDRadarObjSts34Cntr 16;
BA_ "GenSigSendType" SG_ 958 FourDRadarObjSts34Cntr 0;
BA_ "GenSigSendType" SG_ 958 FourDRadarObjSts34DistX 0;
BA_ "GenSigStartValue" SG_ 958 FourDRadarObjSts34DistX 32768;
BA_ "GenSigSendType" SG_ 958 FourDRadarObjSts34DistXStd 0;
BA_ "GenSigSendType" SG_ 958 FourDRadarObjSts34DistY 0;
BA_ "GenSigStartValue" SG_ 958 FourDRadarObjSts34DistY 4096;
BA_ "GenSigSendType" SG_ 958 FourDRadarObjSts34DistYStd 0;
BA_ "GenSigSendType" SG_ 958 FourDRadarObjSts34DistZ 0;
BA_ "GenSigStartValue" SG_ 958 FourDRadarObjSts34DistZ 4096;
BA_ "GenSigSendType" SG_ 958 FourDRadarObjSts34DistZStd 0;
BA_ "GenSigSendType" SG_ 958 FourDRadarObjSts34DynamicProperty 0;
BA_ "GenSigSendType" SG_ 958 FourDRadarObjSts34HeadingAngle 0;
BA_ "GenSigStartValue" SG_ 958 FourDRadarObjSts34HeadingAngle 2047.78157;
BA_ "GenSigSendType" SG_ 958 FourDRadarObjSts34ID 0;
BA_ "GenSigSendType" SG_ 958 FourDRadarObjSts34LifeCycles 0;
BA_ "GenSigSendType" SG_ 958 FourDRadarObjSts34ObjBoundingBoxHeight 0;
BA_ "GenSigSendType" SG_ 958 FourDRadarObjSts34ObjBoundingBoxLength 0;
BA_ "GenSigSendType" SG_ 958 FourDRadarObjSts34ObjBoundingBoxWidth 0;
BA_ "GenSigSendType" SG_ 958 FourDRadarObjSts34ObjNearestPtX 0;
BA_ "GenSigStartValue" SG_ 958 FourDRadarObjSts34ObjNearestPtX 32768;
BA_ "GenSigSendType" SG_ 958 FourDRadarObjSts34ObjNearestPtY 0;
BA_ "GenSigStartValue" SG_ 958 FourDRadarObjSts34ObjNearestPtY 4096;
BA_ "GenSigSendType" SG_ 958 FourDRadarObjSts34ObjNearestPtZ 0;
BA_ "GenSigStartValue" SG_ 958 FourDRadarObjSts34ObjNearestPtZ 4096;
BA_ "GenSigSendType" SG_ 958 FourDRadarObjSts34ObjSNR 0;
BA_ "GenSigSendType" SG_ 958 FourDRadarObjSts34ObjXAccRel 0;
BA_ "GenSigStartValue" SG_ 958 FourDRadarObjSts34ObjXAccRel 356;
BA_ "GenSigSendType" SG_ 958 FourDRadarObjSts34ObjYAccRel 0;
BA_ "GenSigStartValue" SG_ 958 FourDRadarObjSts34ObjYAccRel 356;
BA_ "GenSigSendType" SG_ 958 FourDRadarObjSts34ObstacleProbability 0;
BA_ "GenSigSendType" SG_ 958 FourDRadarObjSts34ProbabilityOfExistence 0;
BA_ "GenSigSendType" SG_ 958 FourDRadarObjSts34RCS 0;
BA_ "GenSigStartValue" SG_ 958 FourDRadarObjSts34RCS 1000;
BA_ "GenSigSendType" SG_ 958 FourDRadarObjSts34TargetClassificationConfidence 0;
BA_ "GenSigSendType" SG_ 958 FourDRadarObjSts34UpdateFlag 0;
BA_ "GenSigSendType" SG_ 958 FourDRadarObjSts34VabsX 0;
BA_ "GenSigStartValue" SG_ 958 FourDRadarObjSts34VabsX 1024;
BA_ "GenSigSendType" SG_ 958 FourDRadarObjSts34VabsXStd 0;
BA_ "GenSigSendType" SG_ 958 FourDRadarObjSts34VabsY 0;
BA_ "GenSigStartValue" SG_ 958 FourDRadarObjSts34VabsY 1024;
BA_ "GenSigSendType" SG_ 958 FourDRadarObjSts34VabsYStd 0;
BA_ "GenSigSendType" SG_ 958 FourDRadarObjSts34ValidFlag 0;
BA_ "GenSigDataID" SG_ 959 FourDRadarObjSts36Chks "0xE26";
BA_ "GenSigFuncType" SG_ 959 FourDRadarObjSts36Chks 15;
BA_ "GenSigSendType" SG_ 959 FourDRadarObjSts36Chks 0;
BA_ "GenSigSendType" SG_ 959 FourDRadarObjSts36Classification 0;
BA_ "GenSigFuncType" SG_ 959 FourDRadarObjSts36Cntr 16;
BA_ "GenSigSendType" SG_ 959 FourDRadarObjSts36Cntr 0;
BA_ "GenSigSendType" SG_ 959 FourDRadarObjSts36DistX 0;
BA_ "GenSigStartValue" SG_ 959 FourDRadarObjSts36DistX 32768;
BA_ "GenSigSendType" SG_ 959 FourDRadarObjSts36DistXStd 0;
BA_ "GenSigSendType" SG_ 959 FourDRadarObjSts36DistY 0;
BA_ "GenSigStartValue" SG_ 959 FourDRadarObjSts36DistY 4096;
BA_ "GenSigSendType" SG_ 959 FourDRadarObjSts36DistYStd 0;
BA_ "GenSigSendType" SG_ 959 FourDRadarObjSts36DistZ 0;
BA_ "GenSigStartValue" SG_ 959 FourDRadarObjSts36DistZ 4096;
BA_ "GenSigSendType" SG_ 959 FourDRadarObjSts36DistZStd 0;
BA_ "GenSigSendType" SG_ 959 FourDRadarObjSts36DynamicProperty 0;
BA_ "GenSigSendType" SG_ 959 FourDRadarObjSts36HeadingAngle 0;
BA_ "GenSigStartValue" SG_ 959 FourDRadarObjSts36HeadingAngle 2047.78157;
BA_ "GenSigSendType" SG_ 959 FourDRadarObjSts36ID 0;
BA_ "GenSigSendType" SG_ 959 FourDRadarObjSts36LifeCycles 0;
BA_ "GenSigSendType" SG_ 959 FourDRadarObjSts36ObjBoundingBoxHeight 0;
BA_ "GenSigSendType" SG_ 959 FourDRadarObjSts36ObjBoundingBoxLength 0;
BA_ "GenSigSendType" SG_ 959 FourDRadarObjSts36ObjBoundingBoxWidth 0;
BA_ "GenSigSendType" SG_ 959 FourDRadarObjSts36ObjNearestPtX 0;
BA_ "GenSigStartValue" SG_ 959 FourDRadarObjSts36ObjNearestPtX 32768;
BA_ "GenSigSendType" SG_ 959 FourDRadarObjSts36ObjNearestPtY 0;
BA_ "GenSigStartValue" SG_ 959 FourDRadarObjSts36ObjNearestPtY 4096;
BA_ "GenSigSendType" SG_ 959 FourDRadarObjSts36ObjNearestPtZ 0;
BA_ "GenSigStartValue" SG_ 959 FourDRadarObjSts36ObjNearestPtZ 4096;
BA_ "GenSigSendType" SG_ 959 FourDRadarObjSts36ObjSNR 0;
BA_ "GenSigSendType" SG_ 959 FourDRadarObjSts36ObjXAccRel 0;
BA_ "GenSigStartValue" SG_ 959 FourDRadarObjSts36ObjXAccRel 356;
BA_ "GenSigSendType" SG_ 959 FourDRadarObjSts36ObjYAccRel 0;
BA_ "GenSigStartValue" SG_ 959 FourDRadarObjSts36ObjYAccRel 356;
BA_ "GenSigSendType" SG_ 959 FourDRadarObjSts36ObstacleProbability 0;
BA_ "GenSigSendType" SG_ 959 FourDRadarObjSts36ProbabilityOfExistence 0;
BA_ "GenSigSendType" SG_ 959 FourDRadarObjSts36RCS 0;
BA_ "GenSigStartValue" SG_ 959 FourDRadarObjSts36RCS 1000;
BA_ "GenSigSendType" SG_ 959 FourDRadarObjSts36TargetClassificationConfidence 0;
BA_ "GenSigSendType" SG_ 959 FourDRadarObjSts36UpdateFlag 0;
BA_ "GenSigSendType" SG_ 959 FourDRadarObjSts36VabsX 0;
BA_ "GenSigStartValue" SG_ 959 FourDRadarObjSts36VabsX 1024;
BA_ "GenSigSendType" SG_ 959 FourDRadarObjSts36VabsXStd 0;
BA_ "GenSigSendType" SG_ 959 FourDRadarObjSts36VabsY 0;
BA_ "GenSigStartValue" SG_ 959 FourDRadarObjSts36VabsY 1024;
BA_ "GenSigSendType" SG_ 959 FourDRadarObjSts36VabsYStd 0;
BA_ "GenSigSendType" SG_ 959 FourDRadarObjSts36ValidFlag 0;
BA_ "GenSigDataID" SG_ 961 FourDRadarObjSts38Chks "0xE28";
BA_ "GenSigFuncType" SG_ 961 FourDRadarObjSts38Chks 15;
BA_ "GenSigSendType" SG_ 961 FourDRadarObjSts38Chks 0;
BA_ "GenSigSendType" SG_ 961 FourDRadarObjSts38Classification 0;
BA_ "GenSigFuncType" SG_ 961 FourDRadarObjSts38Cntr 16;
BA_ "GenSigSendType" SG_ 961 FourDRadarObjSts38Cntr 0;
BA_ "GenSigSendType" SG_ 961 FourDRadarObjSts38DistX 0;
BA_ "GenSigStartValue" SG_ 961 FourDRadarObjSts38DistX 32768;
BA_ "GenSigSendType" SG_ 961 FourDRadarObjSts38DistXStd 0;
BA_ "GenSigSendType" SG_ 961 FourDRadarObjSts38DistY 0;
BA_ "GenSigStartValue" SG_ 961 FourDRadarObjSts38DistY 4096;
BA_ "GenSigSendType" SG_ 961 FourDRadarObjSts38DistYStd 0;
BA_ "GenSigSendType" SG_ 961 FourDRadarObjSts38DistZ 0;
BA_ "GenSigStartValue" SG_ 961 FourDRadarObjSts38DistZ 4096;
BA_ "GenSigSendType" SG_ 961 FourDRadarObjSts38DistZStd 0;
BA_ "GenSigSendType" SG_ 961 FourDRadarObjSts38DynamicProperty 0;
BA_ "GenSigSendType" SG_ 961 FourDRadarObjSts38HeadingAngle 0;
BA_ "GenSigStartValue" SG_ 961 FourDRadarObjSts38HeadingAngle 2047.78157;
BA_ "GenSigSendType" SG_ 961 FourDRadarObjSts38ID 0;
BA_ "GenSigSendType" SG_ 961 FourDRadarObjSts38LifeCycles 0;
BA_ "GenSigSendType" SG_ 961 FourDRadarObjSts38ObjBoundingBoxHeight 0;
BA_ "GenSigSendType" SG_ 961 FourDRadarObjSts38ObjBoundingBoxLength 0;
BA_ "GenSigSendType" SG_ 961 FourDRadarObjSts38ObjBoundingBoxWidth 0;
BA_ "GenSigSendType" SG_ 961 FourDRadarObjSts38ObjNearestPtX 0;
BA_ "GenSigStartValue" SG_ 961 FourDRadarObjSts38ObjNearestPtX 32768;
BA_ "GenSigSendType" SG_ 961 FourDRadarObjSts38ObjNearestPtY 0;
BA_ "GenSigStartValue" SG_ 961 FourDRadarObjSts38ObjNearestPtY 4096;
BA_ "GenSigSendType" SG_ 961 FourDRadarObjSts38ObjNearestPtZ 0;
BA_ "GenSigStartValue" SG_ 961 FourDRadarObjSts38ObjNearestPtZ 4096;
BA_ "GenSigSendType" SG_ 961 FourDRadarObjSts38ObjSNR 0;
BA_ "GenSigSendType" SG_ 961 FourDRadarObjSts38ObjXAccRel 0;
BA_ "GenSigStartValue" SG_ 961 FourDRadarObjSts38ObjXAccRel 356;
BA_ "GenSigSendType" SG_ 961 FourDRadarObjSts38ObjYAccRel 0;
BA_ "GenSigStartValue" SG_ 961 FourDRadarObjSts38ObjYAccRel 356;
BA_ "GenSigSendType" SG_ 961 FourDRadarObjSts38ObstacleProbability 0;
BA_ "GenSigSendType" SG_ 961 FourDRadarObjSts38ProbabilityOfExistence 0;
BA_ "GenSigSendType" SG_ 961 FourDRadarObjSts38RCS 0;
BA_ "GenSigStartValue" SG_ 961 FourDRadarObjSts38RCS 1000;
BA_ "GenSigSendType" SG_ 961 FourDRadarObjSts38TargetClassificationConfidence 0;
BA_ "GenSigSendType" SG_ 961 FourDRadarObjSts38UpdateFlag 0;
BA_ "GenSigSendType" SG_ 961 FourDRadarObjSts38VabsX 0;
BA_ "GenSigStartValue" SG_ 961 FourDRadarObjSts38VabsX 1024;
BA_ "GenSigSendType" SG_ 961 FourDRadarObjSts38VabsXStd 0;
BA_ "GenSigSendType" SG_ 961 FourDRadarObjSts38VabsY 0;
BA_ "GenSigStartValue" SG_ 961 FourDRadarObjSts38VabsY 1024;
BA_ "GenSigSendType" SG_ 961 FourDRadarObjSts38VabsYStd 0;
BA_ "GenSigSendType" SG_ 961 FourDRadarObjSts38ValidFlag 0;
BA_ "GenSigDataID" SG_ 962 FourDRadarObjSts40Chks "0xE2A";
BA_ "GenSigFuncType" SG_ 962 FourDRadarObjSts40Chks 15;
BA_ "GenSigSendType" SG_ 962 FourDRadarObjSts40Chks 0;
BA_ "GenSigSendType" SG_ 962 FourDRadarObjSts40Classification 0;
BA_ "GenSigFuncType" SG_ 962 FourDRadarObjSts40Cntr 16;
BA_ "GenSigSendType" SG_ 962 FourDRadarObjSts40Cntr 0;
BA_ "GenSigSendType" SG_ 962 FourDRadarObjSts40DistX 0;
BA_ "GenSigStartValue" SG_ 962 FourDRadarObjSts40DistX 32768;
BA_ "GenSigSendType" SG_ 962 FourDRadarObjSts40DistXStd 0;
BA_ "GenSigSendType" SG_ 962 FourDRadarObjSts40DistY 0;
BA_ "GenSigStartValue" SG_ 962 FourDRadarObjSts40DistY 4096;
BA_ "GenSigSendType" SG_ 962 FourDRadarObjSts40DistYStd 0;
BA_ "GenSigSendType" SG_ 962 FourDRadarObjSts40DistZ 0;
BA_ "GenSigStartValue" SG_ 962 FourDRadarObjSts40DistZ 4096;
BA_ "GenSigSendType" SG_ 962 FourDRadarObjSts40DistZStd 0;
BA_ "GenSigSendType" SG_ 962 FourDRadarObjSts40DynamicProperty 0;
BA_ "GenSigSendType" SG_ 962 FourDRadarObjSts40HeadingAngle 0;
BA_ "GenSigStartValue" SG_ 962 FourDRadarObjSts40HeadingAngle 2047.78157;
BA_ "GenSigSendType" SG_ 962 FourDRadarObjSts40ID 0;
BA_ "GenSigSendType" SG_ 962 FourDRadarObjSts40LifeCycles 0;
BA_ "GenSigSendType" SG_ 962 FourDRadarObjSts40ObjBoundingBoxHeight 0;
BA_ "GenSigSendType" SG_ 962 FourDRadarObjSts40ObjBoundingBoxLength 0;
BA_ "GenSigSendType" SG_ 962 FourDRadarObjSts40ObjBoundingBoxWidth 0;
BA_ "GenSigSendType" SG_ 962 FourDRadarObjSts40ObjNearestPtX 0;
BA_ "GenSigStartValue" SG_ 962 FourDRadarObjSts40ObjNearestPtX 32768;
BA_ "GenSigSendType" SG_ 962 FourDRadarObjSts40ObjNearestPtY 0;
BA_ "GenSigStartValue" SG_ 962 FourDRadarObjSts40ObjNearestPtY 4096;
BA_ "GenSigSendType" SG_ 962 FourDRadarObjSts40ObjNearestPtZ 0;
BA_ "GenSigStartValue" SG_ 962 FourDRadarObjSts40ObjNearestPtZ 4096;
BA_ "GenSigSendType" SG_ 962 FourDRadarObjSts40ObjSNR 0;
BA_ "GenSigSendType" SG_ 962 FourDRadarObjSts40ObjXAccRel 0;
BA_ "GenSigStartValue" SG_ 962 FourDRadarObjSts40ObjXAccRel 356;
BA_ "GenSigSendType" SG_ 962 FourDRadarObjSts40ObjYAccRel 0;
BA_ "GenSigStartValue" SG_ 962 FourDRadarObjSts40ObjYAccRel 356;
BA_ "GenSigSendType" SG_ 962 FourDRadarObjSts40ObstacleProbability 0;
BA_ "GenSigSendType" SG_ 962 FourDRadarObjSts40ProbabilityOfExistence 0;
BA_ "GenSigSendType" SG_ 962 FourDRadarObjSts40RCS 0;
BA_ "GenSigStartValue" SG_ 962 FourDRadarObjSts40RCS 1000;
BA_ "GenSigSendType" SG_ 962 FourDRadarObjSts40TargetClassificationConfidence 0;
BA_ "GenSigSendType" SG_ 962 FourDRadarObjSts40UpdateFlag 0;
BA_ "GenSigSendType" SG_ 962 FourDRadarObjSts40VabsX 0;
BA_ "GenSigStartValue" SG_ 962 FourDRadarObjSts40VabsX 1024;
BA_ "GenSigSendType" SG_ 962 FourDRadarObjSts40VabsXStd 0;
BA_ "GenSigSendType" SG_ 962 FourDRadarObjSts40VabsY 0;
BA_ "GenSigStartValue" SG_ 962 FourDRadarObjSts40VabsY 1024;
BA_ "GenSigSendType" SG_ 962 FourDRadarObjSts40VabsYStd 0;
BA_ "GenSigSendType" SG_ 962 FourDRadarObjSts40ValidFlag 0;
BA_ "GenSigDataID" SG_ 965 FourDRadarObjSts42Chks "0xE2C";
BA_ "GenSigFuncType" SG_ 965 FourDRadarObjSts42Chks 15;
BA_ "GenSigSendType" SG_ 965 FourDRadarObjSts42Chks 0;
BA_ "GenSigSendType" SG_ 965 FourDRadarObjSts42Classification 0;
BA_ "GenSigFuncType" SG_ 965 FourDRadarObjSts42Cntr 16;
BA_ "GenSigSendType" SG_ 965 FourDRadarObjSts42Cntr 0;
BA_ "GenSigSendType" SG_ 965 FourDRadarObjSts42DistX 0;
BA_ "GenSigStartValue" SG_ 965 FourDRadarObjSts42DistX 32768;
BA_ "GenSigSendType" SG_ 965 FourDRadarObjSts42DistXStd 0;
BA_ "GenSigSendType" SG_ 965 FourDRadarObjSts42DistY 0;
BA_ "GenSigStartValue" SG_ 965 FourDRadarObjSts42DistY 4096;
BA_ "GenSigSendType" SG_ 965 FourDRadarObjSts42DistYStd 0;
BA_ "GenSigSendType" SG_ 965 FourDRadarObjSts42DistZ 0;
BA_ "GenSigStartValue" SG_ 965 FourDRadarObjSts42DistZ 4096;
BA_ "GenSigSendType" SG_ 965 FourDRadarObjSts42DistZStd 0;
BA_ "GenSigSendType" SG_ 965 FourDRadarObjSts42DynamicProperty 0;
BA_ "GenSigSendType" SG_ 965 FourDRadarObjSts42HeadingAngle 0;
BA_ "GenSigStartValue" SG_ 965 FourDRadarObjSts42HeadingAngle 2047.78157;
BA_ "GenSigSendType" SG_ 965 FourDRadarObjSts42ID 0;
BA_ "GenSigSendType" SG_ 965 FourDRadarObjSts42LifeCycles 0;
BA_ "GenSigSendType" SG_ 965 FourDRadarObjSts42ObjBoundingBoxHeight 0;
BA_ "GenSigSendType" SG_ 965 FourDRadarObjSts42ObjBoundingBoxLength 0;
BA_ "GenSigSendType" SG_ 965 FourDRadarObjSts42ObjBoundingBoxWidth 0;
BA_ "GenSigSendType" SG_ 965 FourDRadarObjSts42ObjNearestPtX 0;
BA_ "GenSigStartValue" SG_ 965 FourDRadarObjSts42ObjNearestPtX 32768;
BA_ "GenSigSendType" SG_ 965 FourDRadarObjSts42ObjNearestPtY 0;
BA_ "GenSigStartValue" SG_ 965 FourDRadarObjSts42ObjNearestPtY 4096;
BA_ "GenSigSendType" SG_ 965 FourDRadarObjSts42ObjNearestPtZ 0;
BA_ "GenSigStartValue" SG_ 965 FourDRadarObjSts42ObjNearestPtZ 4096;
BA_ "GenSigSendType" SG_ 965 FourDRadarObjSts42ObjSNR 0;
BA_ "GenSigSendType" SG_ 965 FourDRadarObjSts42ObjXAccRel 0;
BA_ "GenSigStartValue" SG_ 965 FourDRadarObjSts42ObjXAccRel 356;
BA_ "GenSigSendType" SG_ 965 FourDRadarObjSts42ObjYAccRel 0;
BA_ "GenSigStartValue" SG_ 965 FourDRadarObjSts42ObjYAccRel 356;
BA_ "GenSigSendType" SG_ 965 FourDRadarObjSts42ObstacleProbability 0;
BA_ "GenSigSendType" SG_ 965 FourDRadarObjSts42ProbabilityOfExistence 0;
BA_ "GenSigSendType" SG_ 965 FourDRadarObjSts42RCS 0;
BA_ "GenSigStartValue" SG_ 965 FourDRadarObjSts42RCS 1000;
BA_ "GenSigSendType" SG_ 965 FourDRadarObjSts42TargetClassificationConfidence 0;
BA_ "GenSigSendType" SG_ 965 FourDRadarObjSts42UpdateFlag 0;
BA_ "GenSigSendType" SG_ 965 FourDRadarObjSts42VabsX 0;
BA_ "GenSigStartValue" SG_ 965 FourDRadarObjSts42VabsX 1024;
BA_ "GenSigSendType" SG_ 965 FourDRadarObjSts42VabsXStd 0;
BA_ "GenSigSendType" SG_ 965 FourDRadarObjSts42VabsY 0;
BA_ "GenSigStartValue" SG_ 965 FourDRadarObjSts42VabsY 1024;
BA_ "GenSigSendType" SG_ 965 FourDRadarObjSts42VabsYStd 0;
BA_ "GenSigSendType" SG_ 965 FourDRadarObjSts42ValidFlag 0;
BA_ "GenSigSendType" SG_ 853 FrntRdrMdlPrmRdrMountPit 0;
BA_ "GenSigStartValue" SG_ 853 FrntRdrMdlPrmRdrMountPit 9000;
BA_ "GenSigSendType" SG_ 853 FrntRdrMdlPrmRdrMountPosnInDirX 0;
BA_ "GenSigSendType" SG_ 853 FrntRdrMdlPrmRdrMountPosnInDirY 0;
BA_ "GenSigSendType" SG_ 853 FrntRdrMdlPrmRdrMountPosnInDirZ 0;
BA_ "GenSigSendType" SG_ 853 FrntRdrMdlPrmRdrMountRoll 0;
BA_ "GenSigStartValue" SG_ 853 FrntRdrMdlPrmRdrMountRoll 9000;
BA_ "GenSigSendType" SG_ 853 FrntRdrMdlPrmRdrMountYaw 0;
BA_ "GenSigStartValue" SG_ 853 FrntRdrMdlPrmRdrMountYaw 9000;
BA_ "GenSigSendType" SG_ 853 FrntRdrMdlPrmVehBas 0;
BA_ "GenSigSendType" SG_ 853 FrntRdrMdlPrmVehFrntPosnInDirX 0;
BA_ "GenSigSendType" SG_ 853 FrntRdrMdlPrmVehLen 0;
BA_ "GenSigSendType" SG_ 853 FrntRdrMdlPrmVehType 0;
BA_ "GenSigSendType" SG_ 853 FrntRdrMdlPrmVehWidth 0;
BA_ "GenSigSendType" SG_ 880 FrontFourDRadarStsForDim 0;
BA_ "GenSigSendType" SG_ 880 FrontFourDRadarStsRdrNrDetn 0;
BA_ "GenSigSendType" SG_ 880 FrontFourDRadarStsRdrNrObj 0;
BA_ "GenSigSendType" SG_ 880 FrontFourDRadarStsRdrStsBlkd0bin 0;
BA_ "GenSigSendType" SG_ 880 FrontFourDRadarStsRdrStsBlkdConf 0;
BA_ "GenSigDataID" SG_ 880 FrontFourDRadarStsRdrStsChks "0xE02";
BA_ "GenSigFuncType" SG_ 880 FrontFourDRadarStsRdrStsChks 15;
BA_ "GenSigSendType" SG_ 880 FrontFourDRadarStsRdrStsChks 0;
BA_ "GenSigFuncType" SG_ 880 FrontFourDRadarStsRdrStsCntr 16;
BA_ "GenSigSendType" SG_ 880 FrontFourDRadarStsRdrStsCntr 0;
BA_ "GenSigSendType" SG_ 880 FrontFourDRadarStsRdrStsDstbc 0;
BA_ "GenSigSendType" SG_ 880 FrontFourDRadarStsRdrStsEna 0;
BA_ "GenSigSendType" SG_ 880 FrontFourDRadarStsRdrStsFaulty 0;
BA_ "GenSigSendType" SG_ 880 FrontFourDRadarStsRdrStsIfVersMajor 0;
BA_ "GenSigSendType" SG_ 880 FrontFourDRadarStsRdrStsIfVersMinor 0;
BA_ "GenSigSendType" SG_ 880 FrontFourDRadarStsRdrStsLatency 0;
BA_ "GenSigSendType" SG_ 880 FrontFourDRadarStsRdrStsMisAlign 0;
BA_ "GenSigSendType" SG_ 880 FrontFourDRadarStsRdrStsMissCom 0;
BA_ "GenSigSendType" SG_ 880 FrontFourDRadarStsRdrStsSftyFlt 0;
BA_ "GenSigSendType" SG_ 880 FrontFourDRadarStsRdrStsTiStampH 0;
BA_ "GenSigSendType" SG_ 880 FrontFourDRadarStsRdrStsTiStampL 0;
BA_ "GenSigSendType" SG_ 880 FrontFourDRadarStsRdrStsTiStampStsGlbTiBas 0;
BA_ "GenSigSendType" SG_ 880 FrontFourDRadarStsRdrStsTiStampStsSyncToGatewy 0;
BA_ "GenSigSendType" SG_ 880 FrontFourDRadarStsRdrStsTiStampStsTiLeap 0;
BA_ "GenSigSendType" SG_ 880 FrontFourDRadarStsRdrStsTiStampStsTiOut 0;
BA_ "GenSigSendType" SG_ 880 FrontFourDRadarStsRdrStsWhlSpdCmpFac 0;
BA_ "GenSigStartValue" SG_ 880 FrontFourDRadarStsRdrStsWhlSpdCmpFac 16;
BA_ "GenSigDataID" SG_ 880 FrontFourDRadarVDYChks "0xE01";
BA_ "GenSigFuncType" SG_ 880 FrontFourDRadarVDYChks 15;
BA_ "GenSigSendType" SG_ 880 FrontFourDRadarVDYChks 0;
BA_ "GenSigFuncType" SG_ 880 FrontFourDRadarVDYCntr 16;
BA_ "GenSigSendType" SG_ 880 FrontFourDRadarVDYCntr 0;
BA_ "GenSigSendType" SG_ 880 FrontFourDRadarVDYVelocity 0;
BA_ "GenSigStartValue" SG_ 880 FrontFourDRadarVDYVelocity 800;
BA_ "GenSigSendType" SG_ 880 FrontFourDRadarVDYYawRate 0;
BA_ "GenSigStartValue" SG_ 880 FrontFourDRadarVDYYawRate 200000;
BA_ "GenSigSendType" SG_ 880 FrontFourDRadarVDYuiTimeStamp 0;
BA_ "GenSigSendType" SG_ 994 FrtFourDRadarAligStsRdrLearntSts 0;
BA_ "GenSigSendType" SG_ 994 FrtFourDRadarAligStsRdrStsAligPit 0;
BA_ "GenSigStartValue" SG_ 994 FrtFourDRadarAligStsRdrStsAligPit 9000;
BA_ "GenSigSendType" SG_ 994 FrtFourDRadarAligStsRdrStsAligYaw 0;
BA_ "GenSigStartValue" SG_ 994 FrtFourDRadarAligStsRdrStsAligYaw 9000;
BA_ "GenSigSendType" SG_ 994 FrtFourDRadarAligStsRdrStsSN 0;
BA_ "GenSigSendType" SG_ 848 GearLvrIndcn 0;
BA_ "GenSigStartValue" SG_ 848 GearLvrIndcn 7;
BA_ "GenSigSendType" SG_ 405 LvlgDirMovmtIndcr 0;
BA_ "GenSigStartValue" SG_ 405 LvlgDirMovmtIndcr 1;
BA_ "GenSigDataID" SG_ 288 PinionSteerAgGroupChks "0x40D";
BA_ "GenSigFuncType" SG_ 288 PinionSteerAgGroupChks 15;
BA_ "GenSigSendType" SG_ 288 PinionSteerAgGroupChks 0;
BA_ "GenSigFuncType" SG_ 288 PinionSteerAgGroupCntr 16;
BA_ "GenSigSendType" SG_ 288 PinionSteerAgGroupCntr 0;
BA_ "GenSigSendType" SG_ 288 PinionSteerAgGroupPinionSteerAg1 0;
BA_ "GenSigSendType" SG_ 288 PinionSteerAgGroupPinionSteerAg1Qf 0;
BA_ "GenSigStartValue" SG_ 288 PinionSteerAgGroupPinionSteerAg1Qf 1;
BA_ "GenSigSendType" SG_ 288 PinionSteerAgGroupPinionSteerAgSpd1 0;
BA_ "GenSigSendType" SG_ 288 PinionSteerAgGroupPinionSteerAgSpd1Qf 0;
BA_ "GenSigStartValue" SG_ 288 PinionSteerAgGroupPinionSteerAgSpd1Qf 1;
BA_ "GenSigSendType" SG_ 288 PinionSteerAgGroupSteerWhlTq 0;
BA_ "GenSigSendType" SG_ 288 PinionSteerAgGroupSteerWhlTqQf 0;
BA_ "GenSigStartValue" SG_ 288 PinionSteerAgGroupSteerWhlTqQf 1;
BA_ "GenSigSendType" SG_ 18 RainfallAmnt 0;
BA_ "GenSigStartValue" SG_ 18 RainfallAmnt 14;
BA_ "GenSigSendType" SG_ 848 StandStillMgrStsForHld1 0;
BA_ "GenSigDataID" SG_ 848 StandStillMgrStsForHldChks "0x448";
BA_ "GenSigFuncType" SG_ 848 StandStillMgrStsForHldChks 15;
BA_ "GenSigSendType" SG_ 848 StandStillMgrStsForHldChks 0;
BA_ "GenSigFuncType" SG_ 848 StandStillMgrStsForHldCntr 16;
BA_ "GenSigSendType" SG_ 848 StandStillMgrStsForHldCntr 0;
BA_ "GenSigSendType" SG_ 288 SteerWhlSnsrAg 0;
BA_ "GenSigSendType" SG_ 288 SteerWhlSnsrAgSpd 0;
BA_ "GenSigDataID" SG_ 288 SteerWhlSnsrChks "0x33";
BA_ "GenSigFuncType" SG_ 288 SteerWhlSnsrChks 15;
BA_ "GenSigSendType" SG_ 288 SteerWhlSnsrChks 0;
BA_ "GenSigFuncType" SG_ 288 SteerWhlSnsrCntr 16;
BA_ "GenSigSendType" SG_ 288 SteerWhlSnsrCntr 0;
BA_ "GenSigSendType" SG_ 288 SteerWhlSnsrQf 0;
BA_ "GenSigStartValue" SG_ 288 SteerWhlSnsrQf 1;
BA_ "GenSigSendType" SG_ 288 SuspHeiLvlIndcn 0;
BA_ "GenSigSendType" SG_ 1007 SuspPosnVertLe1Chks 0;
BA_ "GenSigSendType" SG_ 1007 SuspPosnVertLe1Frnt 0;
BA_ "GenSigSendType" SG_ 1007 SuspPosnVertLe1FrntQf 0;
BA_ "GenSigStartValue" SG_ 1007 SuspPosnVertLe1FrntQf 1;
BA_ "GenSigSendType" SG_ 1007 SuspPosnVertLe1Re 0;
BA_ "GenSigSendType" SG_ 1007 SuspPosnVertLe1ReQf 0;
BA_ "GenSigStartValue" SG_ 1007 SuspPosnVertLe1ReQf 1;
BA_ "GenSigSendType" SG_ 1007 SuspPosnVertRi1SuspPosnVertRiChks 0;
BA_ "GenSigSendType" SG_ 1007 SuspPosnVertRi1SuspPosnVertRiFrnt 0;
BA_ "GenSigSendType" SG_ 1007 SuspPosnVertRi1SuspPosnVertRiFrntQf 0;
BA_ "GenSigStartValue" SG_ 1007 SuspPosnVertRi1SuspPosnVertRiFrntQf 1;
BA_ "GenSigSendType" SG_ 1007 SuspPosnVertRi1SuspPosnVertRiRe 0;
BA_ "GenSigSendType" SG_ 1007 SuspPosnVertRi1SuspPosnVertRiReQf 0;
BA_ "GenSigStartValue" SG_ 1007 SuspPosnVertRi1SuspPosnVertRiReQf 1;
BA_ "GenSigSendType" SG_ 1007 SuspSetgLvlCtrlSetg 0;
BA_ "GenSigSendType" SG_ 1007 SuspSetgSuspIdPen 0;
BA_ "GenSigSendType" SG_ 18 TiAndDateIndcnDataValid 0;
BA_ "GenSigSendType" SG_ 18 TiAndDateIndcnDay 0;
BA_ "GenSigStartValue" SG_ 18 TiAndDateIndcnDay 1;
BA_ "GenSigSendType" SG_ 18 TiAndDateIndcnHr1 0;
BA_ "GenSigSendType" SG_ 18 TiAndDateIndcnMins1 0;
BA_ "GenSigSendType" SG_ 18 TiAndDateIndcnMth1 0;
BA_ "GenSigStartValue" SG_ 18 TiAndDateIndcnMth1 1;
BA_ "GenSigSendType" SG_ 18 TiAndDateIndcnSec1 0;
BA_ "GenSigSendType" SG_ 18 TiAndDateIndcnYr1 0;
BA_ "GenSigSendType" SG_ 288 VehBattUSysU 0;
BA_ "GenSigSendType" SG_ 288 VehBattUSysUQf 0;
BA_ "GenSigStartValue" SG_ 288 VehBattUSysUQf 1;
BA_ "GenSigSendType" SG_ 837 VehCfgPrmExtBlkIDBytePosn1 1;
BA_ "GenSigSendType" SG_ 837 VehCfgPrmExtCCPBytePosn2 1;
BA_ "GenSigSendType" SG_ 837 VehCfgPrmExtCCPBytePosn3 1;
BA_ "GenSigSendType" SG_ 837 VehCfgPrmExtCCPBytePosn4 1;
BA_ "GenSigSendType" SG_ 837 VehCfgPrmExtCCPBytePosn5 1;
BA_ "GenSigSendType" SG_ 837 VehCfgPrmExtCCPBytePosn6 1;
BA_ "GenSigSendType" SG_ 837 VehCfgPrmExtCCPBytePosn7 1;
BA_ "GenSigSendType" SG_ 837 VehCfgPrmExtCCPBytePosn8 1;
BA_ "GenSigSendType" SG_ 288 VehModMngtGlbSafe1CarModSts1 0;
BA_ "GenSigSendType" SG_ 288 VehModMngtGlbSafe1CarModSubtypWdCarModSubtyp 0;
BA_ "GenSigDataID" SG_ 288 VehModMngtGlbSafe1Chks "0x74";
BA_ "GenSigFuncType" SG_ 288 VehModMngtGlbSafe1Chks 15;
BA_ "GenSigSendType" SG_ 288 VehModMngtGlbSafe1Chks 0;
BA_ "GenSigFuncType" SG_ 288 VehModMngtGlbSafe1Cntr 16;
BA_ "GenSigSendType" SG_ 288 VehModMngtGlbSafe1Cntr 0;
BA_ "GenSigSendType" SG_ 288 VehModMngtGlbSafe1EgyLvlElecMai 0;
BA_ "GenSigSendType" SG_ 288 VehModMngtGlbSafe1EgyLvlElecSubtyp 0;
BA_ "GenSigSendType" SG_ 288 VehModMngtGlbSafe1FltEgyCnsWdSts 0;
BA_ "GenSigSendType" SG_ 288 VehModMngtGlbSafe1PwrLvlElecMai 0;
BA_ "GenSigSendType" SG_ 288 VehModMngtGlbSafe1PwrLvlElecSubtyp 0;
BA_ "GenSigSendType" SG_ 288 VehModMngtGlbSafe1UsgModSts 0;
BA_ "GenSigStartValue" SG_ 288 VehModMngtGlbSafe1UsgModSts 1;
BA_ "GenSigDataID" SG_ 288 VehMtnStChks "0x36";
BA_ "GenSigFuncType" SG_ 288 VehMtnStChks 15;
BA_ "GenSigSendType" SG_ 288 VehMtnStChks 0;
BA_ "GenSigFuncType" SG_ 288 VehMtnStCntr 16;
BA_ "GenSigSendType" SG_ 288 VehMtnStCntr 0;
BA_ "GenSigSendType" SG_ 288 VehMtnStVehMtnSt 0;
BA_ "GenSigSendType" SG_ 288 VehSpdLgtA 0;
BA_ "GenSigDataID" SG_ 288 VehSpdLgtChks "0x37";
BA_ "GenSigFuncType" SG_ 288 VehSpdLgtChks 15;
BA_ "GenSigSendType" SG_ 288 VehSpdLgtChks 0;
BA_ "GenSigFuncType" SG_ 288 VehSpdLgtCntr 16;
BA_ "GenSigSendType" SG_ 288 VehSpdLgtCntr 0;
BA_ "GenSigSendType" SG_ 288 VehSpdLgtQf 0;
BA_ "GenSigStartValue" SG_ 288 VehSpdLgtQf 1;
BA_ "GenSigSendType" SG_ 848 VehTiAndDataDataValid 0;
BA_ "GenSigSendType" SG_ 848 VehTiAndDataDay 0;
BA_ "GenSigStartValue" SG_ 848 VehTiAndDataDay 1;
BA_ "GenSigSendType" SG_ 848 VehTiAndDataHr1 0;
BA_ "GenSigSendType" SG_ 848 VehTiAndDataMins1 0;
BA_ "GenSigSendType" SG_ 848 VehTiAndDataMth1 0;
BA_ "GenSigStartValue" SG_ 848 VehTiAndDataMth1 1;
BA_ "GenSigSendType" SG_ 848 VehTiAndDataSec1 0;
BA_ "GenSigSendType" SG_ 848 VehTiAndDataYr1 0;
BA_ "GenSigDataID" SG_ 848 WhlDirRotlFrntChks "0x228";
BA_ "GenSigFuncType" SG_ 848 WhlDirRotlFrntChks 15;
BA_ "GenSigSendType" SG_ 848 WhlDirRotlFrntChks 0;
BA_ "GenSigFuncType" SG_ 848 WhlDirRotlFrntCntr 16;
BA_ "GenSigSendType" SG_ 848 WhlDirRotlFrntCntr 0;
BA_ "GenSigSendType" SG_ 16 WhlDirRotlFrntForBkpChks 0;
BA_ "GenSigSendType" SG_ 16 WhlDirRotlFrntForBkpCntr 0;
BA_ "GenSigSendType" SG_ 16 WhlDirRotlFrntForBkpLe 0;
BA_ "GenSigSendType" SG_ 16 WhlDirRotlFrntForBkpRi 0;
BA_ "GenSigSendType" SG_ 848 WhlDirRotlFrntLe 0;
BA_ "GenSigSendType" SG_ 848 WhlDirRotlFrntRi 0;
BA_ "GenSigDataID" SG_ 848 WhlDirRotlReChks "0x227";
BA_ "GenSigFuncType" SG_ 848 WhlDirRotlReChks 15;
BA_ "GenSigSendType" SG_ 848 WhlDirRotlReChks 0;
BA_ "GenSigFuncType" SG_ 848 WhlDirRotlReCntr 16;
BA_ "GenSigSendType" SG_ 848 WhlDirRotlReCntr 0;
BA_ "GenSigSendType" SG_ 16 WhlDirRotlReForBkpChks 0;
BA_ "GenSigSendType" SG_ 16 WhlDirRotlReForBkpCntr 0;
BA_ "GenSigSendType" SG_ 16 WhlDirRotlReForBkpLe 0;
BA_ "GenSigSendType" SG_ 16 WhlDirRotlReForBkpRi 0;
BA_ "GenSigSendType" SG_ 848 WhlDirRotlReLe 0;
BA_ "GenSigSendType" SG_ 848 WhlDirRotlReRi 0;
BA_ "GenSigDataID" SG_ 848 WhlSpdCircumlFrntChks "0x6F";
BA_ "GenSigFuncType" SG_ 848 WhlSpdCircumlFrntChks 15;
BA_ "GenSigSendType" SG_ 848 WhlSpdCircumlFrntChks 0;
BA_ "GenSigFuncType" SG_ 848 WhlSpdCircumlFrntCntr 16;
BA_ "GenSigSendType" SG_ 848 WhlSpdCircumlFrntCntr 0;
BA_ "GenSigSendType" SG_ 16 WhlSpdCircumlFrntForBkpWhlSpdCircumlFrntChks 0;
BA_ "GenSigSendType" SG_ 16 WhlSpdCircumlFrntForBkpWhlSpdCircumlFrntCntr 0;
BA_ "GenSigSendType" SG_ 16 WhlSpdCircumlFrntForBkpWhlSpdCircumlFrntLe 0;
BA_ "GenSigSendType" SG_ 16 WhlSpdCircumlFrntForBkpWhlSpdCircumlFrntLeQf 0;
BA_ "GenSigSendType" SG_ 16 WhlSpdCircumlFrntForBkpWhlSpdCircumlFrntRiQf 0;
BA_ "GenSigSendType" SG_ 16 WhlSpdCircumlFrntForBkpWhlSpdCircumlFrntWhlSpdCircumlFrntRi 0;
BA_ "GenSigSendType" SG_ 848 WhlSpdCircumlFrntLe 0;
BA_ "GenSigSendType" SG_ 848 WhlSpdCircumlFrntLeQf 0;
BA_ "GenSigStartValue" SG_ 848 WhlSpdCircumlFrntLeQf 1;
BA_ "GenSigSendType" SG_ 848 WhlSpdCircumlFrntRiQf 0;
BA_ "GenSigStartValue" SG_ 848 WhlSpdCircumlFrntRiQf 1;
BA_ "GenSigSendType" SG_ 848 WhlSpdCircumlFrntWhlSpdCircumlFrntRi 0;
BA_ "GenSigDataID" SG_ 848 WhlSpdCircumlReChks "0x7C";
BA_ "GenSigFuncType" SG_ 848 WhlSpdCircumlReChks 15;
BA_ "GenSigSendType" SG_ 848 WhlSpdCircumlReChks 0;
BA_ "GenSigFuncType" SG_ 848 WhlSpdCircumlReCntr 16;
BA_ "GenSigSendType" SG_ 848 WhlSpdCircumlReCntr 0;
BA_ "GenSigSendType" SG_ 16 WhlSpdCircumlReForBkpWhlSpdCircumlReChks 0;
BA_ "GenSigSendType" SG_ 16 WhlSpdCircumlReForBkpWhlSpdCircumlReCntr 0;
BA_ "GenSigSendType" SG_ 16 WhlSpdCircumlReForBkpWhlSpdCircumlReLe 0;
BA_ "GenSigSendType" SG_ 16 WhlSpdCircumlReForBkpWhlSpdCircumlReLeQf 0;
BA_ "GenSigSendType" SG_ 16 WhlSpdCircumlReForBkpWhlSpdCircumlReRi 0;
BA_ "GenSigSendType" SG_ 16 WhlSpdCircumlReForBkpWhlSpdCircumlReRiQf 0;
BA_ "GenSigSendType" SG_ 848 WhlSpdCircumlReLe 0;
BA_ "GenSigSendType" SG_ 848 WhlSpdCircumlReLeQf 0;
BA_ "GenSigStartValue" SG_ 848 WhlSpdCircumlReLeQf 1;
BA_ "GenSigSendType" SG_ 848 WhlSpdCircumlReRi 0;
BA_ "GenSigSendType" SG_ 848 WhlSpdCircumlReRiQf 0;
BA_ "GenSigStartValue" SG_ 848 WhlSpdCircumlReRiQf 1;
BA_ "GenSigSendType" SG_ 288 WipgInfoWipgSpdInfo 0;
BA_ "GenSigSendType" SG_ 288 WipgInfoWiprActv 0;
BA_ "GenSigSendType" SG_ 288 WipgInfoWiprInWipgAr 0;

VAL_ 101 AgDataRawSafeRollRateQf 0 "Qf1_DevOfDataUndefd" 1 "Qf1_DataTmpUndefdAndEvlnInProgs" 2 "Qf1_DevOfDataNotWithinRngAllwd" 3 "Qf1_DataCalcdWithDevDefd";
VAL_ 101 AgDataRawSafeYawRateQf 0 "Qf1_DevOfDataUndefd" 1 "Qf1_DataTmpUndefdAndEvlnInProgs" 2 "Qf1_DevOfDataNotWithinRngAllwd" 3 "Qf1_DataCalcdWithDevDefd";
VAL_ 848 AbsCtrlActvCtrlSts1 0 "CtrlSts1_NoCtrl" 1 "CtrlSts1_InCtrl";
VAL_ 848 AsySftyEnaDecelAckd 0 "OnOff1_Off" 1 "OnOff1_On";
VAL_ 848 BrkSysCylPMstActQf 0 "GenQf1_UndefindDataAccur" 1 "GenQf1_TmpUndefdData" 2 "GenQf1_DataAccurNotWithinSpcn" 3 "GenQf1_AccurData";
VAL_ 848 BrkSysCylPMstVirtQf 0 "GenQf1_UndefindDataAccur" 1 "GenQf1_TmpUndefdData" 2 "GenQf1_DataAccurNotWithinSpcn" 3 "GenQf1_AccurData";
VAL_ 848 EpbStsEpbSts 0 "EpbSts_Resd0" 1 "EpbSts_Resd1" 2 "EpbSts_Resd2" 3 "EpbSts_AllAppld" 4 "EpbSts_Resd4" 5 "EpbSts_AllInTran" 6 "EpbSts_BrkgDynByActr" 7 "EpbSts_Resd7" 8 "EpbSts_Resd8" 9 "EpbSts_ActrAllReld" 10 "EpbSts_BrkgDynDegraded" 11 "EpbSts_Resd11" 12 "EpbSts_BrkgDyn" 13 "EpbSts_Resd13" 14 "EpbSts_Resd14" 15 "EpbSts_Err";
VAL_ 848 EscCtrlIndcn 0 "DevSts1_On" 1 "DevSts1_Off" 2 "DevSts1_Flt";
VAL_ 848 EscStEscSt 0 "EscSt1_Inin" 1 "EscSt1_Ok" 2 "EscSt1_TmpErr" 3 "EscSt1_PrmntErr" 4 "EscSt1_UsrOff";
VAL_ 848 GearLvrIndcn 0 "GearLvrIndcn2_ParkIndcn" 1 "GearLvrIndcn2_RvsIndcn" 2 "GearLvrIndcn2_NeutIndcn" 3 "GearLvrIndcn2_DrvIndcn" 4 "GearLvrIndcn2_ManModeIndcn" 5 "GearLvrIndcn2_Resd1" 6 "GearLvrIndcn2_Resd2" 7 "GearLvrIndcn2_Undefd";
VAL_ 848 StandStillMgrStsForHld1 0 "StandStillMgrStsForHld1_StandStillMgrStsForHldVal0" 1 "StandStillMgrStsForHld1_StandStillMgrStsForHldVal1" 2 "StandStillMgrStsForHld1_StandStillMgrStsForHldVal2" 3 "StandStillMgrStsForHld1_StandStillMgrStsForHldVal3" 4 "StandStillMgrStsForHld1_StandStillMgrStsForHldVal4" 5 "StandStillMgrStsForHld1_StandStillMgrStsForHldVal5" 6 "StandStillMgrStsForHld1_StandStillMgrStsForHldVal6" 7 "StandStillMgrStsForHld1_StandStillMgrStsForHldVal7";
VAL_ 848 VehTiAndDataDataValid 0 "NoYes1_No" 1 "NoYes1_Yes";
VAL_ 848 WhlDirRotlFrntLe 0 "WhlRotlDirStd1_Undefd" 1 "WhlRotlDirStd1_StandStill" 2 "WhlRotlDirStd1_Fwd" 3 "WhlRotlDirStd1_Backw";
VAL_ 848 WhlDirRotlFrntRi 0 "WhlRotlDirStd1_Undefd" 1 "WhlRotlDirStd1_StandStill" 2 "WhlRotlDirStd1_Fwd" 3 "WhlRotlDirStd1_Backw";
VAL_ 848 WhlDirRotlReLe 0 "WhlRotlDirStd1_Undefd" 1 "WhlRotlDirStd1_StandStill" 2 "WhlRotlDirStd1_Fwd" 3 "WhlRotlDirStd1_Backw";
VAL_ 848 WhlDirRotlReRi 0 "WhlRotlDirStd1_Undefd" 1 "WhlRotlDirStd1_StandStill" 2 "WhlRotlDirStd1_Fwd" 3 "WhlRotlDirStd1_Backw";
VAL_ 848 WhlSpdCircumlFrntLeQf 0 "GenQf1_UndefindDataAccur" 1 "GenQf1_TmpUndefdData" 2 "GenQf1_DataAccurNotWithinSpcn" 3 "GenQf1_AccurData";
VAL_ 848 WhlSpdCircumlFrntRiQf 0 "GenQf1_UndefindDataAccur" 1 "GenQf1_TmpUndefdData" 2 "GenQf1_DataAccurNotWithinSpcn" 3 "GenQf1_AccurData";
VAL_ 848 WhlSpdCircumlReLeQf 0 "GenQf1_UndefindDataAccur" 1 "GenQf1_TmpUndefdData" 2 "GenQf1_DataAccurNotWithinSpcn" 3 "GenQf1_AccurData";
VAL_ 848 WhlSpdCircumlReRiQf 0 "GenQf1_UndefindDataAccur" 1 "GenQf1_TmpUndefdData" 2 "GenQf1_DataAccurNotWithinSpcn" 3 "GenQf1_AccurData";
VAL_ 405 BrkTracCtrlActv 0 "CtrlSts1_NoCtrl" 1 "CtrlSts1_InCtrl";
VAL_ 405 ExtrLtgStsAFS 0 "DevSts4_Off" 1 "DevSts4_On" 2 "DevSts4_Err" 3 "DevSts4_Resd";
VAL_ 405 ExtrLtgStsAHBC 0 "DevSts4_Off" 1 "DevSts4_On" 2 "DevSts4_Err" 3 "DevSts4_Resd";
VAL_ 405 ExtrLtgStsAHL 0 "DevSts4_Off" 1 "DevSts4_On" 2 "DevSts4_Err" 3 "DevSts4_Resd";
VAL_ 405 ExtrLtgStsAllWL 0 "DevSts4_Off" 1 "DevSts4_On" 2 "DevSts4_Err" 3 "DevSts4_Resd";
VAL_ 405 ExtrLtgStsApproach 0 "DevSts4_Off" 1 "DevSts4_On" 2 "DevSts4_Err" 3 "DevSts4_Resd";
VAL_ 405 ExtrLtgStsCornrgLi 0 "DevSts4_Off" 1 "DevSts4_On" 2 "DevSts4_Err" 3 "DevSts4_Resd";
VAL_ 405 ExtrLtgStsDBL 0 "DevSts4_Off" 1 "DevSts4_On" 2 "DevSts4_Err" 3 "DevSts4_Resd";
VAL_ 405 ExtrLtgStsDRL 0 "DevSts4_Off" 1 "DevSts4_On" 2 "DevSts4_Err" 3 "DevSts4_Resd";
VAL_ 405 ExtrLtgStsFlash 0 "DevSts4_Off" 1 "DevSts4_On" 2 "DevSts4_Err" 3 "DevSts4_Resd";
VAL_ 405 ExtrLtgStsFrntFog 0 "DevSts4_Off" 1 "DevSts4_On" 2 "DevSts4_Err" 3 "DevSts4_Resd";
VAL_ 405 ExtrLtgStsGoodbye 0 "DevSts4_Off" 1 "DevSts4_On" 2 "DevSts4_Err" 3 "DevSts4_Resd";
VAL_ 405 ExtrLtgStsHiBeam 0 "DevSts4_Off" 1 "DevSts4_On" 2 "DevSts4_Err" 3 "DevSts4_Resd";
VAL_ 405 ExtrLtgStsHomeSafe 0 "DevSts4_Off" 1 "DevSts4_On" 2 "DevSts4_Err" 3 "DevSts4_Resd";
VAL_ 405 ExtrLtgStsHWL 0 "DevSts4_Off" 1 "DevSts4_On" 2 "DevSts4_Err" 3 "DevSts4_Resd";
VAL_ 405 ExtrLtgStsLoBeam 0 "DevSts4_Off" 1 "DevSts4_On" 2 "DevSts4_Err" 3 "DevSts4_Resd";
VAL_ 405 ExtrLtgStsLtgShow 0 "DevSts4_Off" 1 "DevSts4_On" 2 "DevSts4_Err" 3 "DevSts4_Resd";
VAL_ 405 ExtrLtgStsPosLiFrnt 0 "DevSts4_Off" 1 "DevSts4_On" 2 "DevSts4_Err" 3 "DevSts4_Resd";
VAL_ 405 ExtrLtgStsPosLiRe 0 "DevSts4_Off" 1 "DevSts4_On" 2 "DevSts4_Err" 3 "DevSts4_Resd";
VAL_ 405 ExtrLtgStsReFog 0 "DevSts4_Off" 1 "DevSts4_On" 2 "DevSts4_Err" 3 "DevSts4_Resd";
VAL_ 405 ExtrLtgStsReverseLi 0 "DevSts4_Off" 1 "DevSts4_On" 2 "DevSts4_Err" 3 "DevSts4_Resd";
VAL_ 405 ExtrLtgStsStopLi 0 "DevSts4_Off" 1 "DevSts4_On" 2 "DevSts4_Err" 3 "DevSts4_Resd";
VAL_ 405 ExtrLtgStsTurnIndrLe 0 "DevSts4_Off" 1 "DevSts4_On" 2 "DevSts4_Err" 3 "DevSts4_Resd";
VAL_ 405 ExtrLtgStsTurnIndrRi 0 "DevSts4_Off" 1 "DevSts4_On" 2 "DevSts4_Err" 3 "DevSts4_Resd";
VAL_ 405 ExtrLtgStsWelcome 0 "DevSts4_Off" 1 "DevSts4_On" 2 "DevSts4_Err" 3 "DevSts4_Resd";
VAL_ 405 LvlgDirMovmtIndcr 0 "TriSt1_NegSt" 1 "TriSt1_StabSt" 2 "TriSt1_PosSt" 3 "TriSt1_NotUsed";
VAL_ 853 AD4HDMapRoadTyp 0 "HDMapRoadTyp_NotAvailable" 1 "HDMapRoadTyp_City" 2 "HDMapRoadTyp_Highway" 3 "HDMapRoadTyp_Elevated" 4 "HDMapRoadTyp_Ramp" 5 "HDMapRoadTyp_Tunnel" 6 "HDMapRoadTyp_Reserve1" 7 "HDMapRoadTyp_Reserve2";
VAL_ 853 AgDataRaw2SafePitchRateQf 0 "Qf1_DevOfDataUndefd" 1 "Qf1_DataTmpUndefdAndEvlnInProgs" 2 "Qf1_DevOfDataNotWithinRngAllwd" 3 "Qf1_DataCalcdWithDevDefd";
VAL_ 18 RainfallAmnt 0 "AmntSnsr_Amnt" 14 "AmntSnsr_InitValue" 15 "AmntSnsr_Error";
VAL_ 18 TiAndDateIndcnDataValid 0 "NoYes1_No" 1 "NoYes1_Yes";
VAL_ 288 ADataRawSafeALat1Qf 0 "Qf1_DevOfDataUndefd" 1 "Qf1_DataTmpUndefdAndEvlnInProgs" 2 "Qf1_DevOfDataNotWithinRngAllwd" 3 "Qf1_DataCalcdWithDevDefd";
VAL_ 288 ADataRawSafeALgt1Qf 0 "Qf1_DevOfDataUndefd" 1 "Qf1_DataTmpUndefdAndEvlnInProgs" 2 "Qf1_DevOfDataNotWithinRngAllwd" 3 "Qf1_DataCalcdWithDevDefd";
VAL_ 288 ADataRawSafeAVertQf 0 "Qf1_DevOfDataUndefd" 1 "Qf1_DataTmpUndefdAndEvlnInProgs" 2 "Qf1_DevOfDataNotWithinRngAllwd" 3 "Qf1_DataCalcdWithDevDefd";
VAL_ 288 ALgtStdFromWhlSpdQf 0 "GenQf1_UndefindDataAccur" 1 "GenQf1_TmpUndefdData" 2 "GenQf1_DataAccurNotWithinSpcn" 3 "GenQf1_AccurData";
VAL_ 288 AmbTRawQly 0 "GenQf1_UndefindDataAccur" 1 "GenQf1_TmpUndefdData" 2 "GenQf1_DataAccurNotWithinSpcn" 3 "GenQf1_AccurData";
VAL_ 288 AsyDataWithCmpSafeALat1Qf 0 "Qf1_DevOfDataUndefd" 1 "Qf1_DataTmpUndefdAndEvlnInProgs" 2 "Qf1_DevOfDataNotWithinRngAllwd" 3 "Qf1_DataCalcdWithDevDefd";
VAL_ 288 AsyDataWithCmpSafeALgt1Qf 0 "Qf1_DevOfDataUndefd" 1 "Qf1_DataTmpUndefdAndEvlnInProgs" 2 "Qf1_DevOfDataNotWithinRngAllwd" 3 "Qf1_DataCalcdWithDevDefd";
VAL_ 288 AsyDataWithCmpSafeYawRateQf 0 "Qf1_DevOfDataUndefd" 1 "Qf1_DataTmpUndefdAndEvlnInProgs" 2 "Qf1_DevOfDataNotWithinRngAllwd" 3 "Qf1_DataCalcdWithDevDefd";
VAL_ 288 DrvModReq 0 "DrvModReqType1_Undefd" 1 "DrvModReqType1_ECO" 2 "DrvModReqType1_Comfort_Normal" 3 "DrvModReqType1_Dynamic_Sport" 4 "DrvModReqType1_Individual" 5 "DrvModReqType1_Offroad_CrossTerrain" 6 "DrvModReqType1_Adaptive" 7 "DrvModReqType1_Race" 8 "DrvModReqType1_Pure_EV" 9 "DrvModReqType1_Hybrid" 10 "DrvModReqType1_Power" 11 "DrvModReqType1_Snow" 12 "DrvModReqType1_Sand" 13 "DrvModReqType1_Mud" 14 "DrvModReqType1_Rock" 15 "DrvModReqType1_Err";
VAL_ 288 PinionSteerAgGroupPinionSteerAg1Qf 0 "GenQf1_UndefindDataAccur" 1 "GenQf1_TmpUndefdData" 2 "GenQf1_DataAccurNotWithinSpcn" 3 "GenQf1_AccurData";
VAL_ 288 PinionSteerAgGroupPinionSteerAgSpd1Qf 0 "GenQf1_UndefindDataAccur" 1 "GenQf1_TmpUndefdData" 2 "GenQf1_DataAccurNotWithinSpcn" 3 "GenQf1_AccurData";
VAL_ 288 PinionSteerAgGroupSteerWhlTqQf 0 "GenQf1_UndefindDataAccur" 1 "GenQf1_TmpUndefdData" 2 "GenQf1_DataAccurNotWithinSpcn" 3 "GenQf1_AccurData";
VAL_ 288 SteerWhlSnsrQf 0 "GenQf1_UndefindDataAccur" 1 "GenQf1_TmpUndefdData" 2 "GenQf1_DataAccurNotWithinSpcn" 3 "GenQf1_AccurData";
VAL_ 288 SuspHeiLvlIndcn 0 "SuspHeiLvlCtrl_NRH" 1 "SuspHeiLvlCtrl_HL2" 2 "SuspHeiLvlCtrl_HL1" 3 "SuspHeiLvlCtrl_LL1" 4 "SuspHeiLvlCtrl_LL2";
VAL_ 288 VehBattUSysUQf 0 "GenQf1_UndefindDataAccur" 1 "GenQf1_TmpUndefdData" 2 "GenQf1_DataAccurNotWithinSpcn" 3 "GenQf1_AccurData";
VAL_ 288 VehModMngtGlbSafe1CarModSts1 0 "CarModSts1_CarModNorm" 1 "CarModSts1_CarModTrnsp" 2 "CarModSts1_CarModFcy" 3 "CarModSts1_CarModCrash" 5 "CarModSts1_CarModDyno";
VAL_ 288 VehModMngtGlbSafe1FltEgyCnsWdSts 0 "FltEgyCns1_NoFlt" 1 "FltEgyCns1_Flt";
VAL_ 288 VehModMngtGlbSafe1UsgModSts 0 "UsgModSts1_UsgModAbdnd" 1 "UsgModSts1_UsgModInActv" 2 "UsgModSts1_UsgModCnvinc" 11 "UsgModSts1_UsgModActv" 13 "UsgModSts1_UsgModDrvg";
VAL_ 288 VehMtnStVehMtnSt 0 "VehMtnSt2_Ukwn" 1 "VehMtnSt2_StandStillVal1" 2 "VehMtnSt2_StandStillVal2" 3 "VehMtnSt2_StandStillVal3" 4 "VehMtnSt2_RollgFwdVal1" 5 "VehMtnSt2_RollgFwdVal2" 6 "VehMtnSt2_RollgBackwVal1" 7 "VehMtnSt2_RollgBackwVal2";
VAL_ 288 VehSpdLgtQf 0 "GenQf1_UndefindDataAccur" 1 "GenQf1_TmpUndefdData" 2 "GenQf1_DataAccurNotWithinSpcn" 3 "GenQf1_AccurData";
VAL_ 288 WipgInfoWipgSpdInfo 0 "WipgSpdInfo_Off" 1 "WipgSpdInfo_IntlLo" 2 "WipgSpdInfo_IntlHi" 3 "WipgSpdInfo_WipgSpd4045" 4 "WipgSpdInfo_WipgSpd4650" 5 "WipgSpdInfo_WipgSpd5155" 6 "WipgSpdInfo_WipgSpd5660" 7 "WipgSpdInfo_WiprErr";
VAL_ 288 WipgInfoWiprActv 0 "OnOff1_Off" 1 "OnOff1_On";
VAL_ 288 WipgInfoWiprInWipgAr 0 "OnOff1_Off" 1 "OnOff1_On";
VAL_ 1007 SuspPosnVertLe1FrntQf 0 "GenQf1_UndefindDataAccur" 1 "GenQf1_TmpUndefdData" 2 "GenQf1_DataAccurNotWithinSpcn" 3 "GenQf1_AccurData";
VAL_ 1007 SuspPosnVertLe1ReQf 0 "GenQf1_UndefindDataAccur" 1 "GenQf1_TmpUndefdData" 2 "GenQf1_DataAccurNotWithinSpcn" 3 "GenQf1_AccurData";
VAL_ 1007 SuspPosnVertRi1SuspPosnVertRiFrntQf 0 "GenQf1_UndefindDataAccur" 1 "GenQf1_TmpUndefdData" 2 "GenQf1_DataAccurNotWithinSpcn" 3 "GenQf1_AccurData";
VAL_ 1007 SuspPosnVertRi1SuspPosnVertRiReQf 0 "GenQf1_UndefindDataAccur" 1 "GenQf1_TmpUndefdData" 2 "GenQf1_DataAccurNotWithinSpcn" 3 "GenQf1_AccurData";
VAL_ 1007 SuspSetgLvlCtrlSetg 0 "LvlCtrlSetgTyp_Cmft" 1 "LvlCtrlSetgTyp_Norm" 2 "LvlCtrlSetgTyp_Dyn" 3 "LvlCtrlSetgTyp_XC";
VAL_ 1007 SuspSetgSuspIdPen 0 "IdPen_ProfUkwn" 1 "IdPen_Prof1" 2 "IdPen_Prof2" 3 "IdPen_Prof3" 4 "IdPen_Prof4" 5 "IdPen_Prof5" 6 "IdPen_Prof6" 7 "IdPen_Prof7" 8 "IdPen_Prof8" 9 "IdPen_Prof9" 10 "IdPen_Prof10" 11 "IdPen_Prof11" 12 "IdPen_Prof12" 13 "IdPen_Prof13" 14 "IdPen_Resd14" 15 "IdPen_ProfAll";
VAL_ 16 BrkPedlTrvlQf 0 "GenQf1_UndefindDataAccur" 1 "GenQf1_TmpUndefdData" 2 "GenQf1_DataAccurNotWithinSpcn" 3 "GenQf1_AccurData";
VAL_ 16 BrkPedlTrvlSt 0 "PsdNotPsd_NotPsd" 1 "PsdNotPsd_Psd";
VAL_ 16 BrkPedlTrvlStQf 0 "GenQf1_UndefindDataAccur" 1 "GenQf1_TmpUndefdData" 2 "GenQf1_DataAccurNotWithinSpcn" 3 "GenQf1_AccurData";
VAL_ 16 WhlDirRotlFrntForBkpLe 0 "WhlRotlDirStd1_Undefd" 1 "WhlRotlDirStd1_StandStill" 2 "WhlRotlDirStd1_Fwd" 3 "WhlRotlDirStd1_Backw";
VAL_ 16 WhlDirRotlFrntForBkpRi 0 "WhlRotlDirStd1_Undefd" 1 "WhlRotlDirStd1_StandStill" 2 "WhlRotlDirStd1_Fwd" 3 "WhlRotlDirStd1_Backw";
VAL_ 16 WhlDirRotlReForBkpLe 0 "WhlRotlDirStd1_Undefd" 1 "WhlRotlDirStd1_StandStill" 2 "WhlRotlDirStd1_Fwd" 3 "WhlRotlDirStd1_Backw";
VAL_ 16 WhlDirRotlReForBkpRi 0 "WhlRotlDirStd1_Undefd" 1 "WhlRotlDirStd1_StandStill" 2 "WhlRotlDirStd1_Fwd" 3 "WhlRotlDirStd1_Backw";
VAL_ 16 WhlSpdCircumlFrntForBkpWhlSpdCircumlFrntLeQf 0 "GenQf1_UndefindDataAccur" 1 "GenQf1_TmpUndefdData" 2 "GenQf1_DataAccurNotWithinSpcn" 3 "GenQf1_AccurData";
VAL_ 16 WhlSpdCircumlFrntForBkpWhlSpdCircumlFrntRiQf 0 "GenQf1_UndefindDataAccur" 1 "GenQf1_TmpUndefdData" 2 "GenQf1_DataAccurNotWithinSpcn" 3 "GenQf1_AccurData";
VAL_ 16 WhlSpdCircumlReForBkpWhlSpdCircumlReLeQf 0 "GenQf1_UndefindDataAccur" 1 "GenQf1_TmpUndefdData" 2 "GenQf1_DataAccurNotWithinSpcn" 3 "GenQf1_AccurData";
VAL_ 16 WhlSpdCircumlReForBkpWhlSpdCircumlReRiQf 0 "GenQf1_UndefindDataAccur" 1 "GenQf1_TmpUndefdData" 2 "GenQf1_DataAccurNotWithinSpcn" 3 "GenQf1_AccurData";
VAL_ 955 FourDRadarObjSts28Classification 0 "EClassification_Point" 1 "EClassification_Car" 2 "EClassification_Truck" 3 "EClassification_Pedestrian" 4 "EClassification_Motorcycle" 5 "EClassification_Bicycle" 6 "EClassification_Wide" 7 "EClassification_Reserved1" 8 "EClassification_Reserved2" 9 "EClassification_Reserved3" 10 "EClassification_Unclassified" 11 "EClassification_Reserved4" 12 "EClassification_Reserved5" 13 "EClassification_Reserved6" 14 "EClassification_Reserved7" 15 "EClassification_Reserved8";
VAL_ 955 FourDRadarObjSts28DynamicProperty 0 "EDynamicProperty_Moving" 1 "EDynamicProperty_Stationary" 2 "EDynamicProperty_Oncoming" 3 "EDynamicProperty_CrossingLeftToRight" 4 "EDynamicProperty_CrossingRightToLeft" 5 "EDynamicProperty_Unknown" 6 "EDynamicProperty_Stopped" 7 "EDynamicProperty_Reserved1";
VAL_ 955 FourDRadarObjSts28UpdateFlag 0 "Boolean_FALSE" 1 "Boolean_TRUE";
VAL_ 955 FourDRadarObjSts28ValidFlag 0 "Validity_NotValid" 1 "Validity_Valid";
VAL_ 956 FourDRadarObjSts30Classification 0 "EClassification_Point" 1 "EClassification_Car" 2 "EClassification_Truck" 3 "EClassification_Pedestrian" 4 "EClassification_Motorcycle" 5 "EClassification_Bicycle" 6 "EClassification_Wide" 7 "EClassification_Reserved1" 8 "EClassification_Reserved2" 9 "EClassification_Reserved3" 10 "EClassification_Unclassified" 11 "EClassification_Reserved4" 12 "EClassification_Reserved5" 13 "EClassification_Reserved6" 14 "EClassification_Reserved7" 15 "EClassification_Reserved8";
VAL_ 956 FourDRadarObjSts30DynamicProperty 0 "EDynamicProperty_Moving" 1 "EDynamicProperty_Stationary" 2 "EDynamicProperty_Oncoming" 3 "EDynamicProperty_CrossingLeftToRight" 4 "EDynamicProperty_CrossingRightToLeft" 5 "EDynamicProperty_Unknown" 6 "EDynamicProperty_Stopped" 7 "EDynamicProperty_Reserved1";
VAL_ 956 FourDRadarObjSts30UpdateFlag 0 "Boolean_FALSE" 1 "Boolean_TRUE";
VAL_ 956 FourDRadarObjSts30ValidFlag 0 "Validity_NotValid" 1 "Validity_Valid";
VAL_ 994 FrtFourDRadarAligStsRdrLearntSts 0 "UpdatedSts_NoUpdated" 1 "UpdatedSts_Updated";
VAL_ 957 FourDRadarObjSts32Classification 0 "EClassification_Point" 1 "EClassification_Car" 2 "EClassification_Truck" 3 "EClassification_Pedestrian" 4 "EClassification_Motorcycle" 5 "EClassification_Bicycle" 6 "EClassification_Wide" 7 "EClassification_Reserved1" 8 "EClassification_Reserved2" 9 "EClassification_Reserved3" 10 "EClassification_Unclassified" 11 "EClassification_Reserved4" 12 "EClassification_Reserved5" 13 "EClassification_Reserved6" 14 "EClassification_Reserved7" 15 "EClassification_Reserved8";
VAL_ 957 FourDRadarObjSts32DynamicProperty 0 "EDynamicProperty_Moving" 1 "EDynamicProperty_Stationary" 2 "EDynamicProperty_Oncoming" 3 "EDynamicProperty_CrossingLeftToRight" 4 "EDynamicProperty_CrossingRightToLeft" 5 "EDynamicProperty_Unknown" 6 "EDynamicProperty_Stopped" 7 "EDynamicProperty_Reserved1";
VAL_ 957 FourDRadarObjSts32UpdateFlag 0 "Boolean_FALSE" 1 "Boolean_TRUE";
VAL_ 957 FourDRadarObjSts32ValidFlag 0 "Validity_NotValid" 1 "Validity_Valid";
VAL_ 958 FourDRadarObjSts34Classification 0 "EClassification_Point" 1 "EClassification_Car" 2 "EClassification_Truck" 3 "EClassification_Pedestrian" 4 "EClassification_Motorcycle" 5 "EClassification_Bicycle" 6 "EClassification_Wide" 7 "EClassification_Reserved1" 8 "EClassification_Reserved2" 9 "EClassification_Reserved3" 10 "EClassification_Unclassified" 11 "EClassification_Reserved4" 12 "EClassification_Reserved5" 13 "EClassification_Reserved6" 14 "EClassification_Reserved7" 15 "EClassification_Reserved8";
VAL_ 958 FourDRadarObjSts34DynamicProperty 0 "EDynamicProperty_Moving" 1 "EDynamicProperty_Stationary" 2 "EDynamicProperty_Oncoming" 3 "EDynamicProperty_CrossingLeftToRight" 4 "EDynamicProperty_CrossingRightToLeft" 5 "EDynamicProperty_Unknown" 6 "EDynamicProperty_Stopped" 7 "EDynamicProperty_Reserved1";
VAL_ 958 FourDRadarObjSts34UpdateFlag 0 "Boolean_FALSE" 1 "Boolean_TRUE";
VAL_ 958 FourDRadarObjSts34ValidFlag 0 "Validity_NotValid" 1 "Validity_Valid";
VAL_ 959 FourDRadarObjSts36Classification 0 "EClassification_Point" 1 "EClassification_Car" 2 "EClassification_Truck" 3 "EClassification_Pedestrian" 4 "EClassification_Motorcycle" 5 "EClassification_Bicycle" 6 "EClassification_Wide" 7 "EClassification_Reserved1" 8 "EClassification_Reserved2" 9 "EClassification_Reserved3" 10 "EClassification_Unclassified" 11 "EClassification_Reserved4" 12 "EClassification_Reserved5" 13 "EClassification_Reserved6" 14 "EClassification_Reserved7" 15 "EClassification_Reserved8";
VAL_ 959 FourDRadarObjSts36DynamicProperty 0 "EDynamicProperty_Moving" 1 "EDynamicProperty_Stationary" 2 "EDynamicProperty_Oncoming" 3 "EDynamicProperty_CrossingLeftToRight" 4 "EDynamicProperty_CrossingRightToLeft" 5 "EDynamicProperty_Unknown" 6 "EDynamicProperty_Stopped" 7 "EDynamicProperty_Reserved1";
VAL_ 959 FourDRadarObjSts36UpdateFlag 0 "Boolean_FALSE" 1 "Boolean_TRUE";
VAL_ 959 FourDRadarObjSts36ValidFlag 0 "Validity_NotValid" 1 "Validity_Valid";
VAL_ 961 FourDRadarObjSts38Classification 0 "EClassification_Point" 1 "EClassification_Car" 2 "EClassification_Truck" 3 "EClassification_Pedestrian" 4 "EClassification_Motorcycle" 5 "EClassification_Bicycle" 6 "EClassification_Wide" 7 "EClassification_Reserved1" 8 "EClassification_Reserved2" 9 "EClassification_Reserved3" 10 "EClassification_Unclassified" 11 "EClassification_Reserved4" 12 "EClassification_Reserved5" 13 "EClassification_Reserved6" 14 "EClassification_Reserved7" 15 "EClassification_Reserved8";
VAL_ 961 FourDRadarObjSts38DynamicProperty 0 "EDynamicProperty_Moving" 1 "EDynamicProperty_Stationary" 2 "EDynamicProperty_Oncoming" 3 "EDynamicProperty_CrossingLeftToRight" 4 "EDynamicProperty_CrossingRightToLeft" 5 "EDynamicProperty_Unknown" 6 "EDynamicProperty_Stopped" 7 "EDynamicProperty_Reserved1";
VAL_ 961 FourDRadarObjSts38UpdateFlag 0 "Boolean_FALSE" 1 "Boolean_TRUE";
VAL_ 961 FourDRadarObjSts38ValidFlag 0 "Validity_NotValid" 1 "Validity_Valid";
VAL_ 962 FourDRadarObjSts40Classification 0 "EClassification_Point" 1 "EClassification_Car" 2 "EClassification_Truck" 3 "EClassification_Pedestrian" 4 "EClassification_Motorcycle" 5 "EClassification_Bicycle" 6 "EClassification_Wide" 7 "EClassification_Reserved1" 8 "EClassification_Reserved2" 9 "EClassification_Reserved3" 10 "EClassification_Unclassified" 11 "EClassification_Reserved4" 12 "EClassification_Reserved5" 13 "EClassification_Reserved6" 14 "EClassification_Reserved7" 15 "EClassification_Reserved8";
VAL_ 962 FourDRadarObjSts40DynamicProperty 0 "EDynamicProperty_Moving" 1 "EDynamicProperty_Stationary" 2 "EDynamicProperty_Oncoming" 3 "EDynamicProperty_CrossingLeftToRight" 4 "EDynamicProperty_CrossingRightToLeft" 5 "EDynamicProperty_Unknown" 6 "EDynamicProperty_Stopped" 7 "EDynamicProperty_Reserved1";
VAL_ 962 FourDRadarObjSts40UpdateFlag 0 "Boolean_FALSE" 1 "Boolean_TRUE";
VAL_ 962 FourDRadarObjSts40ValidFlag 0 "Validity_NotValid" 1 "Validity_Valid";
VAL_ 965 FourDRadarObjSts42Classification 0 "EClassification_Point" 1 "EClassification_Car" 2 "EClassification_Truck" 3 "EClassification_Pedestrian" 4 "EClassification_Motorcycle" 5 "EClassification_Bicycle" 6 "EClassification_Wide" 7 "EClassification_Reserved1" 8 "EClassification_Reserved2" 9 "EClassification_Reserved3" 10 "EClassification_Unclassified" 11 "EClassification_Reserved4" 12 "EClassification_Reserved5" 13 "EClassification_Reserved6" 14 "EClassification_Reserved7" 15 "EClassification_Reserved8";
VAL_ 965 FourDRadarObjSts42DynamicProperty 0 "EDynamicProperty_Moving" 1 "EDynamicProperty_Stationary" 2 "EDynamicProperty_Oncoming" 3 "EDynamicProperty_CrossingLeftToRight" 4 "EDynamicProperty_CrossingRightToLeft" 5 "EDynamicProperty_Unknown" 6 "EDynamicProperty_Stopped" 7 "EDynamicProperty_Reserved1";
VAL_ 965 FourDRadarObjSts42UpdateFlag 0 "Boolean_FALSE" 1 "Boolean_TRUE";
VAL_ 965 FourDRadarObjSts42ValidFlag 0 "Validity_NotValid" 1 "Validity_Valid";
VAL_ 880 FourDRadarECUStsCalibrationSts 0 "CalibSts_Unknown" 1 "CalibSts_Calibrated" 2 "CalibSts_SensorMisalignmentDetected" 3 "CalibSts_CalibrationInProgress" 4 "CalibSts_Reserved1" 5 "CalibSts_Reserved2" 6 "CalibSts_Reserved3" 7 "CalibSts_Reserved4";
VAL_ 880 FourDRadarECUStsECUFailureE2E 0 "FailrNoFailr1_NoFailr" 1 "FailrNoFailr1_Failr";
VAL_ 880 FourDRadarECUStsECUFailureNVM 0 "FailrNoFailr1_NoFailr" 1 "FailrNoFailr1_Failr";
VAL_ 880 FourDRadarECUStsECUFailurePlausibility 0 "FailrNoFailr1_NoFailr" 1 "FailrNoFailr1_Failr";
VAL_ 880 FourDRadarECUStsECUFailureQF 0 "FailrNoFailr1_NoFailr" 1 "FailrNoFailr1_Failr";
VAL_ 880 FourDRadarECUStsECUFailureTemperature 0 "FailrNoFailr1_NoFailr" 1 "FailrNoFailr1_Failr";
VAL_ 880 FourDRadarECUStsECUFailureUB 0 "FailrNoFailr1_NoFailr" 1 "FailrNoFailr1_Failr";
VAL_ 880 FourDRadarECUStsECUFailureVCS 0 "FailrNoFailr1_NoFailr" 1 "FailrNoFailr1_Failr";
VAL_ 880 FourDRadarECUStsECUFailureVDY 0 "FailrNoFailr1_NoFailr" 1 "FailrNoFailr1_Failr";
VAL_ 880 FourDRadarECUStsECUFailureVoltage 0 "FailrNoFailr1_NoFailr" 1 "FailrNoFailr1_Failr";
VAL_ 880 FourDRadarECUStsOperationMode 0 "OperationMode_Reserved1" 1 "OperationMode_Init" 2 "OperationMode_Normal" 4 "OperationMode_Degraded" 8 "OperationMode_Blocked";
VAL_ 880 FrontFourDRadarStsForDim 0 "RsdsMstSt_Cfg" 1 "RsdsMstSt_StrtUp" 2 "RsdsMstSt_Runng" 3 "RsdsMstSt_Blkd" 4 "RsdsMstSt_Faulty" 5 "RsdsMstSt_Shutdown" 6 "RsdsMstSt_Hot" 7 "RsdsMstSt_Cal";
VAL_ 880 FrontFourDRadarStsRdrStsBlkd0bin 0 "YesNo2_No" 1 "YesNo2_Yes";
VAL_ 880 FrontFourDRadarStsRdrStsEna 0 "YesNo2_No" 1 "YesNo2_Yes";
VAL_ 880 FrontFourDRadarStsRdrStsFaulty 0 "YesNo2_No" 1 "YesNo2_Yes";
VAL_ 880 FrontFourDRadarStsRdrStsMisAlign 0 "MisAlign_CalibrationNotStart" 1 "MisAlign_SuccessfullyCalibratedInFactoryOrAftersales" 2 "MisAlign_SuccessfullyAutoCalibrated" 3 "MisAlign_MisalignmentDegreeIsLargerThanThreshold_StaticCalibrationFail" 4 "MisAlign_CanNotBeCalibratedStaticallyCauseOtherReason" 5 "MisAlign_AutoCalibrateFail_CauseMisalignmentDegreeIsLargerThanThresholdOrOtherReason" 6 "MisAlign_MisalignmentDegreeIsLargerThanThreshold_DynamicCalibrationFailInFactoryOrAftersales" 7 "MisAlign_CanNotBeCalibratedDynamicallyCauseOtherReason";
VAL_ 880 FrontFourDRadarStsRdrStsMissCom 0 "YesNo2_No" 1 "YesNo2_Yes";
VAL_ 880 FrontFourDRadarStsRdrStsSftyFlt 0 "SftyFlt_Undefined" 1 "SftyFlt_NoSafetyFault" 2 "SftyFlt_SafetyFault" 3 "SftyFlt_Reserved";
VAL_ 880 FrontFourDRadarStsRdrStsTiStampStsGlbTiBas 0 "YesNo2_No" 1 "YesNo2_Yes";
VAL_ 880 FrontFourDRadarStsRdrStsTiStampStsSyncToGatewy 0 "YesNo2_No" 1 "YesNo2_Yes";
VAL_ 880 FrontFourDRadarStsRdrStsTiStampStsTiLeap 0 "YesNo2_No" 1 "YesNo2_Yes";
VAL_ 880 FrontFourDRadarStsRdrStsTiStampStsTiOut 0 "YesNo2_No" 1 "YesNo2_Yes";
SIG_GROUP_ 848 AbsCtrlActv 1 : AbsCtrlActvChks AbsCtrlActvCntr AbsCtrlActvCtrlSts1;
SIG_GROUP_ 288 ADataRawSafe 1 : ADataRawSafeALat ADataRawSafeALat1Qf ADataRawSafeALgt ADataRawSafeALgt1Qf ADataRawSafeAVert ADataRawSafeAVertQf ADataRawSafeChks ADataRawSafeCntr;
SIG_GROUP_ 405 AgDataCmpQuality 1 : AgDataCmpQualityPitchRateCmpQuality AgDataCmpQualityRollRateCmpQuality AgDataCmpQualityYawRateCmpQuality;
SIG_GROUP_ 853 AgDataRaw2Safe 1 : AgDataRaw2SafeChks AgDataRaw2SafeCntr AgDataRaw2SafePitchRate AgDataRaw2SafePitchRateQf;
SIG_GROUP_ 101 AgDataRawSafe 1 : AgDataRawSafeChks AgDataRawSafeCntr AgDataRawSafeRollRate AgDataRawSafeRollRateQf AgDataRawSafeYawRate AgDataRawSafeYawRateQf;
SIG_GROUP_ 288 ALgtStdFromWhlSpd 1 : ALgtStdFromWhlSpdALgtStdFromWhlSpd ALgtStdFromWhlSpdChks ALgtStdFromWhlSpdCntr ALgtStdFromWhlSpdQf;
SIG_GROUP_ 288 AmbTRaw 1 : AmbTRawAmbTVal AmbTRawQly;
SIG_GROUP_ 288 AsyDataWithCmpSafe 1 : AsyDataWithCmpSafeALat1Qf AsyDataWithCmpSafeALatWithCmp AsyDataWithCmpSafeALgt1Qf AsyDataWithCmpSafeChks AsyDataWithCmpSafeCntr AsyDataWithCmpSafeGrdtOfALgt AsyDataWithCmpSafeYawRateQf AsyDataWithCmpSafeYawRateWithCmp;
SIG_GROUP_ 16 BrkPedlTrvl 1 : BrkPedlTrvlAct BrkPedlTrvlChks BrkPedlTrvlCntr BrkPedlTrvlQf BrkPedlTrvlSt BrkPedlTrvlStQf BrkPedlTrvlTar;
SIG_GROUP_ 848 BrkSysCylPMst 1 : BrkSysCylPMstAct BrkSysCylPMstActQf BrkSysCylPMstChks BrkSysCylPMstCntr BrkSysCylPMstTar BrkSysCylPMstVirt BrkSysCylPMstVirtQf;
SIG_GROUP_ 848 EpbSts 1 : EpbStsChks EpbStsCntr EpbStsEpbSts;
SIG_GROUP_ 848 EscSt 1 : EscStChks EscStCntr EscStEscSt;
SIG_GROUP_ 405 ExtrLtgSts 1 : ExtrLtgStsAFS ExtrLtgStsAHBC ExtrLtgStsAHL ExtrLtgStsAllWL ExtrLtgStsApproach ExtrLtgStsChks ExtrLtgStsCntr ExtrLtgStsCornrgLi ExtrLtgStsDBL ExtrLtgStsDRL ExtrLtgStsFlash ExtrLtgStsFrntFog ExtrLtgStsGoodbye ExtrLtgStsHiBeam ExtrLtgStsHomeSafe ExtrLtgStsHWL ExtrLtgStsLoBeam ExtrLtgStsLtgShow ExtrLtgStsPosLiFrnt ExtrLtgStsPosLiRe ExtrLtgStsReFog ExtrLtgStsReverseLi ExtrLtgStsStopLi ExtrLtgStsTurnIndrLe ExtrLtgStsTurnIndrRi ExtrLtgStsWelcome;
SIG_GROUP_ 880 FourDRadarECUSts 1 : FourDRadarECUStsCalibrationSts FourDRadarECUStsChks FourDRadarECUStsCntr FourDRadarECUStsECUFailureE2E FourDRadarECUStsECUFailureNVM FourDRadarECUStsECUFailurePlausibility FourDRadarECUStsECUFailureQF FourDRadarECUStsECUFailureTemperature FourDRadarECUStsECUFailureUB FourDRadarECUStsECUFailureVCS FourDRadarECUStsECUFailureVDY FourDRadarECUStsECUFailureVoltage FourDRadarECUStsOperationMode;
SIG_GROUP_ 955 FourDRadarObjSts28 1 : FourDRadarObjSts28Chks FourDRadarObjSts28Classification FourDRadarObjSts28Cntr FourDRadarObjSts28DistX FourDRadarObjSts28DistXStd FourDRadarObjSts28DistY FourDRadarObjSts28DistYStd FourDRadarObjSts28DistZ FourDRadarObjSts28DistZStd FourDRadarObjSts28DynamicProperty FourDRadarObjSts28HeadingAngle FourDRadarObjSts28ID FourDRadarObjSts28LifeCycles FourDRadarObjSts28ObjBoundingBoxHeight FourDRadarObjSts28ObjBoundingBoxLength FourDRadarObjSts28ObjBoundingBoxWidth FourDRadarObjSts28ObjNearestPtX FourDRadarObjSts28ObjNearestPtY FourDRadarObjSts28ObjNearestPtZ FourDRadarObjSts28ObjSNR FourDRadarObjSts28ObjXAccRel FourDRadarObjSts28ObjYAccRel FourDRadarObjSts28ObstacleProbability FourDRadarObjSts28ProbabilityOfExistence FourDRadarObjSts28RCS FourDRadarObjSts28TargetClassificationConfidence FourDRadarObjSts28UpdateFlag FourDRadarObjSts28VabsX FourDRadarObjSts28VabsXStd FourDRadarObjSts28VabsY FourDRadarObjSts28VabsYStd FourDRadarObjSts28ValidFlag;
SIG_GROUP_ 956 FourDRadarObjSts30 1 : FourDRadarObjSts30Chks FourDRadarObjSts30Classification FourDRadarObjSts30Cntr FourDRadarObjSts30DistX FourDRadarObjSts30DistXStd FourDRadarObjSts30DistY FourDRadarObjSts30DistYStd FourDRadarObjSts30DistZ FourDRadarObjSts30DistZStd FourDRadarObjSts30DynamicProperty FourDRadarObjSts30HeadingAngle FourDRadarObjSts30ID FourDRadarObjSts30LifeCycles FourDRadarObjSts30ObjBoundingBoxHeight FourDRadarObjSts30ObjBoundingBoxLength FourDRadarObjSts30ObjBoundingBoxWidth FourDRadarObjSts30ObjNearestPtX FourDRadarObjSts30ObjNearestPtY FourDRadarObjSts30ObjNearestPtZ FourDRadarObjSts30ObjSNR FourDRadarObjSts30ObjXAccRel FourDRadarObjSts30ObjYAccRel FourDRadarObjSts30ObstacleProbability FourDRadarObjSts30ProbabilityOfExistence FourDRadarObjSts30RCS FourDRadarObjSts30TargetClassificationConfidence FourDRadarObjSts30UpdateFlag FourDRadarObjSts30VabsX FourDRadarObjSts30VabsXStd FourDRadarObjSts30VabsY FourDRadarObjSts30VabsYStd FourDRadarObjSts30ValidFlag;
SIG_GROUP_ 957 FourDRadarObjSts32 1 : FourDRadarObjSts32Chks FourDRadarObjSts32Classification FourDRadarObjSts32Cntr FourDRadarObjSts32DistX FourDRadarObjSts32DistXStd FourDRadarObjSts32DistY FourDRadarObjSts32DistYStd FourDRadarObjSts32DistZ FourDRadarObjSts32DistZStd FourDRadarObjSts32DynamicProperty FourDRadarObjSts32HeadingAngle FourDRadarObjSts32ID FourDRadarObjSts32LifeCycles FourDRadarObjSts32ObjBoundingBoxHeight FourDRadarObjSts32ObjBoundingBoxLength FourDRadarObjSts32ObjBoundingBoxWidth FourDRadarObjSts32ObjNearestPtX FourDRadarObjSts32ObjNearestPtY FourDRadarObjSts32ObjNearestPtZ FourDRadarObjSts32ObjSNR FourDRadarObjSts32ObjXAccRel FourDRadarObjSts32ObjYAccRel FourDRadarObjSts32ObstacleProbability FourDRadarObjSts32ProbabilityOfExistence FourDRadarObjSts32RCS FourDRadarObjSts32TargetClassificationConfidence FourDRadarObjSts32UpdateFlag FourDRadarObjSts32VabsX FourDRadarObjSts32VabsXStd FourDRadarObjSts32VabsY FourDRadarObjSts32VabsYStd FourDRadarObjSts32ValidFlag;
SIG_GROUP_ 958 FourDRadarObjSts34 1 : FourDRadarObjSts34Chks FourDRadarObjSts34Classification FourDRadarObjSts34Cntr FourDRadarObjSts34DistX FourDRadarObjSts34DistXStd FourDRadarObjSts34DistY FourDRadarObjSts34DistYStd FourDRadarObjSts34DistZ FourDRadarObjSts34DistZStd FourDRadarObjSts34DynamicProperty FourDRadarObjSts34HeadingAngle FourDRadarObjSts34ID FourDRadarObjSts34LifeCycles FourDRadarObjSts34ObjBoundingBoxHeight FourDRadarObjSts34ObjBoundingBoxLength FourDRadarObjSts34ObjBoundingBoxWidth FourDRadarObjSts34ObjNearestPtX FourDRadarObjSts34ObjNearestPtY FourDRadarObjSts34ObjNearestPtZ FourDRadarObjSts34ObjSNR FourDRadarObjSts34ObjXAccRel FourDRadarObjSts34ObjYAccRel FourDRadarObjSts34ObstacleProbability FourDRadarObjSts34ProbabilityOfExistence FourDRadarObjSts34RCS FourDRadarObjSts34TargetClassificationConfidence FourDRadarObjSts34UpdateFlag FourDRadarObjSts34VabsX FourDRadarObjSts34VabsXStd FourDRadarObjSts34VabsY FourDRadarObjSts34VabsYStd FourDRadarObjSts34ValidFlag;
SIG_GROUP_ 959 FourDRadarObjSts36 1 : FourDRadarObjSts36Chks FourDRadarObjSts36Classification FourDRadarObjSts36Cntr FourDRadarObjSts36DistX FourDRadarObjSts36DistXStd FourDRadarObjSts36DistY FourDRadarObjSts36DistYStd FourDRadarObjSts36DistZ FourDRadarObjSts36DistZStd FourDRadarObjSts36DynamicProperty FourDRadarObjSts36HeadingAngle FourDRadarObjSts36ID FourDRadarObjSts36LifeCycles FourDRadarObjSts36ObjBoundingBoxHeight FourDRadarObjSts36ObjBoundingBoxLength FourDRadarObjSts36ObjBoundingBoxWidth FourDRadarObjSts36ObjNearestPtX FourDRadarObjSts36ObjNearestPtY FourDRadarObjSts36ObjNearestPtZ FourDRadarObjSts36ObjSNR FourDRadarObjSts36ObjXAccRel FourDRadarObjSts36ObjYAccRel FourDRadarObjSts36ObstacleProbability FourDRadarObjSts36ProbabilityOfExistence FourDRadarObjSts36RCS FourDRadarObjSts36TargetClassificationConfidence FourDRadarObjSts36UpdateFlag FourDRadarObjSts36VabsX FourDRadarObjSts36VabsXStd FourDRadarObjSts36VabsY FourDRadarObjSts36VabsYStd FourDRadarObjSts36ValidFlag;
SIG_GROUP_ 961 FourDRadarObjSts38 1 : FourDRadarObjSts38Chks FourDRadarObjSts38Classification FourDRadarObjSts38Cntr FourDRadarObjSts38DistX FourDRadarObjSts38DistXStd FourDRadarObjSts38DistY FourDRadarObjSts38DistYStd FourDRadarObjSts38DistZ FourDRadarObjSts38DistZStd FourDRadarObjSts38DynamicProperty FourDRadarObjSts38HeadingAngle FourDRadarObjSts38ID FourDRadarObjSts38LifeCycles FourDRadarObjSts38ObjBoundingBoxHeight FourDRadarObjSts38ObjBoundingBoxLength FourDRadarObjSts38ObjBoundingBoxWidth FourDRadarObjSts38ObjNearestPtX FourDRadarObjSts38ObjNearestPtY FourDRadarObjSts38ObjNearestPtZ FourDRadarObjSts38ObjSNR FourDRadarObjSts38ObjXAccRel FourDRadarObjSts38ObjYAccRel FourDRadarObjSts38ObstacleProbability FourDRadarObjSts38ProbabilityOfExistence FourDRadarObjSts38RCS FourDRadarObjSts38TargetClassificationConfidence FourDRadarObjSts38UpdateFlag FourDRadarObjSts38VabsX FourDRadarObjSts38VabsXStd FourDRadarObjSts38VabsY FourDRadarObjSts38VabsYStd FourDRadarObjSts38ValidFlag;
SIG_GROUP_ 962 FourDRadarObjSts40 1 : FourDRadarObjSts40Chks FourDRadarObjSts40Classification FourDRadarObjSts40Cntr FourDRadarObjSts40DistX FourDRadarObjSts40DistXStd FourDRadarObjSts40DistY FourDRadarObjSts40DistYStd FourDRadarObjSts40DistZ FourDRadarObjSts40DistZStd FourDRadarObjSts40DynamicProperty FourDRadarObjSts40HeadingAngle FourDRadarObjSts40ID FourDRadarObjSts40LifeCycles FourDRadarObjSts40ObjBoundingBoxHeight FourDRadarObjSts40ObjBoundingBoxLength FourDRadarObjSts40ObjBoundingBoxWidth FourDRadarObjSts40ObjNearestPtX FourDRadarObjSts40ObjNearestPtY FourDRadarObjSts40ObjNearestPtZ FourDRadarObjSts40ObjSNR FourDRadarObjSts40ObjXAccRel FourDRadarObjSts40ObjYAccRel FourDRadarObjSts40ObstacleProbability FourDRadarObjSts40ProbabilityOfExistence FourDRadarObjSts40RCS FourDRadarObjSts40TargetClassificationConfidence FourDRadarObjSts40UpdateFlag FourDRadarObjSts40VabsX FourDRadarObjSts40VabsXStd FourDRadarObjSts40VabsY FourDRadarObjSts40VabsYStd FourDRadarObjSts40ValidFlag;
SIG_GROUP_ 965 FourDRadarObjSts42 1 : FourDRadarObjSts42Chks FourDRadarObjSts42Classification FourDRadarObjSts42Cntr FourDRadarObjSts42DistX FourDRadarObjSts42DistXStd FourDRadarObjSts42DistY FourDRadarObjSts42DistYStd FourDRadarObjSts42DistZ FourDRadarObjSts42DistZStd FourDRadarObjSts42DynamicProperty FourDRadarObjSts42HeadingAngle FourDRadarObjSts42ID FourDRadarObjSts42LifeCycles FourDRadarObjSts42ObjBoundingBoxHeight FourDRadarObjSts42ObjBoundingBoxLength FourDRadarObjSts42ObjBoundingBoxWidth FourDRadarObjSts42ObjNearestPtX FourDRadarObjSts42ObjNearestPtY FourDRadarObjSts42ObjNearestPtZ FourDRadarObjSts42ObjSNR FourDRadarObjSts42ObjXAccRel FourDRadarObjSts42ObjYAccRel FourDRadarObjSts42ObstacleProbability FourDRadarObjSts42ProbabilityOfExistence FourDRadarObjSts42RCS FourDRadarObjSts42TargetClassificationConfidence FourDRadarObjSts42UpdateFlag FourDRadarObjSts42VabsX FourDRadarObjSts42VabsXStd FourDRadarObjSts42VabsY FourDRadarObjSts42VabsYStd FourDRadarObjSts42ValidFlag;
SIG_GROUP_ 853 FrntRdrMdlPrm 1 : FrntRdrMdlPrmRdrMountPit FrntRdrMdlPrmRdrMountPosnInDirX FrntRdrMdlPrmRdrMountPosnInDirY FrntRdrMdlPrmRdrMountPosnInDirZ FrntRdrMdlPrmRdrMountRoll FrntRdrMdlPrmRdrMountYaw FrntRdrMdlPrmVehBas FrntRdrMdlPrmVehFrntPosnInDirX FrntRdrMdlPrmVehLen FrntRdrMdlPrmVehType FrntRdrMdlPrmVehWidth;
SIG_GROUP_ 880 FrontFourDRadarSts 1 : FrontFourDRadarStsRdrNrDetn FrontFourDRadarStsRdrNrObj FrontFourDRadarStsRdrStsBlkd0bin FrontFourDRadarStsRdrStsBlkdConf FrontFourDRadarStsRdrStsChks FrontFourDRadarStsRdrStsCntr FrontFourDRadarStsRdrStsDstbc FrontFourDRadarStsRdrStsEna FrontFourDRadarStsRdrStsFaulty FrontFourDRadarStsRdrStsIfVersMajor FrontFourDRadarStsRdrStsIfVersMinor FrontFourDRadarStsRdrStsLatency FrontFourDRadarStsRdrStsMisAlign FrontFourDRadarStsRdrStsMissCom FrontFourDRadarStsRdrStsSftyFlt FrontFourDRadarStsRdrStsTiStampH FrontFourDRadarStsRdrStsTiStampL FrontFourDRadarStsRdrStsTiStampStsGlbTiBas FrontFourDRadarStsRdrStsTiStampStsSyncToGatewy FrontFourDRadarStsRdrStsTiStampStsTiLeap FrontFourDRadarStsRdrStsTiStampStsTiOut FrontFourDRadarStsRdrStsWhlSpdCmpFac;
SIG_GROUP_ 880 FrontFourDRadarVDY 1 : FrontFourDRadarVDYChks FrontFourDRadarVDYCntr FrontFourDRadarVDYuiTimeStamp FrontFourDRadarVDYVelocity FrontFourDRadarVDYYawRate;
SIG_GROUP_ 994 FrtFourDRadarAligSts 1 : FrtFourDRadarAligStsRdrLearntSts FrtFourDRadarAligStsRdrStsAligPit FrtFourDRadarAligStsRdrStsAligYaw FrtFourDRadarAligStsRdrStsSN;
SIG_GROUP_ 288 PinionSteerAgGroup 1 : PinionSteerAgGroupChks PinionSteerAgGroupCntr PinionSteerAgGroupPinionSteerAg1 PinionSteerAgGroupPinionSteerAg1Qf PinionSteerAgGroupPinionSteerAgSpd1 PinionSteerAgGroupPinionSteerAgSpd1Qf PinionSteerAgGroupSteerWhlTq PinionSteerAgGroupSteerWhlTqQf;
SIG_GROUP_ 848 StandStillMgrStsForHld 1 : StandStillMgrStsForHld1 StandStillMgrStsForHldChks StandStillMgrStsForHldCntr;
SIG_GROUP_ 288 SteerWhlSnsr 1 : SteerWhlSnsrAg SteerWhlSnsrAgSpd SteerWhlSnsrChks SteerWhlSnsrCntr SteerWhlSnsrQf;
SIG_GROUP_ 1007 SuspPosnVertLe1 1 : SuspPosnVertLe1Chks SuspPosnVertLe1Frnt SuspPosnVertLe1FrntQf SuspPosnVertLe1Re SuspPosnVertLe1ReQf;
SIG_GROUP_ 1007 SuspPosnVertRi1 1 : SuspPosnVertRi1SuspPosnVertRiChks SuspPosnVertRi1SuspPosnVertRiFrnt SuspPosnVertRi1SuspPosnVertRiFrntQf SuspPosnVertRi1SuspPosnVertRiRe SuspPosnVertRi1SuspPosnVertRiReQf;
SIG_GROUP_ 1007 SuspSetg 1 : SuspSetgLvlCtrlSetg SuspSetgSuspIdPen;
SIG_GROUP_ 18 TiAndDateIndcn 1 : TiAndDateIndcnDataValid TiAndDateIndcnDay TiAndDateIndcnHr1 TiAndDateIndcnMins1 TiAndDateIndcnMth1 TiAndDateIndcnSec1 TiAndDateIndcnYr1;
SIG_GROUP_ 288 VehBattU 1 : VehBattUSysU VehBattUSysUQf;
SIG_GROUP_ 837 VehCfgPrmExt 1 : VehCfgPrmExtBlkIDBytePosn1 VehCfgPrmExtCCPBytePosn2 VehCfgPrmExtCCPBytePosn3 VehCfgPrmExtCCPBytePosn4 VehCfgPrmExtCCPBytePosn5 VehCfgPrmExtCCPBytePosn6 VehCfgPrmExtCCPBytePosn7 VehCfgPrmExtCCPBytePosn8;
SIG_GROUP_ 288 VehModMngtGlbSafe1 1 : VehModMngtGlbSafe1CarModSts1 VehModMngtGlbSafe1CarModSubtypWdCarModSubtyp VehModMngtGlbSafe1Chks VehModMngtGlbSafe1Cntr VehModMngtGlbSafe1EgyLvlElecMai VehModMngtGlbSafe1EgyLvlElecSubtyp VehModMngtGlbSafe1FltEgyCnsWdSts VehModMngtGlbSafe1PwrLvlElecMai VehModMngtGlbSafe1PwrLvlElecSubtyp VehModMngtGlbSafe1UsgModSts;
SIG_GROUP_ 288 VehMtnSt 1 : VehMtnStChks VehMtnStCntr VehMtnStVehMtnSt;
SIG_GROUP_ 288 VehSpdLgt 1 : VehSpdLgtA VehSpdLgtChks VehSpdLgtCntr VehSpdLgtQf;
SIG_GROUP_ 848 VehTiAndData 1 : VehTiAndDataDataValid VehTiAndDataDay VehTiAndDataHr1 VehTiAndDataMins1 VehTiAndDataMth1 VehTiAndDataSec1 VehTiAndDataYr1;
SIG_GROUP_ 848 WhlDirRotlFrnt 1 : WhlDirRotlFrntChks WhlDirRotlFrntCntr WhlDirRotlFrntLe WhlDirRotlFrntRi;
SIG_GROUP_ 16 WhlDirRotlFrntForBkp 1 : WhlDirRotlFrntForBkpChks WhlDirRotlFrntForBkpCntr WhlDirRotlFrntForBkpLe WhlDirRotlFrntForBkpRi;
SIG_GROUP_ 848 WhlDirRotlRe 1 : WhlDirRotlReChks WhlDirRotlReCntr WhlDirRotlReLe WhlDirRotlReRi;
SIG_GROUP_ 16 WhlDirRotlReForBkp 1 : WhlDirRotlReForBkpChks WhlDirRotlReForBkpCntr WhlDirRotlReForBkpLe WhlDirRotlReForBkpRi;
SIG_GROUP_ 848 WhlSpdCircumlFrnt 1 : WhlSpdCircumlFrntChks WhlSpdCircumlFrntCntr WhlSpdCircumlFrntLe WhlSpdCircumlFrntLeQf WhlSpdCircumlFrntRiQf WhlSpdCircumlFrntWhlSpdCircumlFrntRi;
SIG_GROUP_ 16 WhlSpdCircumlFrntForBkp 1 : WhlSpdCircumlFrntForBkpWhlSpdCircumlFrntChks WhlSpdCircumlFrntForBkpWhlSpdCircumlFrntCntr WhlSpdCircumlFrntForBkpWhlSpdCircumlFrntLe WhlSpdCircumlFrntForBkpWhlSpdCircumlFrntLeQf WhlSpdCircumlFrntForBkpWhlSpdCircumlFrntRiQf WhlSpdCircumlFrntForBkpWhlSpdCircumlFrntWhlSpdCircumlFrntRi;
SIG_GROUP_ 848 WhlSpdCircumlRe 1 : WhlSpdCircumlReChks WhlSpdCircumlReCntr WhlSpdCircumlReLe WhlSpdCircumlReLeQf WhlSpdCircumlReRi WhlSpdCircumlReRiQf;
SIG_GROUP_ 16 WhlSpdCircumlReForBkp 1 : WhlSpdCircumlReForBkpWhlSpdCircumlReChks WhlSpdCircumlReForBkpWhlSpdCircumlReCntr WhlSpdCircumlReForBkpWhlSpdCircumlReLe WhlSpdCircumlReForBkpWhlSpdCircumlReLeQf WhlSpdCircumlReForBkpWhlSpdCircumlReRi WhlSpdCircumlReForBkpWhlSpdCircumlReRiQf;
SIG_GROUP_ 288 WipgInfo 1 : WipgInfoWipgSpdInfo WipgInfoWiprActv WipgInfoWiprInWipgAr;
