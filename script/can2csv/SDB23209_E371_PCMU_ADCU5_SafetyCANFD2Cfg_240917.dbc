// *************************************************************************** *
// *                                                                           *
// * Description:         CANDB File                                           *
// * Generated at:        2024-09-17 14:55                                     *
// * System:              SDB23200                                             *
// * Variant:             E371_PCMU_ADCU5                                      *
// * Network:             SafetyCANFD2                                         *
// *                                                                           *
// *************************************************************************** *
VERSION "SafetyCANFD2"

NS_ :

BS_ :

BU_ :  ASDM ETC FLR4

BO_ 881 FLRSafetyCANFD2Frame66 : 64 FLR4
 SG_ FourDRadarObjSts02_UB : 280|1@0+ (1,0) [0|1] "" ASDM
 SG_ FourDRadarObjSts02Chks : 7|8@0+ (1.0,0.0) [0.0|255.0] "Unitless" ASDM
 SG_ FourDRadarObjSts02Classification : 15|4@0+ (1,0) [0|15] "" ASDM
 SG_ FourDRadarObjSts02Cntr : 11|4@0+ (1.0,0.0) [0.0|15.0] "Unitless" ASDM
 SG_ FourDRadarObjSts02DistX : 23|16@0+ (0.015625,-512.0) [-512.0|511.984375] "m" ASDM
 SG_ FourDRadarObjSts02DistXStd : 39|7@0+ (0.1,0.0) [0.0|12.700000000000001] "m" ASDM
 SG_ FourDRadarObjSts02DistY : 47|13@0+ (0.015625,-64.0) [-64.0|63.984375] "m" ASDM
 SG_ FourDRadarObjSts02DistYStd : 71|7@0+ (0.1,0.0) [0.0|12.700000000000001] "m" ASDM
 SG_ FourDRadarObjSts02DistZ : 79|13@0+ (0.015625,-64.0) [-64.0|63.984375] "m" ASDM
 SG_ FourDRadarObjSts02DistZStd : 103|7@0+ (0.1,0.0) [0.0|12.700000000000001] "m" ASDM
 SG_ FourDRadarObjSts02DynamicProperty : 111|4@0+ (1,0) [0|15] "" ASDM
 SG_ FourDRadarObjSts02HeadingAngle : 107|12@0+ (0.0879,-180.0) [-180.0|179.95050000000003] "Deg" ASDM
 SG_ FourDRadarObjSts02ID : 127|8@0+ (1.0,0.0) [0.0|255.0] "Unitless" ASDM
 SG_ FourDRadarObjSts02LifeCycles : 135|4@0+ (1.0,0.0) [0.0|15.0] "Unitless" ASDM
 SG_ FourDRadarObjSts02ObjBoundingBoxHeight : 50|11@0+ (0.01,0.0) [0.0|20.0] "m" ASDM
 SG_ FourDRadarObjSts02ObjBoundingBoxLength : 131|12@0+ (0.01,0.0) [0.0|40.95] "m" ASDM
 SG_ FourDRadarObjSts02ObjBoundingBoxWidth : 82|11@0+ (0.01,0.0) [0.0|20.0] "m" ASDM
 SG_ FourDRadarObjSts02ObjNearestPtX : 151|16@0+ (0.015625,-512.0) [-512.0|511.984375] "m" ASDM
 SG_ FourDRadarObjSts02ObjNearestPtY : 167|13@0+ (0.015625,-64.0) [-64.0|63.984375] "m" ASDM
 SG_ FourDRadarObjSts02ObjNearestPtZ : 191|13@0+ (0.015625,-64.0) [-64.0|63.984375] "m" ASDM
 SG_ FourDRadarObjSts02ObjSNR : 169|10@0+ (0.1,0.0) [0.0|102.30000000000001] "dB" ASDM
 SG_ FourDRadarObjSts02ObjXAccRel : 193|10@0+ (0.125,-44.5) [-44.5|44.5] "m/s^2" ASDM
 SG_ FourDRadarObjSts02ObjYAccRel : 215|10@0+ (0.125,-44.5) [-44.5|44.5] "m/s^2" ASDM
 SG_ FourDRadarObjSts02ObstacleProbability : 236|5@0+ (3.2258,0.0) [0.0|99.9998] "%" ASDM
 SG_ FourDRadarObjSts02ProbabilityOfExistence : 247|8@0+ (1.0,0.0) [0.0|100.0] "%" ASDM
 SG_ FourDRadarObjSts02RCS : 231|11@0+ (0.1,-100.0) [-100.0|100.0] "dBm" ASDM
 SG_ FourDRadarObjSts02TargetClassificationConfidence : 221|6@0+ (1.5873,0.0) [0.0|99.9999] "%" ASDM
 SG_ FourDRadarObjSts02UpdateFlag : 32|1@0+ (1,0) [0|1] "" ASDM
 SG_ FourDRadarObjSts02VabsX : 263|11@0+ (0.1,-102.4) [-102.4|102.30000000000001] "m/s" ASDM
 SG_ FourDRadarObjSts02VabsXStd : 255|7@0+ (0.05,0.0) [0.0|6.3500000000000005] "m/s" ASDM
 SG_ FourDRadarObjSts02VabsY : 266|11@0+ (0.1,-102.4) [-102.4|102.30000000000001] "m/s" ASDM
 SG_ FourDRadarObjSts02VabsYStd : 287|7@0+ (0.05,0.0) [0.0|6.3500000000000005] "m/s" ASDM
 SG_ FourDRadarObjSts02ValidFlag : 64|1@0+ (1,0) [0|1] "" ASDM

BO_ 882 FLRSafetyCANFD2Frame67 : 64 FLR4
 SG_ FourDRadarObjSts03_UB : 280|1@0+ (1,0) [0|1] "" ASDM
 SG_ FourDRadarObjSts03Chks : 7|8@0+ (1.0,0.0) [0.0|255.0] "Unitless" ASDM
 SG_ FourDRadarObjSts03Classification : 15|4@0+ (1,0) [0|15] "" ASDM
 SG_ FourDRadarObjSts03Cntr : 11|4@0+ (1.0,0.0) [0.0|15.0] "Unitless" ASDM
 SG_ FourDRadarObjSts03DistX : 23|16@0+ (0.015625,-512.0) [-512.0|511.984375] "m" ASDM
 SG_ FourDRadarObjSts03DistXStd : 39|7@0+ (0.1,0.0) [0.0|12.700000000000001] "m" ASDM
 SG_ FourDRadarObjSts03DistY : 47|13@0+ (0.015625,-64.0) [-64.0|63.984375] "m" ASDM
 SG_ FourDRadarObjSts03DistYStd : 71|7@0+ (0.1,0.0) [0.0|12.700000000000001] "m" ASDM
 SG_ FourDRadarObjSts03DistZ : 79|13@0+ (0.015625,-64.0) [-64.0|63.984375] "m" ASDM
 SG_ FourDRadarObjSts03DistZStd : 103|7@0+ (0.1,0.0) [0.0|12.700000000000001] "m" ASDM
 SG_ FourDRadarObjSts03DynamicProperty : 111|4@0+ (1,0) [0|15] "" ASDM
 SG_ FourDRadarObjSts03HeadingAngle : 107|12@0+ (0.0879,-180.0) [-180.0|179.95050000000003] "Deg" ASDM
 SG_ FourDRadarObjSts03ID : 127|8@0+ (1.0,0.0) [0.0|255.0] "Unitless" ASDM
 SG_ FourDRadarObjSts03LifeCycles : 135|4@0+ (1.0,0.0) [0.0|15.0] "Unitless" ASDM
 SG_ FourDRadarObjSts03ObjBoundingBoxHeight : 50|11@0+ (0.01,0.0) [0.0|20.0] "m" ASDM
 SG_ FourDRadarObjSts03ObjBoundingBoxLength : 131|12@0+ (0.01,0.0) [0.0|40.95] "m" ASDM
 SG_ FourDRadarObjSts03ObjBoundingBoxWidth : 82|11@0+ (0.01,0.0) [0.0|20.0] "m" ASDM
 SG_ FourDRadarObjSts03ObjNearestPtX : 151|16@0+ (0.015625,-512.0) [-512.0|511.984375] "m" ASDM
 SG_ FourDRadarObjSts03ObjNearestPtY : 167|13@0+ (0.015625,-64.0) [-64.0|63.984375] "m" ASDM
 SG_ FourDRadarObjSts03ObjNearestPtZ : 191|13@0+ (0.015625,-64.0) [-64.0|63.984375] "m" ASDM
 SG_ FourDRadarObjSts03ObjSNR : 169|10@0+ (0.1,0.0) [0.0|102.30000000000001] "dB" ASDM
 SG_ FourDRadarObjSts03ObjXAccRel : 193|10@0+ (0.125,-44.5) [-44.5|44.5] "m/s^2" ASDM
 SG_ FourDRadarObjSts03ObjYAccRel : 215|10@0+ (0.125,-44.5) [-44.5|44.5] "m/s^2" ASDM
 SG_ FourDRadarObjSts03ObstacleProbability : 236|5@0+ (3.2258,0.0) [0.0|99.9998] "%" ASDM
 SG_ FourDRadarObjSts03ProbabilityOfExistence : 247|8@0+ (1.0,0.0) [0.0|100.0] "%" ASDM
 SG_ FourDRadarObjSts03RCS : 231|11@0+ (0.1,-100.0) [-100.0|100.0] "dBm" ASDM
 SG_ FourDRadarObjSts03TargetClassificationConfidence : 221|6@0+ (1.5873,0.0) [0.0|99.9999] "%" ASDM
 SG_ FourDRadarObjSts03UpdateFlag : 32|1@0+ (1,0) [0|1] "" ASDM
 SG_ FourDRadarObjSts03VabsX : 263|11@0+ (0.1,-102.4) [-102.4|102.30000000000001] "m/s" ASDM
 SG_ FourDRadarObjSts03VabsXStd : 255|7@0+ (0.05,0.0) [0.0|6.3500000000000005] "m/s" ASDM
 SG_ FourDRadarObjSts03VabsY : 266|11@0+ (0.1,-102.4) [-102.4|102.30000000000001] "m/s" ASDM
 SG_ FourDRadarObjSts03VabsYStd : 287|7@0+ (0.05,0.0) [0.0|6.3500000000000005] "m/s" ASDM
 SG_ FourDRadarObjSts03ValidFlag : 64|1@0+ (1,0) [0|1] "" ASDM

BO_ 883 FLRSafetyCANFD2Frame68 : 64 FLR4
 SG_ FourDRadarObjSts05_UB : 280|1@0+ (1,0) [0|1] "" ASDM
 SG_ FourDRadarObjSts05Chks : 7|8@0+ (1.0,0.0) [0.0|255.0] "Unitless" ASDM
 SG_ FourDRadarObjSts05Classification : 15|4@0+ (1,0) [0|15] "" ASDM
 SG_ FourDRadarObjSts05Cntr : 11|4@0+ (1.0,0.0) [0.0|15.0] "Unitless" ASDM
 SG_ FourDRadarObjSts05DistX : 23|16@0+ (0.015625,-512.0) [-512.0|511.984375] "m" ASDM
 SG_ FourDRadarObjSts05DistXStd : 39|7@0+ (0.1,0.0) [0.0|12.700000000000001] "m" ASDM
 SG_ FourDRadarObjSts05DistY : 47|13@0+ (0.015625,-64.0) [-64.0|63.984375] "m" ASDM
 SG_ FourDRadarObjSts05DistYStd : 71|7@0+ (0.1,0.0) [0.0|12.700000000000001] "m" ASDM
 SG_ FourDRadarObjSts05DistZ : 79|13@0+ (0.015625,-64.0) [-64.0|63.984375] "m" ASDM
 SG_ FourDRadarObjSts05DistZStd : 103|7@0+ (0.1,0.0) [0.0|12.700000000000001] "m" ASDM
 SG_ FourDRadarObjSts05DynamicProperty : 111|4@0+ (1,0) [0|15] "" ASDM
 SG_ FourDRadarObjSts05HeadingAngle : 107|12@0+ (0.0879,-180.0) [-180.0|179.95050000000003] "Deg" ASDM
 SG_ FourDRadarObjSts05ID : 127|8@0+ (1.0,0.0) [0.0|255.0] "Unitless" ASDM
 SG_ FourDRadarObjSts05LifeCycles : 135|4@0+ (1.0,0.0) [0.0|15.0] "Unitless" ASDM
 SG_ FourDRadarObjSts05ObjBoundingBoxHeight : 50|11@0+ (0.01,0.0) [0.0|20.0] "m" ASDM
 SG_ FourDRadarObjSts05ObjBoundingBoxLength : 131|12@0+ (0.01,0.0) [0.0|40.95] "m" ASDM
 SG_ FourDRadarObjSts05ObjBoundingBoxWidth : 82|11@0+ (0.01,0.0) [0.0|20.0] "m" ASDM
 SG_ FourDRadarObjSts05ObjNearestPtX : 151|16@0+ (0.015625,-512.0) [-512.0|511.984375] "m" ASDM
 SG_ FourDRadarObjSts05ObjNearestPtY : 167|13@0+ (0.015625,-64.0) [-64.0|63.984375] "m" ASDM
 SG_ FourDRadarObjSts05ObjNearestPtZ : 191|13@0+ (0.015625,-64.0) [-64.0|63.984375] "m" ASDM
 SG_ FourDRadarObjSts05ObjSNR : 169|10@0+ (0.1,0.0) [0.0|102.30000000000001] "dB" ASDM
 SG_ FourDRadarObjSts05ObjXAccRel : 193|10@0+ (0.125,-44.5) [-44.5|44.5] "m/s^2" ASDM
 SG_ FourDRadarObjSts05ObjYAccRel : 215|10@0+ (0.125,-44.5) [-44.5|44.5] "m/s^2" ASDM
 SG_ FourDRadarObjSts05ObstacleProbability : 236|5@0+ (3.2258,0.0) [0.0|99.9998] "%" ASDM
 SG_ FourDRadarObjSts05ProbabilityOfExistence : 247|8@0+ (1.0,0.0) [0.0|100.0] "%" ASDM
 SG_ FourDRadarObjSts05RCS : 231|11@0+ (0.1,-100.0) [-100.0|100.0] "dBm" ASDM
 SG_ FourDRadarObjSts05TargetClassificationConfidence : 221|6@0+ (1.5873,0.0) [0.0|99.9999] "%" ASDM
 SG_ FourDRadarObjSts05UpdateFlag : 32|1@0+ (1,0) [0|1] "" ASDM
 SG_ FourDRadarObjSts05VabsX : 263|11@0+ (0.1,-102.4) [-102.4|102.30000000000001] "m/s" ASDM
 SG_ FourDRadarObjSts05VabsXStd : 255|7@0+ (0.05,0.0) [0.0|6.3500000000000005] "m/s" ASDM
 SG_ FourDRadarObjSts05VabsY : 266|11@0+ (0.1,-102.4) [-102.4|102.30000000000001] "m/s" ASDM
 SG_ FourDRadarObjSts05VabsYStd : 287|7@0+ (0.05,0.0) [0.0|6.3500000000000005] "m/s" ASDM
 SG_ FourDRadarObjSts05ValidFlag : 64|1@0+ (1,0) [0|1] "" ASDM

BO_ 884 FLRSafetyCANFD2Frame69 : 64 FLR4
 SG_ FourDRadarObjSts07_UB : 280|1@0+ (1,0) [0|1] "" ASDM
 SG_ FourDRadarObjSts07Chks : 7|8@0+ (1.0,0.0) [0.0|255.0] "Unitless" ASDM
 SG_ FourDRadarObjSts07Classification : 15|4@0+ (1,0) [0|15] "" ASDM
 SG_ FourDRadarObjSts07Cntr : 11|4@0+ (1.0,0.0) [0.0|15.0] "Unitless" ASDM
 SG_ FourDRadarObjSts07DistX : 23|16@0+ (0.015625,-512.0) [-512.0|511.984375] "m" ASDM
 SG_ FourDRadarObjSts07DistXStd : 39|7@0+ (0.1,0.0) [0.0|12.700000000000001] "m" ASDM
 SG_ FourDRadarObjSts07DistY : 47|13@0+ (0.015625,-64.0) [-64.0|63.984375] "m" ASDM
 SG_ FourDRadarObjSts07DistYStd : 71|7@0+ (0.1,0.0) [0.0|12.700000000000001] "m" ASDM
 SG_ FourDRadarObjSts07DistZ : 79|13@0+ (0.015625,-64.0) [-64.0|63.984375] "m" ASDM
 SG_ FourDRadarObjSts07DistZStd : 103|7@0+ (0.1,0.0) [0.0|12.700000000000001] "m" ASDM
 SG_ FourDRadarObjSts07DynamicProperty : 111|4@0+ (1,0) [0|15] "" ASDM
 SG_ FourDRadarObjSts07HeadingAngle : 107|12@0+ (0.0879,-180.0) [-180.0|179.95050000000003] "Deg" ASDM
 SG_ FourDRadarObjSts07ID : 127|8@0+ (1.0,0.0) [0.0|255.0] "Unitless" ASDM
 SG_ FourDRadarObjSts07LifeCycles : 135|4@0+ (1.0,0.0) [0.0|15.0] "Unitless" ASDM
 SG_ FourDRadarObjSts07ObjBoundingBoxHeight : 50|11@0+ (0.01,0.0) [0.0|20.0] "m" ASDM
 SG_ FourDRadarObjSts07ObjBoundingBoxLength : 131|12@0+ (0.01,0.0) [0.0|40.95] "m" ASDM
 SG_ FourDRadarObjSts07ObjBoundingBoxWidth : 82|11@0+ (0.01,0.0) [0.0|20.0] "m" ASDM
 SG_ FourDRadarObjSts07ObjNearestPtX : 151|16@0+ (0.015625,-512.0) [-512.0|511.984375] "m" ASDM
 SG_ FourDRadarObjSts07ObjNearestPtY : 167|13@0+ (0.015625,-64.0) [-64.0|63.984375] "m" ASDM
 SG_ FourDRadarObjSts07ObjNearestPtZ : 191|13@0+ (0.015625,-64.0) [-64.0|63.984375] "m" ASDM
 SG_ FourDRadarObjSts07ObjSNR : 169|10@0+ (0.1,0.0) [0.0|102.30000000000001] "dB" ASDM
 SG_ FourDRadarObjSts07ObjXAccRel : 193|10@0+ (0.125,-44.5) [-44.5|44.5] "m/s^2" ASDM
 SG_ FourDRadarObjSts07ObjYAccRel : 215|10@0+ (0.125,-44.5) [-44.5|44.5] "m/s^2" ASDM
 SG_ FourDRadarObjSts07ObstacleProbability : 236|5@0+ (3.2258,0.0) [0.0|99.9998] "%" ASDM
 SG_ FourDRadarObjSts07ProbabilityOfExistence : 247|8@0+ (1.0,0.0) [0.0|100.0] "%" ASDM
 SG_ FourDRadarObjSts07RCS : 231|11@0+ (0.1,-100.0) [-100.0|100.0] "dBm" ASDM
 SG_ FourDRadarObjSts07TargetClassificationConfidence : 221|6@0+ (1.5873,0.0) [0.0|99.9999] "%" ASDM
 SG_ FourDRadarObjSts07UpdateFlag : 32|1@0+ (1,0) [0|1] "" ASDM
 SG_ FourDRadarObjSts07VabsX : 263|11@0+ (0.1,-102.4) [-102.4|102.30000000000001] "m/s" ASDM
 SG_ FourDRadarObjSts07VabsXStd : 255|7@0+ (0.05,0.0) [0.0|6.3500000000000005] "m/s" ASDM
 SG_ FourDRadarObjSts07VabsY : 266|11@0+ (0.1,-102.4) [-102.4|102.30000000000001] "m/s" ASDM
 SG_ FourDRadarObjSts07VabsYStd : 287|7@0+ (0.05,0.0) [0.0|6.3500000000000005] "m/s" ASDM
 SG_ FourDRadarObjSts07ValidFlag : 64|1@0+ (1,0) [0|1] "" ASDM

BO_ 885 FLRSafetyCANFD2Frame70 : 64 FLR4
 SG_ FourDRadarObjSts09_UB : 280|1@0+ (1,0) [0|1] "" ASDM
 SG_ FourDRadarObjSts09Chks : 7|8@0+ (1.0,0.0) [0.0|255.0] "Unitless" ASDM
 SG_ FourDRadarObjSts09Classification : 15|4@0+ (1,0) [0|15] "" ASDM
 SG_ FourDRadarObjSts09Cntr : 11|4@0+ (1.0,0.0) [0.0|15.0] "Unitless" ASDM
 SG_ FourDRadarObjSts09DistX : 23|16@0+ (0.015625,-512.0) [-512.0|511.984375] "m" ASDM
 SG_ FourDRadarObjSts09DistXStd : 39|7@0+ (0.1,0.0) [0.0|12.700000000000001] "m" ASDM
 SG_ FourDRadarObjSts09DistY : 47|13@0+ (0.015625,-64.0) [-64.0|63.984375] "m" ASDM
 SG_ FourDRadarObjSts09DistYStd : 71|7@0+ (0.1,0.0) [0.0|12.700000000000001] "m" ASDM
 SG_ FourDRadarObjSts09DistZ : 79|13@0+ (0.015625,-64.0) [-64.0|63.984375] "m" ASDM
 SG_ FourDRadarObjSts09DistZStd : 103|7@0+ (0.1,0.0) [0.0|12.700000000000001] "m" ASDM
 SG_ FourDRadarObjSts09DynamicProperty : 111|4@0+ (1,0) [0|15] "" ASDM
 SG_ FourDRadarObjSts09HeadingAngle : 107|12@0+ (0.0879,-180.0) [-180.0|179.95050000000003] "Deg" ASDM
 SG_ FourDRadarObjSts09ID : 127|8@0+ (1.0,0.0) [0.0|255.0] "Unitless" ASDM
 SG_ FourDRadarObjSts09LifeCycles : 135|4@0+ (1.0,0.0) [0.0|15.0] "Unitless" ASDM
 SG_ FourDRadarObjSts09ObjBoundingBoxHeight : 50|11@0+ (0.01,0.0) [0.0|20.0] "m" ASDM
 SG_ FourDRadarObjSts09ObjBoundingBoxLength : 131|12@0+ (0.01,0.0) [0.0|40.95] "m" ASDM
 SG_ FourDRadarObjSts09ObjBoundingBoxWidth : 82|11@0+ (0.01,0.0) [0.0|20.0] "m" ASDM
 SG_ FourDRadarObjSts09ObjNearestPtX : 151|16@0+ (0.015625,-512.0) [-512.0|511.984375] "m" ASDM
 SG_ FourDRadarObjSts09ObjNearestPtY : 167|13@0+ (0.015625,-64.0) [-64.0|63.984375] "m" ASDM
 SG_ FourDRadarObjSts09ObjNearestPtZ : 191|13@0+ (0.015625,-64.0) [-64.0|63.984375] "m" ASDM
 SG_ FourDRadarObjSts09ObjSNR : 169|10@0+ (0.1,0.0) [0.0|102.30000000000001] "dB" ASDM
 SG_ FourDRadarObjSts09ObjXAccRel : 193|10@0+ (0.125,-44.5) [-44.5|44.5] "m/s^2" ASDM
 SG_ FourDRadarObjSts09ObjYAccRel : 215|10@0+ (0.125,-44.5) [-44.5|44.5] "m/s^2" ASDM
 SG_ FourDRadarObjSts09ObstacleProbability : 236|5@0+ (3.2258,0.0) [0.0|99.9998] "%" ASDM
 SG_ FourDRadarObjSts09ProbabilityOfExistence : 247|8@0+ (1.0,0.0) [0.0|100.0] "%" ASDM
 SG_ FourDRadarObjSts09RCS : 231|11@0+ (0.1,-100.0) [-100.0|100.0] "dBm" ASDM
 SG_ FourDRadarObjSts09TargetClassificationConfidence : 221|6@0+ (1.5873,0.0) [0.0|99.9999] "%" ASDM
 SG_ FourDRadarObjSts09UpdateFlag : 32|1@0+ (1,0) [0|1] "" ASDM
 SG_ FourDRadarObjSts09VabsX : 263|11@0+ (0.1,-102.4) [-102.4|102.30000000000001] "m/s" ASDM
 SG_ FourDRadarObjSts09VabsXStd : 255|7@0+ (0.05,0.0) [0.0|6.3500000000000005] "m/s" ASDM
 SG_ FourDRadarObjSts09VabsY : 266|11@0+ (0.1,-102.4) [-102.4|102.30000000000001] "m/s" ASDM
 SG_ FourDRadarObjSts09VabsYStd : 287|7@0+ (0.05,0.0) [0.0|6.3500000000000005] "m/s" ASDM
 SG_ FourDRadarObjSts09ValidFlag : 64|1@0+ (1,0) [0|1] "" ASDM

BO_ 886 FLRSafetyCANFD2Frame71 : 64 FLR4
 SG_ FourDRadarObjSts11_UB : 280|1@0+ (1,0) [0|1] "" ASDM
 SG_ FourDRadarObjSts11Chks : 7|8@0+ (1.0,0.0) [0.0|255.0] "Unitless" ASDM
 SG_ FourDRadarObjSts11Classification : 15|4@0+ (1,0) [0|15] "" ASDM
 SG_ FourDRadarObjSts11Cntr : 11|4@0+ (1.0,0.0) [0.0|15.0] "Unitless" ASDM
 SG_ FourDRadarObjSts11DistX : 23|16@0+ (0.015625,-512.0) [-512.0|511.984375] "m" ASDM
 SG_ FourDRadarObjSts11DistXStd : 39|7@0+ (0.1,0.0) [0.0|12.700000000000001] "m" ASDM
 SG_ FourDRadarObjSts11DistY : 47|13@0+ (0.015625,-64.0) [-64.0|63.984375] "m" ASDM
 SG_ FourDRadarObjSts11DistYStd : 71|7@0+ (0.1,0.0) [0.0|12.700000000000001] "m" ASDM
 SG_ FourDRadarObjSts11DistZ : 79|13@0+ (0.015625,-64.0) [-64.0|63.984375] "m" ASDM
 SG_ FourDRadarObjSts11DistZStd : 103|7@0+ (0.1,0.0) [0.0|12.700000000000001] "m" ASDM
 SG_ FourDRadarObjSts11DynamicProperty : 111|4@0+ (1,0) [0|15] "" ASDM
 SG_ FourDRadarObjSts11HeadingAngle : 107|12@0+ (0.0879,-180.0) [-180.0|179.95050000000003] "Deg" ASDM
 SG_ FourDRadarObjSts11ID : 127|8@0+ (1.0,0.0) [0.0|255.0] "Unitless" ASDM
 SG_ FourDRadarObjSts11LifeCycles : 135|4@0+ (1.0,0.0) [0.0|15.0] "Unitless" ASDM
 SG_ FourDRadarObjSts11ObjBoundingBoxHeight : 50|11@0+ (0.01,0.0) [0.0|20.0] "m" ASDM
 SG_ FourDRadarObjSts11ObjBoundingBoxLength : 131|12@0+ (0.01,0.0) [0.0|40.95] "m" ASDM
 SG_ FourDRadarObjSts11ObjBoundingBoxWidth : 82|11@0+ (0.01,0.0) [0.0|20.0] "m" ASDM
 SG_ FourDRadarObjSts11ObjNearestPtX : 151|16@0+ (0.015625,-512.0) [-512.0|511.984375] "m" ASDM
 SG_ FourDRadarObjSts11ObjNearestPtY : 167|13@0+ (0.015625,-64.0) [-64.0|63.984375] "m" ASDM
 SG_ FourDRadarObjSts11ObjNearestPtZ : 191|13@0+ (0.015625,-64.0) [-64.0|63.984375] "m" ASDM
 SG_ FourDRadarObjSts11ObjSNR : 169|10@0+ (0.1,0.0) [0.0|102.30000000000001] "dB" ASDM
 SG_ FourDRadarObjSts11ObjXAccRel : 193|10@0+ (0.125,-44.5) [-44.5|44.5] "m/s^2" ASDM
 SG_ FourDRadarObjSts11ObjYAccRel : 215|10@0+ (0.125,-44.5) [-44.5|44.5] "m/s^2" ASDM
 SG_ FourDRadarObjSts11ObstacleProbability : 236|5@0+ (3.2258,0.0) [0.0|99.9998] "%" ASDM
 SG_ FourDRadarObjSts11ProbabilityOfExistence : 247|8@0+ (1.0,0.0) [0.0|100.0] "%" ASDM
 SG_ FourDRadarObjSts11RCS : 231|11@0+ (0.1,-100.0) [-100.0|100.0] "dBm" ASDM
 SG_ FourDRadarObjSts11TargetClassificationConfidence : 221|6@0+ (1.5873,0.0) [0.0|99.9999] "%" ASDM
 SG_ FourDRadarObjSts11UpdateFlag : 32|1@0+ (1,0) [0|1] "" ASDM
 SG_ FourDRadarObjSts11VabsX : 263|11@0+ (0.1,-102.4) [-102.4|102.30000000000001] "m/s" ASDM
 SG_ FourDRadarObjSts11VabsXStd : 255|7@0+ (0.05,0.0) [0.0|6.3500000000000005] "m/s" ASDM
 SG_ FourDRadarObjSts11VabsY : 266|11@0+ (0.1,-102.4) [-102.4|102.30000000000001] "m/s" ASDM
 SG_ FourDRadarObjSts11VabsYStd : 287|7@0+ (0.05,0.0) [0.0|6.3500000000000005] "m/s" ASDM
 SG_ FourDRadarObjSts11ValidFlag : 64|1@0+ (1,0) [0|1] "" ASDM

BO_ 887 FLRSafetyCANFD2Frame72 : 64 FLR4
 SG_ FourDRadarObjSts13_UB : 280|1@0+ (1,0) [0|1] "" ASDM
 SG_ FourDRadarObjSts13Chks : 7|8@0+ (1.0,0.0) [0.0|255.0] "Unitless" ASDM
 SG_ FourDRadarObjSts13Classification : 15|4@0+ (1,0) [0|15] "" ASDM
 SG_ FourDRadarObjSts13Cntr : 11|4@0+ (1.0,0.0) [0.0|15.0] "Unitless" ASDM
 SG_ FourDRadarObjSts13DistX : 23|16@0+ (0.015625,-512.0) [-512.0|511.984375] "m" ASDM
 SG_ FourDRadarObjSts13DistXStd : 39|7@0+ (0.1,0.0) [0.0|12.700000000000001] "m" ASDM
 SG_ FourDRadarObjSts13DistY : 47|13@0+ (0.015625,-64.0) [-64.0|63.984375] "m" ASDM
 SG_ FourDRadarObjSts13DistYStd : 71|7@0+ (0.1,0.0) [0.0|12.700000000000001] "m" ASDM
 SG_ FourDRadarObjSts13DistZ : 79|13@0+ (0.015625,-64.0) [-64.0|63.984375] "m" ASDM
 SG_ FourDRadarObjSts13DistZStd : 103|7@0+ (0.1,0.0) [0.0|12.700000000000001] "m" ASDM
 SG_ FourDRadarObjSts13DynamicProperty : 111|4@0+ (1,0) [0|15] "" ASDM
 SG_ FourDRadarObjSts13HeadingAngle : 107|12@0+ (0.0879,-180.0) [-180.0|179.95050000000003] "Deg" ASDM
 SG_ FourDRadarObjSts13ID : 127|8@0+ (1.0,0.0) [0.0|255.0] "Unitless" ASDM
 SG_ FourDRadarObjSts13LifeCycles : 135|4@0+ (1.0,0.0) [0.0|15.0] "Unitless" ASDM
 SG_ FourDRadarObjSts13ObjBoundingBoxHeight : 50|11@0+ (0.01,0.0) [0.0|20.0] "m" ASDM
 SG_ FourDRadarObjSts13ObjBoundingBoxLength : 131|12@0+ (0.01,0.0) [0.0|40.95] "m" ASDM
 SG_ FourDRadarObjSts13ObjBoundingBoxWidth : 82|11@0+ (0.01,0.0) [0.0|20.0] "m" ASDM
 SG_ FourDRadarObjSts13ObjNearestPtX : 151|16@0+ (0.015625,-512.0) [-512.0|511.984375] "m" ASDM
 SG_ FourDRadarObjSts13ObjNearestPtY : 167|13@0+ (0.015625,-64.0) [-64.0|63.984375] "m" ASDM
 SG_ FourDRadarObjSts13ObjNearestPtZ : 191|13@0+ (0.015625,-64.0) [-64.0|63.984375] "m" ASDM
 SG_ FourDRadarObjSts13ObjSNR : 169|10@0+ (0.1,0.0) [0.0|102.30000000000001] "dB" ASDM
 SG_ FourDRadarObjSts13ObjXAccRel : 193|10@0+ (0.125,-44.5) [-44.5|44.5] "m/s^2" ASDM
 SG_ FourDRadarObjSts13ObjYAccRel : 215|10@0+ (0.125,-44.5) [-44.5|44.5] "m/s^2" ASDM
 SG_ FourDRadarObjSts13ObstacleProbability : 236|5@0+ (3.2258,0.0) [0.0|99.9998] "%" ASDM
 SG_ FourDRadarObjSts13ProbabilityOfExistence : 247|8@0+ (1.0,0.0) [0.0|100.0] "%" ASDM
 SG_ FourDRadarObjSts13RCS : 231|11@0+ (0.1,-100.0) [-100.0|100.0] "dBm" ASDM
 SG_ FourDRadarObjSts13TargetClassificationConfidence : 221|6@0+ (1.5873,0.0) [0.0|99.9999] "%" ASDM
 SG_ FourDRadarObjSts13UpdateFlag : 32|1@0+ (1,0) [0|1] "" ASDM
 SG_ FourDRadarObjSts13VabsX : 263|11@0+ (0.1,-102.4) [-102.4|102.30000000000001] "m/s" ASDM
 SG_ FourDRadarObjSts13VabsXStd : 255|7@0+ (0.05,0.0) [0.0|6.3500000000000005] "m/s" ASDM
 SG_ FourDRadarObjSts13VabsY : 266|11@0+ (0.1,-102.4) [-102.4|102.30000000000001] "m/s" ASDM
 SG_ FourDRadarObjSts13VabsYStd : 287|7@0+ (0.05,0.0) [0.0|6.3500000000000005] "m/s" ASDM
 SG_ FourDRadarObjSts13ValidFlag : 64|1@0+ (1,0) [0|1] "" ASDM

BO_ 888 FLRSafetyCANFD2Frame73 : 64 FLR4
 SG_ FourDRadarObjSts15_UB : 280|1@0+ (1,0) [0|1] "" ASDM
 SG_ FourDRadarObjSts15Chks : 7|8@0+ (1.0,0.0) [0.0|255.0] "Unitless" ASDM
 SG_ FourDRadarObjSts15Classification : 15|4@0+ (1,0) [0|15] "" ASDM
 SG_ FourDRadarObjSts15Cntr : 11|4@0+ (1.0,0.0) [0.0|15.0] "Unitless" ASDM
 SG_ FourDRadarObjSts15DistX : 23|16@0+ (0.015625,-512.0) [-512.0|511.984375] "m" ASDM
 SG_ FourDRadarObjSts15DistXStd : 39|7@0+ (0.1,0.0) [0.0|12.700000000000001] "m" ASDM
 SG_ FourDRadarObjSts15DistY : 47|13@0+ (0.015625,-64.0) [-64.0|63.984375] "m" ASDM
 SG_ FourDRadarObjSts15DistYStd : 71|7@0+ (0.1,0.0) [0.0|12.700000000000001] "m" ASDM
 SG_ FourDRadarObjSts15DistZ : 79|13@0+ (0.015625,-64.0) [-64.0|63.984375] "m" ASDM
 SG_ FourDRadarObjSts15DistZStd : 103|7@0+ (0.1,0.0) [0.0|12.700000000000001] "m" ASDM
 SG_ FourDRadarObjSts15DynamicProperty : 111|4@0+ (1,0) [0|15] "" ASDM
 SG_ FourDRadarObjSts15HeadingAngle : 107|12@0+ (0.0879,-180.0) [-180.0|179.95050000000003] "Deg" ASDM
 SG_ FourDRadarObjSts15ID : 127|8@0+ (1.0,0.0) [0.0|255.0] "Unitless" ASDM
 SG_ FourDRadarObjSts15LifeCycles : 135|4@0+ (1.0,0.0) [0.0|15.0] "Unitless" ASDM
 SG_ FourDRadarObjSts15ObjBoundingBoxHeight : 50|11@0+ (0.01,0.0) [0.0|20.0] "m" ASDM
 SG_ FourDRadarObjSts15ObjBoundingBoxLength : 131|12@0+ (0.01,0.0) [0.0|40.95] "m" ASDM
 SG_ FourDRadarObjSts15ObjBoundingBoxWidth : 82|11@0+ (0.01,0.0) [0.0|20.0] "m" ASDM
 SG_ FourDRadarObjSts15ObjNearestPtX : 151|16@0+ (0.015625,-512.0) [-512.0|511.984375] "m" ASDM
 SG_ FourDRadarObjSts15ObjNearestPtY : 167|13@0+ (0.015625,-64.0) [-64.0|63.984375] "m" ASDM
 SG_ FourDRadarObjSts15ObjNearestPtZ : 191|13@0+ (0.015625,-64.0) [-64.0|63.984375] "m" ASDM
 SG_ FourDRadarObjSts15ObjSNR : 169|10@0+ (0.1,0.0) [0.0|102.30000000000001] "dB" ASDM
 SG_ FourDRadarObjSts15ObjXAccRel : 193|10@0+ (0.125,-44.5) [-44.5|44.5] "m/s^2" ASDM
 SG_ FourDRadarObjSts15ObjYAccRel : 215|10@0+ (0.125,-44.5) [-44.5|44.5] "m/s^2" ASDM
 SG_ FourDRadarObjSts15ObstacleProbability : 236|5@0+ (3.2258,0.0) [0.0|99.9998] "%" ASDM
 SG_ FourDRadarObjSts15ProbabilityOfExistence : 247|8@0+ (1.0,0.0) [0.0|100.0] "%" ASDM
 SG_ FourDRadarObjSts15RCS : 231|11@0+ (0.1,-100.0) [-100.0|100.0] "dBm" ASDM
 SG_ FourDRadarObjSts15TargetClassificationConfidence : 221|6@0+ (1.5873,0.0) [0.0|99.9999] "%" ASDM
 SG_ FourDRadarObjSts15UpdateFlag : 32|1@0+ (1,0) [0|1] "" ASDM
 SG_ FourDRadarObjSts15VabsX : 263|11@0+ (0.1,-102.4) [-102.4|102.30000000000001] "m/s" ASDM
 SG_ FourDRadarObjSts15VabsXStd : 255|7@0+ (0.05,0.0) [0.0|6.3500000000000005] "m/s" ASDM
 SG_ FourDRadarObjSts15VabsY : 266|11@0+ (0.1,-102.4) [-102.4|102.30000000000001] "m/s" ASDM
 SG_ FourDRadarObjSts15VabsYStd : 287|7@0+ (0.05,0.0) [0.0|6.3500000000000005] "m/s" ASDM
 SG_ FourDRadarObjSts15ValidFlag : 64|1@0+ (1,0) [0|1] "" ASDM

BO_ 889 FLRSafetyCANFD2Frame74 : 64 FLR4
 SG_ FourDRadarObjSts17_UB : 280|1@0+ (1,0) [0|1] "" ASDM
 SG_ FourDRadarObjSts17Chks : 7|8@0+ (1.0,0.0) [0.0|255.0] "Unitless" ASDM
 SG_ FourDRadarObjSts17Classification : 15|4@0+ (1,0) [0|15] "" ASDM
 SG_ FourDRadarObjSts17Cntr : 11|4@0+ (1.0,0.0) [0.0|15.0] "Unitless" ASDM
 SG_ FourDRadarObjSts17DistX : 23|16@0+ (0.015625,-512.0) [-512.0|511.984375] "m" ASDM
 SG_ FourDRadarObjSts17DistXStd : 39|7@0+ (0.1,0.0) [0.0|12.700000000000001] "m" ASDM
 SG_ FourDRadarObjSts17DistY : 47|13@0+ (0.015625,-64.0) [-64.0|63.984375] "m" ASDM
 SG_ FourDRadarObjSts17DistYStd : 71|7@0+ (0.1,0.0) [0.0|12.700000000000001] "m" ASDM
 SG_ FourDRadarObjSts17DistZ : 79|13@0+ (0.015625,-64.0) [-64.0|63.984375] "m" ASDM
 SG_ FourDRadarObjSts17DistZStd : 103|7@0+ (0.1,0.0) [0.0|12.700000000000001] "m" ASDM
 SG_ FourDRadarObjSts17DynamicProperty : 111|4@0+ (1,0) [0|15] "" ASDM
 SG_ FourDRadarObjSts17HeadingAngle : 107|12@0+ (0.0879,-180.0) [-180.0|179.95050000000003] "Deg" ASDM
 SG_ FourDRadarObjSts17ID : 127|8@0+ (1.0,0.0) [0.0|255.0] "Unitless" ASDM
 SG_ FourDRadarObjSts17LifeCycles : 135|4@0+ (1.0,0.0) [0.0|15.0] "Unitless" ASDM
 SG_ FourDRadarObjSts17ObjBoundingBoxHeight : 50|11@0+ (0.01,0.0) [0.0|20.0] "m" ASDM
 SG_ FourDRadarObjSts17ObjBoundingBoxLength : 131|12@0+ (0.01,0.0) [0.0|40.95] "m" ASDM
 SG_ FourDRadarObjSts17ObjBoundingBoxWidth : 82|11@0+ (0.01,0.0) [0.0|20.0] "m" ASDM
 SG_ FourDRadarObjSts17ObjNearestPtX : 151|16@0+ (0.015625,-512.0) [-512.0|511.984375] "m" ASDM
 SG_ FourDRadarObjSts17ObjNearestPtY : 167|13@0+ (0.015625,-64.0) [-64.0|63.984375] "m" ASDM
 SG_ FourDRadarObjSts17ObjNearestPtZ : 191|13@0+ (0.015625,-64.0) [-64.0|63.984375] "m" ASDM
 SG_ FourDRadarObjSts17ObjSNR : 169|10@0+ (0.1,0.0) [0.0|102.30000000000001] "dB" ASDM
 SG_ FourDRadarObjSts17ObjXAccRel : 193|10@0+ (0.125,-44.5) [-44.5|44.5] "m/s^2" ASDM
 SG_ FourDRadarObjSts17ObjYAccRel : 215|10@0+ (0.125,-44.5) [-44.5|44.5] "m/s^2" ASDM
 SG_ FourDRadarObjSts17ObstacleProbability : 236|5@0+ (3.2258,0.0) [0.0|99.9998] "%" ASDM
 SG_ FourDRadarObjSts17ProbabilityOfExistence : 247|8@0+ (1.0,0.0) [0.0|100.0] "%" ASDM
 SG_ FourDRadarObjSts17RCS : 231|11@0+ (0.1,-100.0) [-100.0|100.0] "dBm" ASDM
 SG_ FourDRadarObjSts17TargetClassificationConfidence : 221|6@0+ (1.5873,0.0) [0.0|99.9999] "%" ASDM
 SG_ FourDRadarObjSts17UpdateFlag : 32|1@0+ (1,0) [0|1] "" ASDM
 SG_ FourDRadarObjSts17VabsX : 263|11@0+ (0.1,-102.4) [-102.4|102.30000000000001] "m/s" ASDM
 SG_ FourDRadarObjSts17VabsXStd : 255|7@0+ (0.05,0.0) [0.0|6.3500000000000005] "m/s" ASDM
 SG_ FourDRadarObjSts17VabsY : 266|11@0+ (0.1,-102.4) [-102.4|102.30000000000001] "m/s" ASDM
 SG_ FourDRadarObjSts17VabsYStd : 287|7@0+ (0.05,0.0) [0.0|6.3500000000000005] "m/s" ASDM
 SG_ FourDRadarObjSts17ValidFlag : 64|1@0+ (1,0) [0|1] "" ASDM

BO_ 890 FLRSafetyCANFD2Frame75 : 64 FLR4
 SG_ FourDRadarObjSts19_UB : 280|1@0+ (1,0) [0|1] "" ASDM
 SG_ FourDRadarObjSts19Chks : 7|8@0+ (1.0,0.0) [0.0|255.0] "Unitless" ASDM
 SG_ FourDRadarObjSts19Classification : 15|4@0+ (1,0) [0|15] "" ASDM
 SG_ FourDRadarObjSts19Cntr : 11|4@0+ (1.0,0.0) [0.0|15.0] "Unitless" ASDM
 SG_ FourDRadarObjSts19DistX : 23|16@0+ (0.015625,-512.0) [-512.0|511.984375] "m" ASDM
 SG_ FourDRadarObjSts19DistXStd : 39|7@0+ (0.1,0.0) [0.0|12.700000000000001] "m" ASDM
 SG_ FourDRadarObjSts19DistY : 47|13@0+ (0.015625,-64.0) [-64.0|63.984375] "m" ASDM
 SG_ FourDRadarObjSts19DistYStd : 71|7@0+ (0.1,0.0) [0.0|12.700000000000001] "m" ASDM
 SG_ FourDRadarObjSts19DistZ : 79|13@0+ (0.015625,-64.0) [-64.0|63.984375] "m" ASDM
 SG_ FourDRadarObjSts19DistZStd : 103|7@0+ (0.1,0.0) [0.0|12.700000000000001] "m" ASDM
 SG_ FourDRadarObjSts19DynamicProperty : 111|4@0+ (1,0) [0|15] "" ASDM
 SG_ FourDRadarObjSts19HeadingAngle : 107|12@0+ (0.0879,-180.0) [-180.0|179.95050000000003] "Deg" ASDM
 SG_ FourDRadarObjSts19ID : 127|8@0+ (1.0,0.0) [0.0|255.0] "Unitless" ASDM
 SG_ FourDRadarObjSts19LifeCycles : 135|4@0+ (1.0,0.0) [0.0|15.0] "Unitless" ASDM
 SG_ FourDRadarObjSts19ObjBoundingBoxHeight : 50|11@0+ (0.01,0.0) [0.0|20.0] "m" ASDM
 SG_ FourDRadarObjSts19ObjBoundingBoxLength : 131|12@0+ (0.01,0.0) [0.0|40.95] "m" ASDM
 SG_ FourDRadarObjSts19ObjBoundingBoxWidth : 82|11@0+ (0.01,0.0) [0.0|20.0] "m" ASDM
 SG_ FourDRadarObjSts19ObjNearestPtX : 151|16@0+ (0.015625,-512.0) [-512.0|511.984375] "m" ASDM
 SG_ FourDRadarObjSts19ObjNearestPtY : 167|13@0+ (0.015625,-64.0) [-64.0|63.984375] "m" ASDM
 SG_ FourDRadarObjSts19ObjNearestPtZ : 191|13@0+ (0.015625,-64.0) [-64.0|63.984375] "m" ASDM
 SG_ FourDRadarObjSts19ObjSNR : 169|10@0+ (0.1,0.0) [0.0|102.30000000000001] "dB" ASDM
 SG_ FourDRadarObjSts19ObjXAccRel : 193|10@0+ (0.125,-44.5) [-44.5|44.5] "m/s^2" ASDM
 SG_ FourDRadarObjSts19ObjYAccRel : 215|10@0+ (0.125,-44.5) [-44.5|44.5] "m/s^2" ASDM
 SG_ FourDRadarObjSts19ObstacleProbability : 236|5@0+ (3.2258,0.0) [0.0|99.9998] "%" ASDM
 SG_ FourDRadarObjSts19ProbabilityOfExistence : 247|8@0+ (1.0,0.0) [0.0|100.0] "%" ASDM
 SG_ FourDRadarObjSts19RCS : 231|11@0+ (0.1,-100.0) [-100.0|100.0] "dBm" ASDM
 SG_ FourDRadarObjSts19TargetClassificationConfidence : 221|6@0+ (1.5873,0.0) [0.0|99.9999] "%" ASDM
 SG_ FourDRadarObjSts19UpdateFlag : 32|1@0+ (1,0) [0|1] "" ASDM
 SG_ FourDRadarObjSts19VabsX : 263|11@0+ (0.1,-102.4) [-102.4|102.30000000000001] "m/s" ASDM
 SG_ FourDRadarObjSts19VabsXStd : 255|7@0+ (0.05,0.0) [0.0|6.3500000000000005] "m/s" ASDM
 SG_ FourDRadarObjSts19VabsY : 266|11@0+ (0.1,-102.4) [-102.4|102.30000000000001] "m/s" ASDM
 SG_ FourDRadarObjSts19VabsYStd : 287|7@0+ (0.05,0.0) [0.0|6.3500000000000005] "m/s" ASDM
 SG_ FourDRadarObjSts19ValidFlag : 64|1@0+ (1,0) [0|1] "" ASDM

BO_ 891 FLRSafetyCANFD2Frame76 : 64 FLR4
 SG_ FourDRadarObjSts21_UB : 280|1@0+ (1,0) [0|1] "" ASDM
 SG_ FourDRadarObjSts21Chks : 7|8@0+ (1.0,0.0) [0.0|255.0] "Unitless" ASDM
 SG_ FourDRadarObjSts21Classification : 15|4@0+ (1,0) [0|15] "" ASDM
 SG_ FourDRadarObjSts21Cntr : 11|4@0+ (1.0,0.0) [0.0|15.0] "Unitless" ASDM
 SG_ FourDRadarObjSts21DistX : 23|16@0+ (0.015625,-512.0) [-512.0|511.984375] "m" ASDM
 SG_ FourDRadarObjSts21DistXStd : 39|7@0+ (0.1,0.0) [0.0|12.700000000000001] "m" ASDM
 SG_ FourDRadarObjSts21DistY : 47|13@0+ (0.015625,-64.0) [-64.0|63.984375] "m" ASDM
 SG_ FourDRadarObjSts21DistYStd : 71|7@0+ (0.1,0.0) [0.0|12.700000000000001] "m" ASDM
 SG_ FourDRadarObjSts21DistZ : 79|13@0+ (0.015625,-64.0) [-64.0|63.984375] "m" ASDM
 SG_ FourDRadarObjSts21DistZStd : 103|7@0+ (0.1,0.0) [0.0|12.700000000000001] "m" ASDM
 SG_ FourDRadarObjSts21DynamicProperty : 111|4@0+ (1,0) [0|15] "" ASDM
 SG_ FourDRadarObjSts21HeadingAngle : 107|12@0+ (0.0879,-180.0) [-180.0|179.95050000000003] "Deg" ASDM
 SG_ FourDRadarObjSts21ID : 127|8@0+ (1.0,0.0) [0.0|255.0] "Unitless" ASDM
 SG_ FourDRadarObjSts21LifeCycles : 135|4@0+ (1.0,0.0) [0.0|15.0] "Unitless" ASDM
 SG_ FourDRadarObjSts21ObjBoundingBoxHeight : 50|11@0+ (0.01,0.0) [0.0|20.0] "m" ASDM
 SG_ FourDRadarObjSts21ObjBoundingBoxLength : 131|12@0+ (0.01,0.0) [0.0|40.95] "m" ASDM
 SG_ FourDRadarObjSts21ObjBoundingBoxWidth : 82|11@0+ (0.01,0.0) [0.0|20.0] "m" ASDM
 SG_ FourDRadarObjSts21ObjNearestPtX : 151|16@0+ (0.015625,-512.0) [-512.0|511.984375] "m" ASDM
 SG_ FourDRadarObjSts21ObjNearestPtY : 167|13@0+ (0.015625,-64.0) [-64.0|63.984375] "m" ASDM
 SG_ FourDRadarObjSts21ObjNearestPtZ : 191|13@0+ (0.015625,-64.0) [-64.0|63.984375] "m" ASDM
 SG_ FourDRadarObjSts21ObjSNR : 169|10@0+ (0.1,0.0) [0.0|102.30000000000001] "dB" ASDM
 SG_ FourDRadarObjSts21ObjXAccRel : 193|10@0+ (0.125,-44.5) [-44.5|44.5] "m/s^2" ASDM
 SG_ FourDRadarObjSts21ObjYAccRel : 215|10@0+ (0.125,-44.5) [-44.5|44.5] "m/s^2" ASDM
 SG_ FourDRadarObjSts21ObstacleProbability : 236|5@0+ (3.2258,0.0) [0.0|99.9998] "%" ASDM
 SG_ FourDRadarObjSts21ProbabilityOfExistence : 247|8@0+ (1.0,0.0) [0.0|100.0] "%" ASDM
 SG_ FourDRadarObjSts21RCS : 231|11@0+ (0.1,-100.0) [-100.0|100.0] "dBm" ASDM
 SG_ FourDRadarObjSts21TargetClassificationConfidence : 221|6@0+ (1.5873,0.0) [0.0|99.9999] "%" ASDM
 SG_ FourDRadarObjSts21UpdateFlag : 32|1@0+ (1,0) [0|1] "" ASDM
 SG_ FourDRadarObjSts21VabsX : 263|11@0+ (0.1,-102.4) [-102.4|102.30000000000001] "m/s" ASDM
 SG_ FourDRadarObjSts21VabsXStd : 255|7@0+ (0.05,0.0) [0.0|6.3500000000000005] "m/s" ASDM
 SG_ FourDRadarObjSts21VabsY : 266|11@0+ (0.1,-102.4) [-102.4|102.30000000000001] "m/s" ASDM
 SG_ FourDRadarObjSts21VabsYStd : 287|7@0+ (0.05,0.0) [0.0|6.3500000000000005] "m/s" ASDM
 SG_ FourDRadarObjSts21ValidFlag : 64|1@0+ (1,0) [0|1] "" ASDM

BO_ 892 FLRSafetyCANFD2Frame77 : 64 FLR4
 SG_ FourDRadarObjSts23_UB : 280|1@0+ (1,0) [0|1] "" ASDM
 SG_ FourDRadarObjSts23Chks : 7|8@0+ (1.0,0.0) [0.0|255.0] "Unitless" ASDM
 SG_ FourDRadarObjSts23Classification : 15|4@0+ (1,0) [0|15] "" ASDM
 SG_ FourDRadarObjSts23Cntr : 11|4@0+ (1.0,0.0) [0.0|15.0] "Unitless" ASDM
 SG_ FourDRadarObjSts23DistX : 23|16@0+ (0.015625,-512.0) [-512.0|511.984375] "m" ASDM
 SG_ FourDRadarObjSts23DistXStd : 39|7@0+ (0.1,0.0) [0.0|12.700000000000001] "m" ASDM
 SG_ FourDRadarObjSts23DistY : 47|13@0+ (0.015625,-64.0) [-64.0|63.984375] "m" ASDM
 SG_ FourDRadarObjSts23DistYStd : 71|7@0+ (0.1,0.0) [0.0|12.700000000000001] "m" ASDM
 SG_ FourDRadarObjSts23DistZ : 79|13@0+ (0.015625,-64.0) [-64.0|63.984375] "m" ASDM
 SG_ FourDRadarObjSts23DistZStd : 103|7@0+ (0.1,0.0) [0.0|12.700000000000001] "m" ASDM
 SG_ FourDRadarObjSts23DynamicProperty : 111|4@0+ (1,0) [0|15] "" ASDM
 SG_ FourDRadarObjSts23HeadingAngle : 107|12@0+ (0.0879,-180.0) [-180.0|179.95050000000003] "Deg" ASDM
 SG_ FourDRadarObjSts23ID : 127|8@0+ (1.0,0.0) [0.0|255.0] "Unitless" ASDM
 SG_ FourDRadarObjSts23LifeCycles : 135|4@0+ (1.0,0.0) [0.0|15.0] "Unitless" ASDM
 SG_ FourDRadarObjSts23ObjBoundingBoxHeight : 50|11@0+ (0.01,0.0) [0.0|20.0] "m" ASDM
 SG_ FourDRadarObjSts23ObjBoundingBoxLength : 131|12@0+ (0.01,0.0) [0.0|40.95] "m" ASDM
 SG_ FourDRadarObjSts23ObjBoundingBoxWidth : 82|11@0+ (0.01,0.0) [0.0|20.0] "m" ASDM
 SG_ FourDRadarObjSts23ObjNearestPtX : 151|16@0+ (0.015625,-512.0) [-512.0|511.984375] "m" ASDM
 SG_ FourDRadarObjSts23ObjNearestPtY : 167|13@0+ (0.015625,-64.0) [-64.0|63.984375] "m" ASDM
 SG_ FourDRadarObjSts23ObjNearestPtZ : 191|13@0+ (0.015625,-64.0) [-64.0|63.984375] "m" ASDM
 SG_ FourDRadarObjSts23ObjSNR : 169|10@0+ (0.1,0.0) [0.0|102.30000000000001] "dB" ASDM
 SG_ FourDRadarObjSts23ObjXAccRel : 193|10@0+ (0.125,-44.5) [-44.5|44.5] "m/s^2" ASDM
 SG_ FourDRadarObjSts23ObjYAccRel : 215|10@0+ (0.125,-44.5) [-44.5|44.5] "m/s^2" ASDM
 SG_ FourDRadarObjSts23ObstacleProbability : 236|5@0+ (3.2258,0.0) [0.0|99.9998] "%" ASDM
 SG_ FourDRadarObjSts23ProbabilityOfExistence : 247|8@0+ (1.0,0.0) [0.0|100.0] "%" ASDM
 SG_ FourDRadarObjSts23RCS : 231|11@0+ (0.1,-100.0) [-100.0|100.0] "dBm" ASDM
 SG_ FourDRadarObjSts23TargetClassificationConfidence : 221|6@0+ (1.5873,0.0) [0.0|99.9999] "%" ASDM
 SG_ FourDRadarObjSts23UpdateFlag : 32|1@0+ (1,0) [0|1] "" ASDM
 SG_ FourDRadarObjSts23VabsX : 263|11@0+ (0.1,-102.4) [-102.4|102.30000000000001] "m/s" ASDM
 SG_ FourDRadarObjSts23VabsXStd : 255|7@0+ (0.05,0.0) [0.0|6.3500000000000005] "m/s" ASDM
 SG_ FourDRadarObjSts23VabsY : 266|11@0+ (0.1,-102.4) [-102.4|102.30000000000001] "m/s" ASDM
 SG_ FourDRadarObjSts23VabsYStd : 287|7@0+ (0.05,0.0) [0.0|6.3500000000000005] "m/s" ASDM
 SG_ FourDRadarObjSts23ValidFlag : 64|1@0+ (1,0) [0|1] "" ASDM

BO_ 893 FLRSafetyCANFD2Frame78 : 64 FLR4
 SG_ FourDRadarObjSts25_UB : 280|1@0+ (1,0) [0|1] "" ASDM
 SG_ FourDRadarObjSts25Chks : 7|8@0+ (1.0,0.0) [0.0|255.0] "Unitless" ASDM
 SG_ FourDRadarObjSts25Classification : 15|4@0+ (1,0) [0|15] "" ASDM
 SG_ FourDRadarObjSts25Cntr : 11|4@0+ (1.0,0.0) [0.0|15.0] "Unitless" ASDM
 SG_ FourDRadarObjSts25DistX : 23|16@0+ (0.015625,-512.0) [-512.0|511.984375] "m" ASDM
 SG_ FourDRadarObjSts25DistXStd : 39|7@0+ (0.1,0.0) [0.0|12.700000000000001] "m" ASDM
 SG_ FourDRadarObjSts25DistY : 47|13@0+ (0.015625,-64.0) [-64.0|63.984375] "m" ASDM
 SG_ FourDRadarObjSts25DistYStd : 71|7@0+ (0.1,0.0) [0.0|12.700000000000001] "m" ASDM
 SG_ FourDRadarObjSts25DistZ : 79|13@0+ (0.015625,-64.0) [-64.0|63.984375] "m" ASDM
 SG_ FourDRadarObjSts25DistZStd : 103|7@0+ (0.1,0.0) [0.0|12.700000000000001] "m" ASDM
 SG_ FourDRadarObjSts25DynamicProperty : 111|4@0+ (1,0) [0|15] "" ASDM
 SG_ FourDRadarObjSts25HeadingAngle : 107|12@0+ (0.0879,-180.0) [-180.0|179.95050000000003] "Deg" ASDM
 SG_ FourDRadarObjSts25ID : 127|8@0+ (1.0,0.0) [0.0|255.0] "Unitless" ASDM
 SG_ FourDRadarObjSts25LifeCycles : 135|4@0+ (1.0,0.0) [0.0|15.0] "Unitless" ASDM
 SG_ FourDRadarObjSts25ObjBoundingBoxHeight : 50|11@0+ (0.01,0.0) [0.0|20.0] "m" ASDM
 SG_ FourDRadarObjSts25ObjBoundingBoxLength : 131|12@0+ (0.01,0.0) [0.0|40.95] "m" ASDM
 SG_ FourDRadarObjSts25ObjBoundingBoxWidth : 82|11@0+ (0.01,0.0) [0.0|20.0] "m" ASDM
 SG_ FourDRadarObjSts25ObjNearestPtX : 151|16@0+ (0.015625,-512.0) [-512.0|511.984375] "m" ASDM
 SG_ FourDRadarObjSts25ObjNearestPtY : 167|13@0+ (0.015625,-64.0) [-64.0|63.984375] "m" ASDM
 SG_ FourDRadarObjSts25ObjNearestPtZ : 191|13@0+ (0.015625,-64.0) [-64.0|63.984375] "m" ASDM
 SG_ FourDRadarObjSts25ObjSNR : 169|10@0+ (0.1,0.0) [0.0|102.30000000000001] "dB" ASDM
 SG_ FourDRadarObjSts25ObjXAccRel : 193|10@0+ (0.125,-44.5) [-44.5|44.5] "m/s^2" ASDM
 SG_ FourDRadarObjSts25ObjYAccRel : 215|10@0+ (0.125,-44.5) [-44.5|44.5] "m/s^2" ASDM
 SG_ FourDRadarObjSts25ObstacleProbability : 236|5@0+ (3.2258,0.0) [0.0|99.9998] "%" ASDM
 SG_ FourDRadarObjSts25ProbabilityOfExistence : 247|8@0+ (1.0,0.0) [0.0|100.0] "%" ASDM
 SG_ FourDRadarObjSts25RCS : 231|11@0+ (0.1,-100.0) [-100.0|100.0] "dBm" ASDM
 SG_ FourDRadarObjSts25TargetClassificationConfidence : 221|6@0+ (1.5873,0.0) [0.0|99.9999] "%" ASDM
 SG_ FourDRadarObjSts25UpdateFlag : 32|1@0+ (1,0) [0|1] "" ASDM
 SG_ FourDRadarObjSts25VabsX : 263|11@0+ (0.1,-102.4) [-102.4|102.30000000000001] "m/s" ASDM
 SG_ FourDRadarObjSts25VabsXStd : 255|7@0+ (0.05,0.0) [0.0|6.3500000000000005] "m/s" ASDM
 SG_ FourDRadarObjSts25VabsY : 266|11@0+ (0.1,-102.4) [-102.4|102.30000000000001] "m/s" ASDM
 SG_ FourDRadarObjSts25VabsYStd : 287|7@0+ (0.05,0.0) [0.0|6.3500000000000005] "m/s" ASDM
 SG_ FourDRadarObjSts25ValidFlag : 64|1@0+ (1,0) [0|1] "" ASDM

BO_ 894 FLRSafetyCANFD2Frame79 : 64 FLR4
 SG_ FourDRadarObjSts27_UB : 280|1@0+ (1,0) [0|1] "" ASDM
 SG_ FourDRadarObjSts27Chks : 7|8@0+ (1.0,0.0) [0.0|255.0] "Unitless" ASDM
 SG_ FourDRadarObjSts27Classification : 15|4@0+ (1,0) [0|15] "" ASDM
 SG_ FourDRadarObjSts27Cntr : 11|4@0+ (1.0,0.0) [0.0|15.0] "Unitless" ASDM
 SG_ FourDRadarObjSts27DistX : 23|16@0+ (0.015625,-512.0) [-512.0|511.984375] "m" ASDM
 SG_ FourDRadarObjSts27DistXStd : 39|7@0+ (0.1,0.0) [0.0|12.700000000000001] "m" ASDM
 SG_ FourDRadarObjSts27DistY : 47|13@0+ (0.015625,-64.0) [-64.0|63.984375] "m" ASDM
 SG_ FourDRadarObjSts27DistYStd : 71|7@0+ (0.1,0.0) [0.0|12.700000000000001] "m" ASDM
 SG_ FourDRadarObjSts27DistZ : 79|13@0+ (0.015625,-64.0) [-64.0|63.984375] "m" ASDM
 SG_ FourDRadarObjSts27DistZStd : 103|7@0+ (0.1,0.0) [0.0|12.700000000000001] "m" ASDM
 SG_ FourDRadarObjSts27DynamicProperty : 111|4@0+ (1,0) [0|15] "" ASDM
 SG_ FourDRadarObjSts27HeadingAngle : 107|12@0+ (0.0879,-180.0) [-180.0|179.95050000000003] "Deg" ASDM
 SG_ FourDRadarObjSts27ID : 127|8@0+ (1.0,0.0) [0.0|255.0] "Unitless" ASDM
 SG_ FourDRadarObjSts27LifeCycles : 135|4@0+ (1.0,0.0) [0.0|15.0] "Unitless" ASDM
 SG_ FourDRadarObjSts27ObjBoundingBoxHeight : 50|11@0+ (0.01,0.0) [0.0|20.0] "m" ASDM
 SG_ FourDRadarObjSts27ObjBoundingBoxLength : 131|12@0+ (0.01,0.0) [0.0|40.95] "m" ASDM
 SG_ FourDRadarObjSts27ObjBoundingBoxWidth : 82|11@0+ (0.01,0.0) [0.0|20.0] "m" ASDM
 SG_ FourDRadarObjSts27ObjNearestPtX : 151|16@0+ (0.015625,-512.0) [-512.0|511.984375] "m" ASDM
 SG_ FourDRadarObjSts27ObjNearestPtY : 167|13@0+ (0.015625,-64.0) [-64.0|63.984375] "m" ASDM
 SG_ FourDRadarObjSts27ObjNearestPtZ : 191|13@0+ (0.015625,-64.0) [-64.0|63.984375] "m" ASDM
 SG_ FourDRadarObjSts27ObjSNR : 169|10@0+ (0.1,0.0) [0.0|102.30000000000001] "dB" ASDM
 SG_ FourDRadarObjSts27ObjXAccRel : 193|10@0+ (0.125,-44.5) [-44.5|44.5] "m/s^2" ASDM
 SG_ FourDRadarObjSts27ObjYAccRel : 215|10@0+ (0.125,-44.5) [-44.5|44.5] "m/s^2" ASDM
 SG_ FourDRadarObjSts27ObstacleProbability : 236|5@0+ (3.2258,0.0) [0.0|99.9998] "%" ASDM
 SG_ FourDRadarObjSts27ProbabilityOfExistence : 247|8@0+ (1.0,0.0) [0.0|100.0] "%" ASDM
 SG_ FourDRadarObjSts27RCS : 231|11@0+ (0.1,-100.0) [-100.0|100.0] "dBm" ASDM
 SG_ FourDRadarObjSts27TargetClassificationConfidence : 221|6@0+ (1.5873,0.0) [0.0|99.9999] "%" ASDM
 SG_ FourDRadarObjSts27UpdateFlag : 32|1@0+ (1,0) [0|1] "" ASDM
 SG_ FourDRadarObjSts27VabsX : 263|11@0+ (0.1,-102.4) [-102.4|102.30000000000001] "m/s" ASDM
 SG_ FourDRadarObjSts27VabsXStd : 255|7@0+ (0.05,0.0) [0.0|6.3500000000000005] "m/s" ASDM
 SG_ FourDRadarObjSts27VabsY : 266|11@0+ (0.1,-102.4) [-102.4|102.30000000000001] "m/s" ASDM
 SG_ FourDRadarObjSts27VabsYStd : 287|7@0+ (0.05,0.0) [0.0|6.3500000000000005] "m/s" ASDM
 SG_ FourDRadarObjSts27ValidFlag : 64|1@0+ (1,0) [0|1] "" ASDM

BO_ 895 FLRSafetyCANFD2Frame80 : 64 FLR4
 SG_ FourDRadarObjSts29_UB : 280|1@0+ (1,0) [0|1] "" ASDM
 SG_ FourDRadarObjSts29Chks : 7|8@0+ (1.0,0.0) [0.0|255.0] "Unitless" ASDM
 SG_ FourDRadarObjSts29Classification : 15|4@0+ (1,0) [0|15] "" ASDM
 SG_ FourDRadarObjSts29Cntr : 11|4@0+ (1.0,0.0) [0.0|15.0] "Unitless" ASDM
 SG_ FourDRadarObjSts29DistX : 23|16@0+ (0.015625,-512.0) [-512.0|511.984375] "m" ASDM
 SG_ FourDRadarObjSts29DistXStd : 39|7@0+ (0.1,0.0) [0.0|12.700000000000001] "m" ASDM
 SG_ FourDRadarObjSts29DistY : 47|13@0+ (0.015625,-64.0) [-64.0|63.984375] "m" ASDM
 SG_ FourDRadarObjSts29DistYStd : 71|7@0+ (0.1,0.0) [0.0|12.700000000000001] "m" ASDM
 SG_ FourDRadarObjSts29DistZ : 79|13@0+ (0.015625,-64.0) [-64.0|63.984375] "m" ASDM
 SG_ FourDRadarObjSts29DistZStd : 103|7@0+ (0.1,0.0) [0.0|12.700000000000001] "m" ASDM
 SG_ FourDRadarObjSts29DynamicProperty : 111|4@0+ (1,0) [0|15] "" ASDM
 SG_ FourDRadarObjSts29HeadingAngle : 107|12@0+ (0.0879,-180.0) [-180.0|179.95050000000003] "Deg" ASDM
 SG_ FourDRadarObjSts29ID : 127|8@0+ (1.0,0.0) [0.0|255.0] "Unitless" ASDM
 SG_ FourDRadarObjSts29LifeCycles : 135|4@0+ (1.0,0.0) [0.0|15.0] "Unitless" ASDM
 SG_ FourDRadarObjSts29ObjBoundingBoxHeight : 50|11@0+ (0.01,0.0) [0.0|20.0] "m" ASDM
 SG_ FourDRadarObjSts29ObjBoundingBoxLength : 131|12@0+ (0.01,0.0) [0.0|40.95] "m" ASDM
 SG_ FourDRadarObjSts29ObjBoundingBoxWidth : 82|11@0+ (0.01,0.0) [0.0|20.0] "m" ASDM
 SG_ FourDRadarObjSts29ObjNearestPtX : 151|16@0+ (0.015625,-512.0) [-512.0|511.984375] "m" ASDM
 SG_ FourDRadarObjSts29ObjNearestPtY : 167|13@0+ (0.015625,-64.0) [-64.0|63.984375] "m" ASDM
 SG_ FourDRadarObjSts29ObjNearestPtZ : 191|13@0+ (0.015625,-64.0) [-64.0|63.984375] "m" ASDM
 SG_ FourDRadarObjSts29ObjSNR : 169|10@0+ (0.1,0.0) [0.0|102.30000000000001] "dB" ASDM
 SG_ FourDRadarObjSts29ObjXAccRel : 193|10@0+ (0.125,-44.5) [-44.5|44.5] "m/s^2" ASDM
 SG_ FourDRadarObjSts29ObjYAccRel : 215|10@0+ (0.125,-44.5) [-44.5|44.5] "m/s^2" ASDM
 SG_ FourDRadarObjSts29ObstacleProbability : 236|5@0+ (3.2258,0.0) [0.0|99.9998] "%" ASDM
 SG_ FourDRadarObjSts29ProbabilityOfExistence : 247|8@0+ (1.0,0.0) [0.0|100.0] "%" ASDM
 SG_ FourDRadarObjSts29RCS : 231|11@0+ (0.1,-100.0) [-100.0|100.0] "dBm" ASDM
 SG_ FourDRadarObjSts29TargetClassificationConfidence : 221|6@0+ (1.5873,0.0) [0.0|99.9999] "%" ASDM
 SG_ FourDRadarObjSts29UpdateFlag : 32|1@0+ (1,0) [0|1] "" ASDM
 SG_ FourDRadarObjSts29VabsX : 263|11@0+ (0.1,-102.4) [-102.4|102.30000000000001] "m/s" ASDM
 SG_ FourDRadarObjSts29VabsXStd : 255|7@0+ (0.05,0.0) [0.0|6.3500000000000005] "m/s" ASDM
 SG_ FourDRadarObjSts29VabsY : 266|11@0+ (0.1,-102.4) [-102.4|102.30000000000001] "m/s" ASDM
 SG_ FourDRadarObjSts29VabsYStd : 287|7@0+ (0.05,0.0) [0.0|6.3500000000000005] "m/s" ASDM
 SG_ FourDRadarObjSts29ValidFlag : 64|1@0+ (1,0) [0|1] "" ASDM

BO_ 896 FLRSafetyCANFD2Frame81 : 64 FLR4
 SG_ FourDRadarObjSts31_UB : 280|1@0+ (1,0) [0|1] "" ASDM
 SG_ FourDRadarObjSts31Chks : 7|8@0+ (1.0,0.0) [0.0|255.0] "Unitless" ASDM
 SG_ FourDRadarObjSts31Classification : 15|4@0+ (1,0) [0|15] "" ASDM
 SG_ FourDRadarObjSts31Cntr : 11|4@0+ (1.0,0.0) [0.0|15.0] "Unitless" ASDM
 SG_ FourDRadarObjSts31DistX : 23|16@0+ (0.015625,-512.0) [-512.0|511.984375] "m" ASDM
 SG_ FourDRadarObjSts31DistXStd : 39|7@0+ (0.1,0.0) [0.0|12.700000000000001] "m" ASDM
 SG_ FourDRadarObjSts31DistY : 47|13@0+ (0.015625,-64.0) [-64.0|63.984375] "m" ASDM
 SG_ FourDRadarObjSts31DistYStd : 71|7@0+ (0.1,0.0) [0.0|12.700000000000001] "m" ASDM
 SG_ FourDRadarObjSts31DistZ : 79|13@0+ (0.015625,-64.0) [-64.0|63.984375] "m" ASDM
 SG_ FourDRadarObjSts31DistZStd : 103|7@0+ (0.1,0.0) [0.0|12.700000000000001] "m" ASDM
 SG_ FourDRadarObjSts31DynamicProperty : 111|4@0+ (1,0) [0|15] "" ASDM
 SG_ FourDRadarObjSts31HeadingAngle : 107|12@0+ (0.0879,-180.0) [-180.0|179.95050000000003] "Deg" ASDM
 SG_ FourDRadarObjSts31ID : 127|8@0+ (1.0,0.0) [0.0|255.0] "Unitless" ASDM
 SG_ FourDRadarObjSts31LifeCycles : 135|4@0+ (1.0,0.0) [0.0|15.0] "Unitless" ASDM
 SG_ FourDRadarObjSts31ObjBoundingBoxHeight : 50|11@0+ (0.01,0.0) [0.0|20.0] "m" ASDM
 SG_ FourDRadarObjSts31ObjBoundingBoxLength : 131|12@0+ (0.01,0.0) [0.0|40.95] "m" ASDM
 SG_ FourDRadarObjSts31ObjBoundingBoxWidth : 82|11@0+ (0.01,0.0) [0.0|20.0] "m" ASDM
 SG_ FourDRadarObjSts31ObjNearestPtX : 151|16@0+ (0.015625,-512.0) [-512.0|511.984375] "m" ASDM
 SG_ FourDRadarObjSts31ObjNearestPtY : 167|13@0+ (0.015625,-64.0) [-64.0|63.984375] "m" ASDM
 SG_ FourDRadarObjSts31ObjNearestPtZ : 191|13@0+ (0.015625,-64.0) [-64.0|63.984375] "m" ASDM
 SG_ FourDRadarObjSts31ObjSNR : 169|10@0+ (0.1,0.0) [0.0|102.30000000000001] "dB" ASDM
 SG_ FourDRadarObjSts31ObjXAccRel : 193|10@0+ (0.125,-44.5) [-44.5|44.5] "m/s^2" ASDM
 SG_ FourDRadarObjSts31ObjYAccRel : 215|10@0+ (0.125,-44.5) [-44.5|44.5] "m/s^2" ASDM
 SG_ FourDRadarObjSts31ObstacleProbability : 236|5@0+ (3.2258,0.0) [0.0|99.9998] "%" ASDM
 SG_ FourDRadarObjSts31ProbabilityOfExistence : 247|8@0+ (1.0,0.0) [0.0|100.0] "%" ASDM
 SG_ FourDRadarObjSts31RCS : 231|11@0+ (0.1,-100.0) [-100.0|100.0] "dBm" ASDM
 SG_ FourDRadarObjSts31TargetClassificationConfidence : 221|6@0+ (1.5873,0.0) [0.0|99.9999] "%" ASDM
 SG_ FourDRadarObjSts31UpdateFlag : 32|1@0+ (1,0) [0|1] "" ASDM
 SG_ FourDRadarObjSts31VabsX : 263|11@0+ (0.1,-102.4) [-102.4|102.30000000000001] "m/s" ASDM
 SG_ FourDRadarObjSts31VabsXStd : 255|7@0+ (0.05,0.0) [0.0|6.3500000000000005] "m/s" ASDM
 SG_ FourDRadarObjSts31VabsY : 266|11@0+ (0.1,-102.4) [-102.4|102.30000000000001] "m/s" ASDM
 SG_ FourDRadarObjSts31VabsYStd : 287|7@0+ (0.05,0.0) [0.0|6.3500000000000005] "m/s" ASDM
 SG_ FourDRadarObjSts31ValidFlag : 64|1@0+ (1,0) [0|1] "" ASDM

BO_ 897 FLRSafetyCANFD2Frame82 : 64 FLR4
 SG_ FourDRadarObjSts33_UB : 280|1@0+ (1,0) [0|1] "" ASDM
 SG_ FourDRadarObjSts33Chks : 7|8@0+ (1.0,0.0) [0.0|255.0] "Unitless" ASDM
 SG_ FourDRadarObjSts33Classification : 15|4@0+ (1,0) [0|15] "" ASDM
 SG_ FourDRadarObjSts33Cntr : 11|4@0+ (1.0,0.0) [0.0|15.0] "Unitless" ASDM
 SG_ FourDRadarObjSts33DistX : 23|16@0+ (0.015625,-512.0) [-512.0|511.984375] "m" ASDM
 SG_ FourDRadarObjSts33DistXStd : 39|7@0+ (0.1,0.0) [0.0|12.700000000000001] "m" ASDM
 SG_ FourDRadarObjSts33DistY : 47|13@0+ (0.015625,-64.0) [-64.0|63.984375] "m" ASDM
 SG_ FourDRadarObjSts33DistYStd : 71|7@0+ (0.1,0.0) [0.0|12.700000000000001] "m" ASDM
 SG_ FourDRadarObjSts33DistZ : 79|13@0+ (0.015625,-64.0) [-64.0|63.984375] "m" ASDM
 SG_ FourDRadarObjSts33DistZStd : 103|7@0+ (0.1,0.0) [0.0|12.700000000000001] "m" ASDM
 SG_ FourDRadarObjSts33DynamicProperty : 111|4@0+ (1,0) [0|15] "" ASDM
 SG_ FourDRadarObjSts33HeadingAngle : 107|12@0+ (0.0879,-180.0) [-180.0|179.95050000000003] "Deg" ASDM
 SG_ FourDRadarObjSts33ID : 127|8@0+ (1.0,0.0) [0.0|255.0] "Unitless" ASDM
 SG_ FourDRadarObjSts33LifeCycles : 135|4@0+ (1.0,0.0) [0.0|15.0] "Unitless" ASDM
 SG_ FourDRadarObjSts33ObjBoundingBoxHeight : 50|11@0+ (0.01,0.0) [0.0|20.0] "m" ASDM
 SG_ FourDRadarObjSts33ObjBoundingBoxLength : 131|12@0+ (0.01,0.0) [0.0|40.95] "m" ASDM
 SG_ FourDRadarObjSts33ObjBoundingBoxWidth : 82|11@0+ (0.01,0.0) [0.0|20.0] "m" ASDM
 SG_ FourDRadarObjSts33ObjNearestPtX : 151|16@0+ (0.015625,-512.0) [-512.0|511.984375] "m" ASDM
 SG_ FourDRadarObjSts33ObjNearestPtY : 167|13@0+ (0.015625,-64.0) [-64.0|63.984375] "m" ASDM
 SG_ FourDRadarObjSts33ObjNearestPtZ : 191|13@0+ (0.015625,-64.0) [-64.0|63.984375] "m" ASDM
 SG_ FourDRadarObjSts33ObjSNR : 169|10@0+ (0.1,0.0) [0.0|102.30000000000001] "dB" ASDM
 SG_ FourDRadarObjSts33ObjXAccRel : 193|10@0+ (0.125,-44.5) [-44.5|44.5] "m/s^2" ASDM
 SG_ FourDRadarObjSts33ObjYAccRel : 215|10@0+ (0.125,-44.5) [-44.5|44.5] "m/s^2" ASDM
 SG_ FourDRadarObjSts33ObstacleProbability : 236|5@0+ (3.2258,0.0) [0.0|99.9998] "%" ASDM
 SG_ FourDRadarObjSts33ProbabilityOfExistence : 247|8@0+ (1.0,0.0) [0.0|100.0] "%" ASDM
 SG_ FourDRadarObjSts33RCS : 231|11@0+ (0.1,-100.0) [-100.0|100.0] "dBm" ASDM
 SG_ FourDRadarObjSts33TargetClassificationConfidence : 221|6@0+ (1.5873,0.0) [0.0|99.9999] "%" ASDM
 SG_ FourDRadarObjSts33UpdateFlag : 32|1@0+ (1,0) [0|1] "" ASDM
 SG_ FourDRadarObjSts33VabsX : 263|11@0+ (0.1,-102.4) [-102.4|102.30000000000001] "m/s" ASDM
 SG_ FourDRadarObjSts33VabsXStd : 255|7@0+ (0.05,0.0) [0.0|6.3500000000000005] "m/s" ASDM
 SG_ FourDRadarObjSts33VabsY : 266|11@0+ (0.1,-102.4) [-102.4|102.30000000000001] "m/s" ASDM
 SG_ FourDRadarObjSts33VabsYStd : 287|7@0+ (0.05,0.0) [0.0|6.3500000000000005] "m/s" ASDM
 SG_ FourDRadarObjSts33ValidFlag : 64|1@0+ (1,0) [0|1] "" ASDM

BO_ 898 FLRSafetyCANFD2Frame83 : 64 FLR4
 SG_ FourDRadarObjSts35_UB : 280|1@0+ (1,0) [0|1] "" ASDM
 SG_ FourDRadarObjSts35Chks : 7|8@0+ (1.0,0.0) [0.0|255.0] "Unitless" ASDM
 SG_ FourDRadarObjSts35Classification : 15|4@0+ (1,0) [0|15] "" ASDM
 SG_ FourDRadarObjSts35Cntr : 11|4@0+ (1.0,0.0) [0.0|15.0] "Unitless" ASDM
 SG_ FourDRadarObjSts35DistX : 23|16@0+ (0.015625,-512.0) [-512.0|511.984375] "m" ASDM
 SG_ FourDRadarObjSts35DistXStd : 39|7@0+ (0.1,0.0) [0.0|12.700000000000001] "m" ASDM
 SG_ FourDRadarObjSts35DistY : 47|13@0+ (0.015625,-64.0) [-64.0|63.984375] "m" ASDM
 SG_ FourDRadarObjSts35DistYStd : 71|7@0+ (0.1,0.0) [0.0|12.700000000000001] "m" ASDM
 SG_ FourDRadarObjSts35DistZ : 79|13@0+ (0.015625,-64.0) [-64.0|63.984375] "m" ASDM
 SG_ FourDRadarObjSts35DistZStd : 103|7@0+ (0.1,0.0) [0.0|12.700000000000001] "m" ASDM
 SG_ FourDRadarObjSts35DynamicProperty : 111|4@0+ (1,0) [0|15] "" ASDM
 SG_ FourDRadarObjSts35HeadingAngle : 107|12@0+ (0.0879,-180.0) [-180.0|179.95050000000003] "Deg" ASDM
 SG_ FourDRadarObjSts35ID : 127|8@0+ (1.0,0.0) [0.0|255.0] "Unitless" ASDM
 SG_ FourDRadarObjSts35LifeCycles : 135|4@0+ (1.0,0.0) [0.0|15.0] "Unitless" ASDM
 SG_ FourDRadarObjSts35ObjBoundingBoxHeight : 50|11@0+ (0.01,0.0) [0.0|20.0] "m" ASDM
 SG_ FourDRadarObjSts35ObjBoundingBoxLength : 131|12@0+ (0.01,0.0) [0.0|40.95] "m" ASDM
 SG_ FourDRadarObjSts35ObjBoundingBoxWidth : 82|11@0+ (0.01,0.0) [0.0|20.0] "m" ASDM
 SG_ FourDRadarObjSts35ObjNearestPtX : 151|16@0+ (0.015625,-512.0) [-512.0|511.984375] "m" ASDM
 SG_ FourDRadarObjSts35ObjNearestPtY : 167|13@0+ (0.015625,-64.0) [-64.0|63.984375] "m" ASDM
 SG_ FourDRadarObjSts35ObjNearestPtZ : 191|13@0+ (0.015625,-64.0) [-64.0|63.984375] "m" ASDM
 SG_ FourDRadarObjSts35ObjSNR : 169|10@0+ (0.1,0.0) [0.0|102.30000000000001] "dB" ASDM
 SG_ FourDRadarObjSts35ObjXAccRel : 193|10@0+ (0.125,-44.5) [-44.5|44.5] "m/s^2" ASDM
 SG_ FourDRadarObjSts35ObjYAccRel : 215|10@0+ (0.125,-44.5) [-44.5|44.5] "m/s^2" ASDM
 SG_ FourDRadarObjSts35ObstacleProbability : 236|5@0+ (3.2258,0.0) [0.0|99.9998] "%" ASDM
 SG_ FourDRadarObjSts35ProbabilityOfExistence : 247|8@0+ (1.0,0.0) [0.0|100.0] "%" ASDM
 SG_ FourDRadarObjSts35RCS : 231|11@0+ (0.1,-100.0) [-100.0|100.0] "dBm" ASDM
 SG_ FourDRadarObjSts35TargetClassificationConfidence : 221|6@0+ (1.5873,0.0) [0.0|99.9999] "%" ASDM
 SG_ FourDRadarObjSts35UpdateFlag : 32|1@0+ (1,0) [0|1] "" ASDM
 SG_ FourDRadarObjSts35VabsX : 263|11@0+ (0.1,-102.4) [-102.4|102.30000000000001] "m/s" ASDM
 SG_ FourDRadarObjSts35VabsXStd : 255|7@0+ (0.05,0.0) [0.0|6.3500000000000005] "m/s" ASDM
 SG_ FourDRadarObjSts35VabsY : 266|11@0+ (0.1,-102.4) [-102.4|102.30000000000001] "m/s" ASDM
 SG_ FourDRadarObjSts35VabsYStd : 287|7@0+ (0.05,0.0) [0.0|6.3500000000000005] "m/s" ASDM
 SG_ FourDRadarObjSts35ValidFlag : 64|1@0+ (1,0) [0|1] "" ASDM

CM_ SG_ 881 FourDRadarObjSts02Chks "Check sum";
CM_ SG_ 881 FourDRadarObjSts02Classification "classification";
CM_ SG_ 881 FourDRadarObjSts02Cntr "Counter";
CM_ SG_ 881 FourDRadarObjSts02DistX "4d Radar attributes";
CM_ SG_ 881 FourDRadarObjSts02DistXStd "diststd";
CM_ SG_ 881 FourDRadarObjSts02DistY "fdisty";
CM_ SG_ 881 FourDRadarObjSts02DistYStd "fdistystd";
CM_ SG_ 881 FourDRadarObjSts02DistZ "fdistz
";
CM_ SG_ 881 FourDRadarObjSts02DistZStd "4d Radar attributes";
CM_ SG_ 881 FourDRadarObjSts02DynamicProperty "dynamic Property";
CM_ SG_ 881 FourDRadarObjSts02HeadingAngle "heading angle";
CM_ SG_ 881 FourDRadarObjSts02ID "ID";
CM_ SG_ 881 FourDRadarObjSts02LifeCycles "lifecycle";
CM_ SG_ 881 FourDRadarObjSts02ObjBoundingBoxHeight "BBheight";
CM_ SG_ 881 FourDRadarObjSts02ObjBoundingBoxLength "BB Length";
CM_ SG_ 881 FourDRadarObjSts02ObjBoundingBoxWidth "Bb Width
";
CM_ SG_ 881 FourDRadarObjSts02ObjNearestPtX "4d Radar attributes";
CM_ SG_ 881 FourDRadarObjSts02ObjNearestPtY "4d Radar attributes";
CM_ SG_ 881 FourDRadarObjSts02ObjNearestPtZ "4d Radar attributes";
CM_ SG_ 881 FourDRadarObjSts02ObjSNR "SNR";
CM_ SG_ 881 FourDRadarObjSts02ObjXAccRel "xaccrel";
CM_ SG_ 881 FourDRadarObjSts02ObjYAccRel "yaccrel";
CM_ SG_ 881 FourDRadarObjSts02ObstacleProbability "ObstacleProbability";
CM_ SG_ 881 FourDRadarObjSts02ProbabilityOfExistence "probability of existence";
CM_ SG_ 881 FourDRadarObjSts02RCS "rcs
";
CM_ SG_ 881 FourDRadarObjSts02TargetClassificationConfidence "TargetClassiffication Confidence";
CM_ SG_ 881 FourDRadarObjSts02UpdateFlag "4d Radar attributes";
CM_ SG_ 881 FourDRadarObjSts02VabsX "VabsX";
CM_ SG_ 881 FourDRadarObjSts02VabsXStd "VabsXstd";
CM_ SG_ 881 FourDRadarObjSts02VabsY "VabsY";
CM_ SG_ 881 FourDRadarObjSts02VabsYStd "VabsYstd";
CM_ SG_ 881 FourDRadarObjSts02ValidFlag "ValidFlag";
CM_ SG_ 882 FourDRadarObjSts03Chks "Check Sum";
CM_ SG_ 882 FourDRadarObjSts03Classification "classification";
CM_ SG_ 882 FourDRadarObjSts03Cntr "Counter";
CM_ SG_ 882 FourDRadarObjSts03DistX "4d Radar attributes";
CM_ SG_ 882 FourDRadarObjSts03DistXStd "fdistXstd";
CM_ SG_ 882 FourDRadarObjSts03DistY "disty";
CM_ SG_ 882 FourDRadarObjSts03DistYStd "distystd";
CM_ SG_ 882 FourDRadarObjSts03DistZ "distz";
CM_ SG_ 882 FourDRadarObjSts03DistZStd "4d Radar attributes";
CM_ SG_ 882 FourDRadarObjSts03DynamicProperty "dynamicProperty";
CM_ SG_ 882 FourDRadarObjSts03HeadingAngle "Heading Angle";
CM_ SG_ 882 FourDRadarObjSts03ID "ID";
CM_ SG_ 882 FourDRadarObjSts03LifeCycles "Lifecycle";
CM_ SG_ 882 FourDRadarObjSts03ObjBoundingBoxHeight "BB height";
CM_ SG_ 882 FourDRadarObjSts03ObjBoundingBoxLength "BB length";
CM_ SG_ 882 FourDRadarObjSts03ObjBoundingBoxWidth "BB width";
CM_ SG_ 882 FourDRadarObjSts03ObjNearestPtX "4d Radar attributes";
CM_ SG_ 882 FourDRadarObjSts03ObjNearestPtY "4d Radar attributes";
CM_ SG_ 882 FourDRadarObjSts03ObjNearestPtZ "4d Radar attributes";
CM_ SG_ 882 FourDRadarObjSts03ObjSNR "SNR";
CM_ SG_ 882 FourDRadarObjSts03ObjXAccRel "xACCRel";
CM_ SG_ 882 FourDRadarObjSts03ObjYAccRel "Yaccrel";
CM_ SG_ 882 FourDRadarObjSts03ObstacleProbability "Obj probability";
CM_ SG_ 882 FourDRadarObjSts03ProbabilityOfExistence "Probabilityof Existence";
CM_ SG_ 882 FourDRadarObjSts03RCS "frsc";
CM_ SG_ 882 FourDRadarObjSts03TargetClassificationConfidence "Target Classification";
CM_ SG_ 882 FourDRadarObjSts03UpdateFlag "4d Radar attributes";
CM_ SG_ 882 FourDRadarObjSts03VabsX "Vabsx";
CM_ SG_ 882 FourDRadarObjSts03VabsXStd "VabsXstd";
CM_ SG_ 882 FourDRadarObjSts03VabsY "VabsY";
CM_ SG_ 882 FourDRadarObjSts03VabsYStd "VabsYstd";
CM_ SG_ 882 FourDRadarObjSts03ValidFlag "ValidFlag";
CM_ SG_ 883 FourDRadarObjSts05Chks "Check Sum";
CM_ SG_ 883 FourDRadarObjSts05Classification "4d Radar attributes";
CM_ SG_ 883 FourDRadarObjSts05Cntr "Counter";
CM_ SG_ 883 FourDRadarObjSts05DistX "4d Radar attributes";
CM_ SG_ 883 FourDRadarObjSts05DistXStd "4d Radar attributes";
CM_ SG_ 883 FourDRadarObjSts05DistY "4d Radar attributes";
CM_ SG_ 883 FourDRadarObjSts05DistYStd "4d Radar attributes";
CM_ SG_ 883 FourDRadarObjSts05DistZ "4d Radar attributes";
CM_ SG_ 883 FourDRadarObjSts05DistZStd "4d Radar attributes";
CM_ SG_ 883 FourDRadarObjSts05DynamicProperty "4d Radar attributes";
CM_ SG_ 883 FourDRadarObjSts05HeadingAngle "4d Radar attributes";
CM_ SG_ 883 FourDRadarObjSts05ID "4d Radar attributes";
CM_ SG_ 883 FourDRadarObjSts05LifeCycles "4d Radar attributes";
CM_ SG_ 883 FourDRadarObjSts05ObjBoundingBoxHeight "4d Radar attributes";
CM_ SG_ 883 FourDRadarObjSts05ObjBoundingBoxLength "4d Radar attributes";
CM_ SG_ 883 FourDRadarObjSts05ObjBoundingBoxWidth "4d Radar attributes";
CM_ SG_ 883 FourDRadarObjSts05ObjNearestPtX "4d Radar attributes";
CM_ SG_ 883 FourDRadarObjSts05ObjNearestPtY "4d Radar attributes";
CM_ SG_ 883 FourDRadarObjSts05ObjNearestPtZ "4d Radar attributes";
CM_ SG_ 883 FourDRadarObjSts05ObjSNR "4d Radar attributes";
CM_ SG_ 883 FourDRadarObjSts05ObjXAccRel "4d Radar attributes";
CM_ SG_ 883 FourDRadarObjSts05ObjYAccRel "4d Radar attributes";
CM_ SG_ 883 FourDRadarObjSts05ObstacleProbability "4d Radar attributes";
CM_ SG_ 883 FourDRadarObjSts05ProbabilityOfExistence "4d Radar attributes";
CM_ SG_ 883 FourDRadarObjSts05RCS "4d Radar attributes";
CM_ SG_ 883 FourDRadarObjSts05TargetClassificationConfidence "4d Radar attributes";
CM_ SG_ 883 FourDRadarObjSts05UpdateFlag "4d Radar attributes";
CM_ SG_ 883 FourDRadarObjSts05VabsX "4d Radar attributes";
CM_ SG_ 883 FourDRadarObjSts05VabsXStd "4d Radar attributes";
CM_ SG_ 883 FourDRadarObjSts05VabsY "4d Radar attributes";
CM_ SG_ 883 FourDRadarObjSts05VabsYStd "4d Radar attributes";
CM_ SG_ 883 FourDRadarObjSts05ValidFlag "4d Radar attributes";
CM_ SG_ 884 FourDRadarObjSts07Chks "4d Radar attributes";
CM_ SG_ 884 FourDRadarObjSts07Classification "4d Radar attributes";
CM_ SG_ 884 FourDRadarObjSts07Cntr "Counter";
CM_ SG_ 884 FourDRadarObjSts07DistX "4d Radar attributes";
CM_ SG_ 884 FourDRadarObjSts07DistXStd "4d Radar attributes";
CM_ SG_ 884 FourDRadarObjSts07DistY "4d Radar attributes";
CM_ SG_ 884 FourDRadarObjSts07DistYStd "4d Radar attributes";
CM_ SG_ 884 FourDRadarObjSts07DistZ "4d Radar attributes";
CM_ SG_ 884 FourDRadarObjSts07DistZStd "4d Radar attributes";
CM_ SG_ 884 FourDRadarObjSts07DynamicProperty "4d Radar attributes";
CM_ SG_ 884 FourDRadarObjSts07HeadingAngle "4d Radar attributes";
CM_ SG_ 884 FourDRadarObjSts07ID "4d Radar attributes";
CM_ SG_ 884 FourDRadarObjSts07LifeCycles "4d Radar attributes";
CM_ SG_ 884 FourDRadarObjSts07ObjBoundingBoxHeight "4d Radar attributes";
CM_ SG_ 884 FourDRadarObjSts07ObjBoundingBoxLength "4d Radar attributes";
CM_ SG_ 884 FourDRadarObjSts07ObjBoundingBoxWidth "4d Radar attributes";
CM_ SG_ 884 FourDRadarObjSts07ObjNearestPtX "4d Radar attributes";
CM_ SG_ 884 FourDRadarObjSts07ObjNearestPtY "4d Radar attributes";
CM_ SG_ 884 FourDRadarObjSts07ObjNearestPtZ "4d Radar attributes";
CM_ SG_ 884 FourDRadarObjSts07ObjSNR "4d Radar attributes";
CM_ SG_ 884 FourDRadarObjSts07ObjXAccRel "4d Radar attributes";
CM_ SG_ 884 FourDRadarObjSts07ObjYAccRel "4d Radar attributes";
CM_ SG_ 884 FourDRadarObjSts07ObstacleProbability "4d Radar attributes";
CM_ SG_ 884 FourDRadarObjSts07ProbabilityOfExistence "4d Radar attributes";
CM_ SG_ 884 FourDRadarObjSts07RCS "4d Radar attributes";
CM_ SG_ 884 FourDRadarObjSts07TargetClassificationConfidence "4d Radar attributes";
CM_ SG_ 884 FourDRadarObjSts07UpdateFlag "4d Radar attributes";
CM_ SG_ 884 FourDRadarObjSts07VabsX "4d Radar attributes";
CM_ SG_ 884 FourDRadarObjSts07VabsXStd "4d Radar attributes";
CM_ SG_ 884 FourDRadarObjSts07VabsY "4d Radar attributes";
CM_ SG_ 884 FourDRadarObjSts07VabsYStd "4d Radar attributes";
CM_ SG_ 884 FourDRadarObjSts07ValidFlag "4d Radar attributes";
CM_ SG_ 885 FourDRadarObjSts09Chks "4d Radar attributes";
CM_ SG_ 885 FourDRadarObjSts09Classification "4d Radar attributes";
CM_ SG_ 885 FourDRadarObjSts09Cntr "Counter";
CM_ SG_ 885 FourDRadarObjSts09DistX "4d Radar attributes";
CM_ SG_ 885 FourDRadarObjSts09DistXStd "4d Radar attributes";
CM_ SG_ 885 FourDRadarObjSts09DistY "4d Radar attributes";
CM_ SG_ 885 FourDRadarObjSts09DistYStd "4d Radar attributes";
CM_ SG_ 885 FourDRadarObjSts09DistZ "4d Radar attributes";
CM_ SG_ 885 FourDRadarObjSts09DistZStd "4d Radar attributes";
CM_ SG_ 885 FourDRadarObjSts09DynamicProperty "4d Radar attributes";
CM_ SG_ 885 FourDRadarObjSts09HeadingAngle "4d Radar attributes";
CM_ SG_ 885 FourDRadarObjSts09ID "4d Radar attributes";
CM_ SG_ 885 FourDRadarObjSts09LifeCycles "4d Radar attributes";
CM_ SG_ 885 FourDRadarObjSts09ObjBoundingBoxHeight "4d Radar attributes";
CM_ SG_ 885 FourDRadarObjSts09ObjBoundingBoxLength "4d Radar attributes";
CM_ SG_ 885 FourDRadarObjSts09ObjBoundingBoxWidth "4d Radar attributes";
CM_ SG_ 885 FourDRadarObjSts09ObjNearestPtX "4d Radar attributes";
CM_ SG_ 885 FourDRadarObjSts09ObjNearestPtY "4d Radar attributes";
CM_ SG_ 885 FourDRadarObjSts09ObjNearestPtZ "4d Radar attributes";
CM_ SG_ 885 FourDRadarObjSts09ObjSNR "4d Radar attributes";
CM_ SG_ 885 FourDRadarObjSts09ObjXAccRel "4d Radar attributes";
CM_ SG_ 885 FourDRadarObjSts09ObjYAccRel "4d Radar attributes";
CM_ SG_ 885 FourDRadarObjSts09ObstacleProbability "4d Radar attributes";
CM_ SG_ 885 FourDRadarObjSts09ProbabilityOfExistence "4d Radar attributes";
CM_ SG_ 885 FourDRadarObjSts09RCS "4d Radar attributes";
CM_ SG_ 885 FourDRadarObjSts09TargetClassificationConfidence "4d Radar attributes";
CM_ SG_ 885 FourDRadarObjSts09UpdateFlag "4d Radar attributes";
CM_ SG_ 885 FourDRadarObjSts09VabsX "4d Radar attributes";
CM_ SG_ 885 FourDRadarObjSts09VabsXStd "4d Radar attributes";
CM_ SG_ 885 FourDRadarObjSts09VabsY "4d Radar attributes";
CM_ SG_ 885 FourDRadarObjSts09VabsYStd "4d Radar attributes";
CM_ SG_ 885 FourDRadarObjSts09ValidFlag "4d Radar attributes";
CM_ SG_ 886 FourDRadarObjSts11Chks "4d Radar attributes";
CM_ SG_ 886 FourDRadarObjSts11Classification "4d Radar attributes";
CM_ SG_ 886 FourDRadarObjSts11Cntr "Counter";
CM_ SG_ 886 FourDRadarObjSts11DistX "4d Radar attributes";
CM_ SG_ 886 FourDRadarObjSts11DistXStd "4d Radar attributes";
CM_ SG_ 886 FourDRadarObjSts11DistY "4d Radar attributes";
CM_ SG_ 886 FourDRadarObjSts11DistYStd "4d Radar attributes";
CM_ SG_ 886 FourDRadarObjSts11DistZ "4d Radar attributes";
CM_ SG_ 886 FourDRadarObjSts11DistZStd "4d Radar attributes";
CM_ SG_ 886 FourDRadarObjSts11DynamicProperty "4d Radar attributes";
CM_ SG_ 886 FourDRadarObjSts11HeadingAngle "4d Radar attributes";
CM_ SG_ 886 FourDRadarObjSts11ID "4d Radar attributes";
CM_ SG_ 886 FourDRadarObjSts11LifeCycles "4d Radar attributes";
CM_ SG_ 886 FourDRadarObjSts11ObjBoundingBoxHeight "4d Radar attributes";
CM_ SG_ 886 FourDRadarObjSts11ObjBoundingBoxLength "4d Radar attributes";
CM_ SG_ 886 FourDRadarObjSts11ObjBoundingBoxWidth "4d Radar attributes";
CM_ SG_ 886 FourDRadarObjSts11ObjNearestPtX "4d Radar attributes";
CM_ SG_ 886 FourDRadarObjSts11ObjNearestPtY "4d Radar attributes";
CM_ SG_ 886 FourDRadarObjSts11ObjNearestPtZ "4d Radar attributes";
CM_ SG_ 886 FourDRadarObjSts11ObjSNR "4d Radar attributes";
CM_ SG_ 886 FourDRadarObjSts11ObjXAccRel "4d Radar attributes";
CM_ SG_ 886 FourDRadarObjSts11ObjYAccRel "4d Radar attributes";
CM_ SG_ 886 FourDRadarObjSts11ObstacleProbability "4d Radar attributes";
CM_ SG_ 886 FourDRadarObjSts11ProbabilityOfExistence "4d Radar attributes";
CM_ SG_ 886 FourDRadarObjSts11RCS "4d Radar attributes";
CM_ SG_ 886 FourDRadarObjSts11TargetClassificationConfidence "4d Radar attributes";
CM_ SG_ 886 FourDRadarObjSts11UpdateFlag "4d Radar attributes";
CM_ SG_ 886 FourDRadarObjSts11VabsX "4d Radar attributes";
CM_ SG_ 886 FourDRadarObjSts11VabsXStd "4d Radar attributes";
CM_ SG_ 886 FourDRadarObjSts11VabsY "4d Radar attributes";
CM_ SG_ 886 FourDRadarObjSts11VabsYStd "4d Radar attributes";
CM_ SG_ 886 FourDRadarObjSts11ValidFlag "4d Radar attributes";
CM_ SG_ 887 FourDRadarObjSts13Chks "4d Radar attributes";
CM_ SG_ 887 FourDRadarObjSts13Classification "4d Radar attributes";
CM_ SG_ 887 FourDRadarObjSts13Cntr "Counter";
CM_ SG_ 887 FourDRadarObjSts13DistX "4d Radar attributes";
CM_ SG_ 887 FourDRadarObjSts13DistXStd "4d Radar attributes";
CM_ SG_ 887 FourDRadarObjSts13DistY "4d Radar attributes";
CM_ SG_ 887 FourDRadarObjSts13DistYStd "4d Radar attributes";
CM_ SG_ 887 FourDRadarObjSts13DistZ "4d Radar attributes";
CM_ SG_ 887 FourDRadarObjSts13DistZStd "4d Radar attributes";
CM_ SG_ 887 FourDRadarObjSts13DynamicProperty "4d Radar attributes";
CM_ SG_ 887 FourDRadarObjSts13HeadingAngle "4d Radar attributes";
CM_ SG_ 887 FourDRadarObjSts13ID "4d Radar attributes";
CM_ SG_ 887 FourDRadarObjSts13LifeCycles "4d Radar attributes";
CM_ SG_ 887 FourDRadarObjSts13ObjBoundingBoxHeight "4d Radar attributes";
CM_ SG_ 887 FourDRadarObjSts13ObjBoundingBoxLength "4d Radar attributes";
CM_ SG_ 887 FourDRadarObjSts13ObjBoundingBoxWidth "4d Radar attributes";
CM_ SG_ 887 FourDRadarObjSts13ObjNearestPtX "4d Radar attributes";
CM_ SG_ 887 FourDRadarObjSts13ObjNearestPtY "4d Radar attributes";
CM_ SG_ 887 FourDRadarObjSts13ObjNearestPtZ "4d Radar attributes";
CM_ SG_ 887 FourDRadarObjSts13ObjSNR "4d Radar attributes";
CM_ SG_ 887 FourDRadarObjSts13ObjXAccRel "4d Radar attributes";
CM_ SG_ 887 FourDRadarObjSts13ObjYAccRel "4d Radar attributes";
CM_ SG_ 887 FourDRadarObjSts13ObstacleProbability "4d Radar attributes";
CM_ SG_ 887 FourDRadarObjSts13ProbabilityOfExistence "4d Radar attributes";
CM_ SG_ 887 FourDRadarObjSts13RCS "4d Radar attributes";
CM_ SG_ 887 FourDRadarObjSts13TargetClassificationConfidence "4d Radar attributes";
CM_ SG_ 887 FourDRadarObjSts13UpdateFlag "4d Radar attributes";
CM_ SG_ 887 FourDRadarObjSts13VabsX "4d Radar attributes";
CM_ SG_ 887 FourDRadarObjSts13VabsXStd "4d Radar attributes";
CM_ SG_ 887 FourDRadarObjSts13VabsY "4d Radar attributes";
CM_ SG_ 887 FourDRadarObjSts13VabsYStd "4d Radar attributes";
CM_ SG_ 887 FourDRadarObjSts13ValidFlag "4d Radar attributes";
CM_ SG_ 888 FourDRadarObjSts15Chks "4d Radar attributes";
CM_ SG_ 888 FourDRadarObjSts15Classification "4d Radar attributes";
CM_ SG_ 888 FourDRadarObjSts15Cntr "Counter";
CM_ SG_ 888 FourDRadarObjSts15DistX "4d Radar attributes";
CM_ SG_ 888 FourDRadarObjSts15DistXStd "4d Radar attributes";
CM_ SG_ 888 FourDRadarObjSts15DistY "4d Radar attributes";
CM_ SG_ 888 FourDRadarObjSts15DistYStd "4d Radar attributes";
CM_ SG_ 888 FourDRadarObjSts15DistZ "4d Radar attributes";
CM_ SG_ 888 FourDRadarObjSts15DistZStd "4d Radar attributes";
CM_ SG_ 888 FourDRadarObjSts15DynamicProperty "4d Radar attributes";
CM_ SG_ 888 FourDRadarObjSts15HeadingAngle "4d Radar attributes";
CM_ SG_ 888 FourDRadarObjSts15ID "4d Radar attributes";
CM_ SG_ 888 FourDRadarObjSts15LifeCycles "4d Radar attributes";
CM_ SG_ 888 FourDRadarObjSts15ObjBoundingBoxHeight "4d Radar attributes";
CM_ SG_ 888 FourDRadarObjSts15ObjBoundingBoxLength "4d Radar attributes";
CM_ SG_ 888 FourDRadarObjSts15ObjBoundingBoxWidth "4d Radar attributes";
CM_ SG_ 888 FourDRadarObjSts15ObjNearestPtX "4d Radar attributes";
CM_ SG_ 888 FourDRadarObjSts15ObjNearestPtY "4d Radar attributes";
CM_ SG_ 888 FourDRadarObjSts15ObjNearestPtZ "4d Radar attributes";
CM_ SG_ 888 FourDRadarObjSts15ObjSNR "4d Radar attributes";
CM_ SG_ 888 FourDRadarObjSts15ObjXAccRel "4d Radar attributes";
CM_ SG_ 888 FourDRadarObjSts15ObjYAccRel "4d Radar attributes";
CM_ SG_ 888 FourDRadarObjSts15ObstacleProbability "4d Radar attributes";
CM_ SG_ 888 FourDRadarObjSts15ProbabilityOfExistence "4d Radar attributes";
CM_ SG_ 888 FourDRadarObjSts15RCS "4d Radar attributes";
CM_ SG_ 888 FourDRadarObjSts15TargetClassificationConfidence "4d Radar attributes";
CM_ SG_ 888 FourDRadarObjSts15UpdateFlag "4d Radar attributes";
CM_ SG_ 888 FourDRadarObjSts15VabsX "4d Radar attributes";
CM_ SG_ 888 FourDRadarObjSts15VabsXStd "4d Radar attributes";
CM_ SG_ 888 FourDRadarObjSts15VabsY "4d Radar attributes";
CM_ SG_ 888 FourDRadarObjSts15VabsYStd "4d Radar attributes";
CM_ SG_ 888 FourDRadarObjSts15ValidFlag "4d Radar attributes";
CM_ SG_ 889 FourDRadarObjSts17Chks "4d Radar attributes";
CM_ SG_ 889 FourDRadarObjSts17Classification "4d Radar attributes";
CM_ SG_ 889 FourDRadarObjSts17Cntr "Counter";
CM_ SG_ 889 FourDRadarObjSts17DistX "4d Radar attributes";
CM_ SG_ 889 FourDRadarObjSts17DistXStd "4d Radar attributes";
CM_ SG_ 889 FourDRadarObjSts17DistY "4d Radar attributes";
CM_ SG_ 889 FourDRadarObjSts17DistYStd "4d Radar attributes";
CM_ SG_ 889 FourDRadarObjSts17DistZ "4d Radar attributes";
CM_ SG_ 889 FourDRadarObjSts17DistZStd "4d Radar attributes";
CM_ SG_ 889 FourDRadarObjSts17DynamicProperty "4d Radar attributes";
CM_ SG_ 889 FourDRadarObjSts17HeadingAngle "4d Radar attributes";
CM_ SG_ 889 FourDRadarObjSts17ID "4d Radar attributes";
CM_ SG_ 889 FourDRadarObjSts17LifeCycles "4d Radar attributes";
CM_ SG_ 889 FourDRadarObjSts17ObjBoundingBoxHeight "4d Radar attributes";
CM_ SG_ 889 FourDRadarObjSts17ObjBoundingBoxLength "4d Radar attributes";
CM_ SG_ 889 FourDRadarObjSts17ObjBoundingBoxWidth "4d Radar attributes";
CM_ SG_ 889 FourDRadarObjSts17ObjNearestPtX "4d Radar attributes";
CM_ SG_ 889 FourDRadarObjSts17ObjNearestPtY "4d Radar attributes";
CM_ SG_ 889 FourDRadarObjSts17ObjNearestPtZ "4d Radar attributes";
CM_ SG_ 889 FourDRadarObjSts17ObjSNR "4d Radar attributes";
CM_ SG_ 889 FourDRadarObjSts17ObjXAccRel "4d Radar attributes";
CM_ SG_ 889 FourDRadarObjSts17ObjYAccRel "4d Radar attributes";
CM_ SG_ 889 FourDRadarObjSts17ObstacleProbability "4d Radar attributes";
CM_ SG_ 889 FourDRadarObjSts17ProbabilityOfExistence "4d Radar attributes";
CM_ SG_ 889 FourDRadarObjSts17RCS "4d Radar attributes";
CM_ SG_ 889 FourDRadarObjSts17TargetClassificationConfidence "4d Radar attributes";
CM_ SG_ 889 FourDRadarObjSts17UpdateFlag "4d Radar attributes";
CM_ SG_ 889 FourDRadarObjSts17VabsX "4d Radar attributes";
CM_ SG_ 889 FourDRadarObjSts17VabsXStd "4d Radar attributes";
CM_ SG_ 889 FourDRadarObjSts17VabsY "4d Radar attributes";
CM_ SG_ 889 FourDRadarObjSts17VabsYStd "4d Radar attributes";
CM_ SG_ 889 FourDRadarObjSts17ValidFlag "4d Radar attributes";
CM_ SG_ 890 FourDRadarObjSts19Chks "4d Radar attributes";
CM_ SG_ 890 FourDRadarObjSts19Classification "4d Radar attributes";
CM_ SG_ 890 FourDRadarObjSts19Cntr "Counter";
CM_ SG_ 890 FourDRadarObjSts19DistX "4d Radar attributes";
CM_ SG_ 890 FourDRadarObjSts19DistXStd "4d Radar attributes";
CM_ SG_ 890 FourDRadarObjSts19DistY "4d Radar attributes";
CM_ SG_ 890 FourDRadarObjSts19DistYStd "4d Radar attributes";
CM_ SG_ 890 FourDRadarObjSts19DistZ "4d Radar attributes";
CM_ SG_ 890 FourDRadarObjSts19DistZStd "4d Radar attributes";
CM_ SG_ 890 FourDRadarObjSts19DynamicProperty "4d Radar attributes";
CM_ SG_ 890 FourDRadarObjSts19HeadingAngle "4d Radar attributes";
CM_ SG_ 890 FourDRadarObjSts19ID "4d Radar attributes";
CM_ SG_ 890 FourDRadarObjSts19LifeCycles "4d Radar attributes";
CM_ SG_ 890 FourDRadarObjSts19ObjBoundingBoxHeight "4d Radar attributes";
CM_ SG_ 890 FourDRadarObjSts19ObjBoundingBoxLength "4d Radar attributes";
CM_ SG_ 890 FourDRadarObjSts19ObjBoundingBoxWidth "4d Radar attributes";
CM_ SG_ 890 FourDRadarObjSts19ObjNearestPtX "4d Radar attributes";
CM_ SG_ 890 FourDRadarObjSts19ObjNearestPtY "4d Radar attributes";
CM_ SG_ 890 FourDRadarObjSts19ObjNearestPtZ "4d Radar attributes";
CM_ SG_ 890 FourDRadarObjSts19ObjSNR "4d Radar attributes";
CM_ SG_ 890 FourDRadarObjSts19ObjXAccRel "4d Radar attributes";
CM_ SG_ 890 FourDRadarObjSts19ObjYAccRel "4d Radar attributes";
CM_ SG_ 890 FourDRadarObjSts19ObstacleProbability "4d Radar attributes";
CM_ SG_ 890 FourDRadarObjSts19ProbabilityOfExistence "4d Radar attributes";
CM_ SG_ 890 FourDRadarObjSts19RCS "4d Radar attributes";
CM_ SG_ 890 FourDRadarObjSts19TargetClassificationConfidence "4d Radar attributes";
CM_ SG_ 890 FourDRadarObjSts19UpdateFlag "4d Radar attributes";
CM_ SG_ 890 FourDRadarObjSts19VabsX "4d Radar attributes";
CM_ SG_ 890 FourDRadarObjSts19VabsXStd "4d Radar attributes";
CM_ SG_ 890 FourDRadarObjSts19VabsY "4d Radar attributes";
CM_ SG_ 890 FourDRadarObjSts19VabsYStd "4d Radar attributes";
CM_ SG_ 890 FourDRadarObjSts19ValidFlag "4d Radar attributes";
CM_ SG_ 891 FourDRadarObjSts21Chks "4d Radar attributes";
CM_ SG_ 891 FourDRadarObjSts21Classification "4d Radar attributes";
CM_ SG_ 891 FourDRadarObjSts21Cntr "Counter";
CM_ SG_ 891 FourDRadarObjSts21DistX "4d Radar attributes";
CM_ SG_ 891 FourDRadarObjSts21DistXStd "4d Radar attributes";
CM_ SG_ 891 FourDRadarObjSts21DistY "4d Radar attributes";
CM_ SG_ 891 FourDRadarObjSts21DistYStd "4d Radar attributes";
CM_ SG_ 891 FourDRadarObjSts21DistZ "4d Radar attributes";
CM_ SG_ 891 FourDRadarObjSts21DistZStd "4d Radar attributes";
CM_ SG_ 891 FourDRadarObjSts21DynamicProperty "4d Radar attributes";
CM_ SG_ 891 FourDRadarObjSts21HeadingAngle "4d Radar attributes";
CM_ SG_ 891 FourDRadarObjSts21ID "4d Radar attributes";
CM_ SG_ 891 FourDRadarObjSts21LifeCycles "4d Radar attributes";
CM_ SG_ 891 FourDRadarObjSts21ObjBoundingBoxHeight "4d Radar attributes";
CM_ SG_ 891 FourDRadarObjSts21ObjBoundingBoxLength "4d Radar attributes";
CM_ SG_ 891 FourDRadarObjSts21ObjBoundingBoxWidth "4d Radar attributes";
CM_ SG_ 891 FourDRadarObjSts21ObjNearestPtX "4d Radar attributes";
CM_ SG_ 891 FourDRadarObjSts21ObjNearestPtY "4d Radar attributes";
CM_ SG_ 891 FourDRadarObjSts21ObjNearestPtZ "4d Radar attributes";
CM_ SG_ 891 FourDRadarObjSts21ObjSNR "4d Radar attributes";
CM_ SG_ 891 FourDRadarObjSts21ObjXAccRel "4d Radar attributes";
CM_ SG_ 891 FourDRadarObjSts21ObjYAccRel "4d Radar attributes";
CM_ SG_ 891 FourDRadarObjSts21ObstacleProbability "4d Radar attributes";
CM_ SG_ 891 FourDRadarObjSts21ProbabilityOfExistence "4d Radar attributes";
CM_ SG_ 891 FourDRadarObjSts21RCS "4d Radar attributes";
CM_ SG_ 891 FourDRadarObjSts21TargetClassificationConfidence "4d Radar attributes";
CM_ SG_ 891 FourDRadarObjSts21UpdateFlag "4d Radar attributes";
CM_ SG_ 891 FourDRadarObjSts21VabsX "4d Radar attributes";
CM_ SG_ 891 FourDRadarObjSts21VabsXStd "4d Radar attributes";
CM_ SG_ 891 FourDRadarObjSts21VabsY "4d Radar attributes";
CM_ SG_ 891 FourDRadarObjSts21VabsYStd "4d Radar attributes";
CM_ SG_ 891 FourDRadarObjSts21ValidFlag "4d Radar attributes";
CM_ SG_ 892 FourDRadarObjSts23Chks "4d Radar attributes";
CM_ SG_ 892 FourDRadarObjSts23Classification "4d Radar attributes";
CM_ SG_ 892 FourDRadarObjSts23Cntr "Counter";
CM_ SG_ 892 FourDRadarObjSts23DistX "4d Radar attributes";
CM_ SG_ 892 FourDRadarObjSts23DistXStd "4d Radar attributes";
CM_ SG_ 892 FourDRadarObjSts23DistY "4d Radar attributes";
CM_ SG_ 892 FourDRadarObjSts23DistYStd "4d Radar attributes";
CM_ SG_ 892 FourDRadarObjSts23DistZ "4d Radar attributes";
CM_ SG_ 892 FourDRadarObjSts23DistZStd "4d Radar attributes";
CM_ SG_ 892 FourDRadarObjSts23DynamicProperty "4d Radar attributes";
CM_ SG_ 892 FourDRadarObjSts23HeadingAngle "4d Radar attributes";
CM_ SG_ 892 FourDRadarObjSts23ID "4d Radar attributes";
CM_ SG_ 892 FourDRadarObjSts23LifeCycles "4d Radar attributes";
CM_ SG_ 892 FourDRadarObjSts23ObjBoundingBoxHeight "4d Radar attributes";
CM_ SG_ 892 FourDRadarObjSts23ObjBoundingBoxLength "4d Radar attributes";
CM_ SG_ 892 FourDRadarObjSts23ObjBoundingBoxWidth "4d Radar attributes";
CM_ SG_ 892 FourDRadarObjSts23ObjNearestPtX "4d Radar attributes";
CM_ SG_ 892 FourDRadarObjSts23ObjNearestPtY "4d Radar attributes";
CM_ SG_ 892 FourDRadarObjSts23ObjNearestPtZ "4d Radar attributes";
CM_ SG_ 892 FourDRadarObjSts23ObjSNR "4d Radar attributes";
CM_ SG_ 892 FourDRadarObjSts23ObjXAccRel "4d Radar attributes";
CM_ SG_ 892 FourDRadarObjSts23ObjYAccRel "4d Radar attributes";
CM_ SG_ 892 FourDRadarObjSts23ObstacleProbability "4d Radar attributes";
CM_ SG_ 892 FourDRadarObjSts23ProbabilityOfExistence "4d Radar attributes";
CM_ SG_ 892 FourDRadarObjSts23RCS "4d Radar attributes";
CM_ SG_ 892 FourDRadarObjSts23TargetClassificationConfidence "4d Radar attributes";
CM_ SG_ 892 FourDRadarObjSts23UpdateFlag "4d Radar attributes";
CM_ SG_ 892 FourDRadarObjSts23VabsX "4d Radar attributes";
CM_ SG_ 892 FourDRadarObjSts23VabsXStd "4d Radar attributes";
CM_ SG_ 892 FourDRadarObjSts23VabsY "4d Radar attributes";
CM_ SG_ 892 FourDRadarObjSts23VabsYStd "4d Radar attributes";
CM_ SG_ 892 FourDRadarObjSts23ValidFlag "4d Radar attributes";
CM_ SG_ 893 FourDRadarObjSts25Chks "4d Radar attributes";
CM_ SG_ 893 FourDRadarObjSts25Classification "4d Radar attributes";
CM_ SG_ 893 FourDRadarObjSts25Cntr "Counter";
CM_ SG_ 893 FourDRadarObjSts25DistX "4d Radar attributes";
CM_ SG_ 893 FourDRadarObjSts25DistXStd "4d Radar attributes";
CM_ SG_ 893 FourDRadarObjSts25DistY "4d Radar attributes";
CM_ SG_ 893 FourDRadarObjSts25DistYStd "4d Radar attributes";
CM_ SG_ 893 FourDRadarObjSts25DistZ "4d Radar attributes";
CM_ SG_ 893 FourDRadarObjSts25DistZStd "4d Radar attributes";
CM_ SG_ 893 FourDRadarObjSts25DynamicProperty "4d Radar attributes";
CM_ SG_ 893 FourDRadarObjSts25HeadingAngle "4d Radar attributes";
CM_ SG_ 893 FourDRadarObjSts25ID "4d Radar attributes";
CM_ SG_ 893 FourDRadarObjSts25LifeCycles "4d Radar attributes";
CM_ SG_ 893 FourDRadarObjSts25ObjBoundingBoxHeight "4d Radar attributes";
CM_ SG_ 893 FourDRadarObjSts25ObjBoundingBoxLength "4d Radar attributes";
CM_ SG_ 893 FourDRadarObjSts25ObjBoundingBoxWidth "4d Radar attributes";
CM_ SG_ 893 FourDRadarObjSts25ObjNearestPtX "4d Radar attributes";
CM_ SG_ 893 FourDRadarObjSts25ObjNearestPtY "4d Radar attributes";
CM_ SG_ 893 FourDRadarObjSts25ObjNearestPtZ "4d Radar attributes";
CM_ SG_ 893 FourDRadarObjSts25ObjSNR "4d Radar attributes";
CM_ SG_ 893 FourDRadarObjSts25ObjXAccRel "4d Radar attributes";
CM_ SG_ 893 FourDRadarObjSts25ObjYAccRel "4d Radar attributes";
CM_ SG_ 893 FourDRadarObjSts25ObstacleProbability "4d Radar attributes";
CM_ SG_ 893 FourDRadarObjSts25ProbabilityOfExistence "4d Radar attributes";
CM_ SG_ 893 FourDRadarObjSts25RCS "4d Radar attributes";
CM_ SG_ 893 FourDRadarObjSts25TargetClassificationConfidence "4d Radar attributes";
CM_ SG_ 893 FourDRadarObjSts25UpdateFlag "4d Radar attributes";
CM_ SG_ 893 FourDRadarObjSts25VabsX "4d Radar attributes";
CM_ SG_ 893 FourDRadarObjSts25VabsXStd "4d Radar attributes";
CM_ SG_ 893 FourDRadarObjSts25VabsY "4d Radar attributes";
CM_ SG_ 893 FourDRadarObjSts25VabsYStd "4d Radar attributes";
CM_ SG_ 893 FourDRadarObjSts25ValidFlag "4d Radar attributes";
CM_ SG_ 894 FourDRadarObjSts27Chks "4d Radar attributes";
CM_ SG_ 894 FourDRadarObjSts27Classification "4d Radar attributes";
CM_ SG_ 894 FourDRadarObjSts27Cntr "Counter";
CM_ SG_ 894 FourDRadarObjSts27DistX "4d Radar attributes";
CM_ SG_ 894 FourDRadarObjSts27DistXStd "4d Radar attributes";
CM_ SG_ 894 FourDRadarObjSts27DistY "4d Radar attributes";
CM_ SG_ 894 FourDRadarObjSts27DistYStd "4d Radar attributes";
CM_ SG_ 894 FourDRadarObjSts27DistZ "4d Radar attributes";
CM_ SG_ 894 FourDRadarObjSts27DistZStd "4d Radar attributes";
CM_ SG_ 894 FourDRadarObjSts27DynamicProperty "4d Radar attributes";
CM_ SG_ 894 FourDRadarObjSts27HeadingAngle "4d Radar attributes";
CM_ SG_ 894 FourDRadarObjSts27ID "4d Radar attributes";
CM_ SG_ 894 FourDRadarObjSts27LifeCycles "4d Radar attributes";
CM_ SG_ 894 FourDRadarObjSts27ObjBoundingBoxHeight "4d Radar attributes";
CM_ SG_ 894 FourDRadarObjSts27ObjBoundingBoxLength "4d Radar attributes";
CM_ SG_ 894 FourDRadarObjSts27ObjBoundingBoxWidth "4d Radar attributes";
CM_ SG_ 894 FourDRadarObjSts27ObjNearestPtX "4d Radar attributes";
CM_ SG_ 894 FourDRadarObjSts27ObjNearestPtY "4d Radar attributes";
CM_ SG_ 894 FourDRadarObjSts27ObjNearestPtZ "4d Radar attributes";
CM_ SG_ 894 FourDRadarObjSts27ObjSNR "4d Radar attributes";
CM_ SG_ 894 FourDRadarObjSts27ObjXAccRel "4d Radar attributes";
CM_ SG_ 894 FourDRadarObjSts27ObjYAccRel "4d Radar attributes";
CM_ SG_ 894 FourDRadarObjSts27ObstacleProbability "4d Radar attributes";
CM_ SG_ 894 FourDRadarObjSts27ProbabilityOfExistence "4d Radar attributes";
CM_ SG_ 894 FourDRadarObjSts27RCS "4d Radar attributes";
CM_ SG_ 894 FourDRadarObjSts27TargetClassificationConfidence "4d Radar attributes";
CM_ SG_ 894 FourDRadarObjSts27UpdateFlag "4d Radar attributes";
CM_ SG_ 894 FourDRadarObjSts27VabsX "4d Radar attributes";
CM_ SG_ 894 FourDRadarObjSts27VabsXStd "4d Radar attributes";
CM_ SG_ 894 FourDRadarObjSts27VabsY "4d Radar attributes";
CM_ SG_ 894 FourDRadarObjSts27VabsYStd "4d Radar attributes";
CM_ SG_ 894 FourDRadarObjSts27ValidFlag "4d Radar attributes";
CM_ SG_ 895 FourDRadarObjSts29Chks "4d Radar attributes";
CM_ SG_ 895 FourDRadarObjSts29Classification "4d Radar attributes";
CM_ SG_ 895 FourDRadarObjSts29Cntr "Counter";
CM_ SG_ 895 FourDRadarObjSts29DistX "4d Radar attributes";
CM_ SG_ 895 FourDRadarObjSts29DistXStd "4d Radar attributes";
CM_ SG_ 895 FourDRadarObjSts29DistY "4d Radar attributes";
CM_ SG_ 895 FourDRadarObjSts29DistYStd "4d Radar attributes";
CM_ SG_ 895 FourDRadarObjSts29DistZ "4d Radar attributes";
CM_ SG_ 895 FourDRadarObjSts29DistZStd "4d Radar attributes";
CM_ SG_ 895 FourDRadarObjSts29DynamicProperty "4d Radar attributes";
CM_ SG_ 895 FourDRadarObjSts29HeadingAngle "4d Radar attributes";
CM_ SG_ 895 FourDRadarObjSts29ID "4d Radar attributes";
CM_ SG_ 895 FourDRadarObjSts29LifeCycles "4d Radar attributes";
CM_ SG_ 895 FourDRadarObjSts29ObjBoundingBoxHeight "4d Radar attributes";
CM_ SG_ 895 FourDRadarObjSts29ObjBoundingBoxLength "4d Radar attributes";
CM_ SG_ 895 FourDRadarObjSts29ObjBoundingBoxWidth "4d Radar attributes";
CM_ SG_ 895 FourDRadarObjSts29ObjNearestPtX "4d Radar attributes";
CM_ SG_ 895 FourDRadarObjSts29ObjNearestPtY "4d Radar attributes";
CM_ SG_ 895 FourDRadarObjSts29ObjNearestPtZ "4d Radar attributes";
CM_ SG_ 895 FourDRadarObjSts29ObjSNR "4d Radar attributes";
CM_ SG_ 895 FourDRadarObjSts29ObjXAccRel "4d Radar attributes";
CM_ SG_ 895 FourDRadarObjSts29ObjYAccRel "4d Radar attributes";
CM_ SG_ 895 FourDRadarObjSts29ObstacleProbability "4d Radar attributes";
CM_ SG_ 895 FourDRadarObjSts29ProbabilityOfExistence "4d Radar attributes";
CM_ SG_ 895 FourDRadarObjSts29RCS "4d Radar attributes";
CM_ SG_ 895 FourDRadarObjSts29TargetClassificationConfidence "4d Radar attributes";
CM_ SG_ 895 FourDRadarObjSts29UpdateFlag "4d Radar attributes";
CM_ SG_ 895 FourDRadarObjSts29VabsX "4d Radar attributes
";
CM_ SG_ 895 FourDRadarObjSts29VabsXStd "4d Radar attributes";
CM_ SG_ 895 FourDRadarObjSts29VabsY "4d Radar attributes";
CM_ SG_ 895 FourDRadarObjSts29VabsYStd "4d Radar attributes";
CM_ SG_ 895 FourDRadarObjSts29ValidFlag "4d Radar attributes";
CM_ SG_ 896 FourDRadarObjSts31Chks "4d Radar attributes";
CM_ SG_ 896 FourDRadarObjSts31Classification "4d Radar attributes";
CM_ SG_ 896 FourDRadarObjSts31Cntr "Counter";
CM_ SG_ 896 FourDRadarObjSts31DistX "4d Radar attributes";
CM_ SG_ 896 FourDRadarObjSts31DistXStd "4d Radar attributes";
CM_ SG_ 896 FourDRadarObjSts31DistY "4d Radar attributes";
CM_ SG_ 896 FourDRadarObjSts31DistYStd "4d Radar attributes";
CM_ SG_ 896 FourDRadarObjSts31DistZ "4d Radar attributes";
CM_ SG_ 896 FourDRadarObjSts31DistZStd "4d Radar attributes";
CM_ SG_ 896 FourDRadarObjSts31DynamicProperty "4d Radar attributes";
CM_ SG_ 896 FourDRadarObjSts31HeadingAngle "4d Radar attributes";
CM_ SG_ 896 FourDRadarObjSts31ID "4d Radar attributes";
CM_ SG_ 896 FourDRadarObjSts31LifeCycles "4d Radar attributes";
CM_ SG_ 896 FourDRadarObjSts31ObjBoundingBoxHeight "4d Radar attributes";
CM_ SG_ 896 FourDRadarObjSts31ObjBoundingBoxLength "4d Radar attributes";
CM_ SG_ 896 FourDRadarObjSts31ObjBoundingBoxWidth "4d Radar attributes";
CM_ SG_ 896 FourDRadarObjSts31ObjNearestPtX "4d Radar attributes";
CM_ SG_ 896 FourDRadarObjSts31ObjNearestPtY "4d Radar attributes";
CM_ SG_ 896 FourDRadarObjSts31ObjNearestPtZ "4d Radar attributes";
CM_ SG_ 896 FourDRadarObjSts31ObjSNR "4d Radar attributes";
CM_ SG_ 896 FourDRadarObjSts31ObjXAccRel "4d Radar attributes";
CM_ SG_ 896 FourDRadarObjSts31ObjYAccRel "4d Radar attributes";
CM_ SG_ 896 FourDRadarObjSts31ObstacleProbability "4d Radar attributes";
CM_ SG_ 896 FourDRadarObjSts31ProbabilityOfExistence "4d Radar attributes";
CM_ SG_ 896 FourDRadarObjSts31RCS "4d Radar attributes";
CM_ SG_ 896 FourDRadarObjSts31TargetClassificationConfidence "4d Radar attributes";
CM_ SG_ 896 FourDRadarObjSts31UpdateFlag "4d Radar attributes";
CM_ SG_ 896 FourDRadarObjSts31VabsX "4d Radar attributes";
CM_ SG_ 896 FourDRadarObjSts31VabsXStd "4d Radar attributes";
CM_ SG_ 896 FourDRadarObjSts31VabsY "4d Radar attributes";
CM_ SG_ 896 FourDRadarObjSts31VabsYStd "4d Radar attributes";
CM_ SG_ 896 FourDRadarObjSts31ValidFlag "4d Radar attributes";
CM_ SG_ 897 FourDRadarObjSts33Chks "4d Radar attributes";
CM_ SG_ 897 FourDRadarObjSts33Classification "4d Radar attributes";
CM_ SG_ 897 FourDRadarObjSts33Cntr "Counter";
CM_ SG_ 897 FourDRadarObjSts33DistX "4d Radar attributes";
CM_ SG_ 897 FourDRadarObjSts33DistXStd "4d Radar attributes";
CM_ SG_ 897 FourDRadarObjSts33DistY "4d Radar attributes";
CM_ SG_ 897 FourDRadarObjSts33DistYStd "4d Radar attributes";
CM_ SG_ 897 FourDRadarObjSts33DistZ "4d Radar attributes";
CM_ SG_ 897 FourDRadarObjSts33DistZStd "4d Radar attributes";
CM_ SG_ 897 FourDRadarObjSts33DynamicProperty "4d Radar attributes";
CM_ SG_ 897 FourDRadarObjSts33HeadingAngle "4d Radar attributes";
CM_ SG_ 897 FourDRadarObjSts33ID "4d Radar attributes";
CM_ SG_ 897 FourDRadarObjSts33LifeCycles "4d Radar attributes";
CM_ SG_ 897 FourDRadarObjSts33ObjBoundingBoxHeight "4d Radar attributes";
CM_ SG_ 897 FourDRadarObjSts33ObjBoundingBoxLength "4d Radar attributes";
CM_ SG_ 897 FourDRadarObjSts33ObjBoundingBoxWidth "4d Radar attributes";
CM_ SG_ 897 FourDRadarObjSts33ObjNearestPtX "4d Radar attributes";
CM_ SG_ 897 FourDRadarObjSts33ObjNearestPtY "4d Radar attributes";
CM_ SG_ 897 FourDRadarObjSts33ObjNearestPtZ "4d Radar attributes";
CM_ SG_ 897 FourDRadarObjSts33ObjSNR "4d Radar attributes";
CM_ SG_ 897 FourDRadarObjSts33ObjXAccRel "4d Radar attributes";
CM_ SG_ 897 FourDRadarObjSts33ObjYAccRel "4d Radar attributes";
CM_ SG_ 897 FourDRadarObjSts33ObstacleProbability "4d Radar attributes";
CM_ SG_ 897 FourDRadarObjSts33ProbabilityOfExistence "4d Radar attributes";
CM_ SG_ 897 FourDRadarObjSts33RCS "4d Radar attributes";
CM_ SG_ 897 FourDRadarObjSts33TargetClassificationConfidence "4d Radar attributes";
CM_ SG_ 897 FourDRadarObjSts33UpdateFlag "4d Radar attributes";
CM_ SG_ 897 FourDRadarObjSts33VabsX "4d Radar attributes";
CM_ SG_ 897 FourDRadarObjSts33VabsXStd "4d Radar attributes";
CM_ SG_ 897 FourDRadarObjSts33VabsY "4d Radar attributes";
CM_ SG_ 897 FourDRadarObjSts33VabsYStd "4d Radar attributes";
CM_ SG_ 897 FourDRadarObjSts33ValidFlag "4d Radar attributes";
CM_ SG_ 898 FourDRadarObjSts35Chks "4d Radar attributes";
CM_ SG_ 898 FourDRadarObjSts35Classification "4d Radar attributes";
CM_ SG_ 898 FourDRadarObjSts35Cntr "Counter";
CM_ SG_ 898 FourDRadarObjSts35DistX "4d Radar attributes";
CM_ SG_ 898 FourDRadarObjSts35DistXStd "4d Radar attributes";
CM_ SG_ 898 FourDRadarObjSts35DistY "4d Radar attributes";
CM_ SG_ 898 FourDRadarObjSts35DistYStd "4d Radar attributes";
CM_ SG_ 898 FourDRadarObjSts35DistZ "4d Radar attributes";
CM_ SG_ 898 FourDRadarObjSts35DistZStd "4d Radar attributes";
CM_ SG_ 898 FourDRadarObjSts35DynamicProperty "4d Radar attributes";
CM_ SG_ 898 FourDRadarObjSts35HeadingAngle "4d Radar attributes";
CM_ SG_ 898 FourDRadarObjSts35ID "4d Radar attributes";
CM_ SG_ 898 FourDRadarObjSts35LifeCycles "4d Radar attributes";
CM_ SG_ 898 FourDRadarObjSts35ObjBoundingBoxHeight "4d Radar attributes";
CM_ SG_ 898 FourDRadarObjSts35ObjBoundingBoxLength "4d Radar attributes";
CM_ SG_ 898 FourDRadarObjSts35ObjBoundingBoxWidth "4d Radar attributes";
CM_ SG_ 898 FourDRadarObjSts35ObjNearestPtX "4d Radar attributes";
CM_ SG_ 898 FourDRadarObjSts35ObjNearestPtY "4d Radar attributes";
CM_ SG_ 898 FourDRadarObjSts35ObjNearestPtZ "4d Radar attributes";
CM_ SG_ 898 FourDRadarObjSts35ObjSNR "4d Radar attributes";
CM_ SG_ 898 FourDRadarObjSts35ObjXAccRel "4d Radar attributes";
CM_ SG_ 898 FourDRadarObjSts35ObjYAccRel "4d Radar attributes";
CM_ SG_ 898 FourDRadarObjSts35ObstacleProbability "4d Radar attributes";
CM_ SG_ 898 FourDRadarObjSts35ProbabilityOfExistence "4d Radar attributes";
CM_ SG_ 898 FourDRadarObjSts35RCS "4d Radar attributes";
CM_ SG_ 898 FourDRadarObjSts35TargetClassificationConfidence "4d Radar attributes";
CM_ SG_ 898 FourDRadarObjSts35UpdateFlag "4d Radar attributes";
CM_ SG_ 898 FourDRadarObjSts35VabsX "4d Radar attributes";
CM_ SG_ 898 FourDRadarObjSts35VabsXStd "4d Radar attributes";
CM_ SG_ 898 FourDRadarObjSts35VabsY "4d Radar attributes";
CM_ SG_ 898 FourDRadarObjSts35VabsYStd "4d Radar attributes";
CM_ SG_ 898 FourDRadarObjSts35ValidFlag "4d Radar attributes";
BA_DEF_ BO_ "CANFD_BRS" ENUM "0","1";
BA_DEF_ BO_ "GenMsgCycleTime" INT 0 65536; // [ms]
BA_DEF_ BO_ "GenMsgDelayTime" INT 0 65536; // [ms]
BA_DEF_ BO_ "GenMsgSendType" ENUM "cyclic", "spontaneous", "not-used", "not-used", "not-used", "cyclicAndSpontaneous", "not-used", "cyclicIfActive", "NoMsgSendType"; // [us]
BA_DEF_ BO_ "GenMsgStartDelayTime" INT 0 65536; // [ms]
BA_DEF_ BO_ "VFrameFormat" ENUM "StandardCAN","ExtendedCAN","reserved","J1939PG","reserved","reserved","reserved","reserved","reserved","reserved","reserved","reserved","reserved","reserved","StandardCAN_FD","ExtendedCAN_FD";
BA_DEF_ SG_ "GenSigSendType" ENUM "Cyclic","OnWrite","OnWriteWithRepetition","OnChange","OnChangeWithRepetition","IfActive","IfActiveWithRepetition","NoSigSendType";
BA_DEF_ SG_ "GenSigStartValue" HEX 0 80000000;
BA_DEF_ BO_ "GenMsgILSupport" ENUM "No","Yes";
BA_DEF_ BO_ "NmAsrMessage" ENUM "No","Yes";
BA_DEF_ SG_ "GenSigFuncType" ENUM "NoFunction","n/a","n/a","n/a","n/a","n/a","n/a","n/a","n/a","n/a","n/a","n/a","n/a","n/a","n/a","CHK","CNTR","n/a","n/a","n/a","CNTR_AR_01","CRC_AR_01_BOTH","CRC_AR_01_ALT","CRC_AR_01_LOW","CRC_AR_01_NIBBLE","CNTR_AR_04","CRC_AR_04A","CNTR_AR_05","CRC_AR_05";
BA_DEF_ SG_ "GenSigDataID" STRING;
BA_DEF_DEF_ "CANFD_BRS" "1";
BA_DEF_DEF_ "GenSigStartValue" 0;
BA_DEF_DEF_ "VFrameFormat" "J1939PG";
BA_DEF_DEF_ "GenSigSendType" "NoSigSendType";
BA_DEF_DEF_ "GenMsgCycleTime" 0;
BA_DEF_DEF_ "GenMsgDelayTime" 0;
BA_DEF_DEF_ "GenMsgStartDelayTime" 0;
BA_DEF_DEF_ "GenMsgSendType" "NoMsgSendType";
BA_DEF_DEF_ "GenMsgILSupport" "Yes";
BA_DEF_DEF_ "NmAsrMessage" "No";
BA_DEF_DEF_ "GenSigFuncType" "NoFunction";
BA_DEF_DEF_ "GenSigDataID" "";
// Frame: FLRSafetyCANFD2Frame66
BA_ "GenMsgCycleTime" BO_ 881 60.000;
BA_ "GenMsgSendType" BO_ 881 0;
BA_ "VFrameFormat" BO_ 881 14;
// Frame: FLRSafetyCANFD2Frame67
BA_ "GenMsgCycleTime" BO_ 882 60.000;
BA_ "GenMsgSendType" BO_ 882 0;
BA_ "VFrameFormat" BO_ 882 14;
// Frame: FLRSafetyCANFD2Frame68
BA_ "GenMsgCycleTime" BO_ 883 60.000;
BA_ "GenMsgSendType" BO_ 883 0;
BA_ "VFrameFormat" BO_ 883 14;
// Frame: FLRSafetyCANFD2Frame69
BA_ "GenMsgCycleTime" BO_ 884 60.000;
BA_ "GenMsgSendType" BO_ 884 0;
BA_ "VFrameFormat" BO_ 884 14;
// Frame: FLRSafetyCANFD2Frame70
BA_ "GenMsgCycleTime" BO_ 885 60.000;
BA_ "GenMsgSendType" BO_ 885 0;
BA_ "VFrameFormat" BO_ 885 14;
// Frame: FLRSafetyCANFD2Frame71
BA_ "GenMsgCycleTime" BO_ 886 60.000;
BA_ "GenMsgSendType" BO_ 886 0;
BA_ "VFrameFormat" BO_ 886 14;
// Frame: FLRSafetyCANFD2Frame72
BA_ "GenMsgCycleTime" BO_ 887 60.000;
BA_ "GenMsgSendType" BO_ 887 0;
BA_ "VFrameFormat" BO_ 887 14;
// Frame: FLRSafetyCANFD2Frame73
BA_ "GenMsgCycleTime" BO_ 888 60.000;
BA_ "GenMsgSendType" BO_ 888 0;
BA_ "VFrameFormat" BO_ 888 14;
// Frame: FLRSafetyCANFD2Frame74
BA_ "GenMsgCycleTime" BO_ 889 60.000;
BA_ "GenMsgSendType" BO_ 889 0;
BA_ "VFrameFormat" BO_ 889 14;
// Frame: FLRSafetyCANFD2Frame75
BA_ "GenMsgCycleTime" BO_ 890 60.000;
BA_ "GenMsgSendType" BO_ 890 0;
BA_ "VFrameFormat" BO_ 890 14;
// Frame: FLRSafetyCANFD2Frame76
BA_ "GenMsgCycleTime" BO_ 891 60.000;
BA_ "GenMsgSendType" BO_ 891 0;
BA_ "VFrameFormat" BO_ 891 14;
// Frame: FLRSafetyCANFD2Frame77
BA_ "GenMsgCycleTime" BO_ 892 60.000;
BA_ "GenMsgSendType" BO_ 892 0;
BA_ "VFrameFormat" BO_ 892 14;
// Frame: FLRSafetyCANFD2Frame78
BA_ "GenMsgCycleTime" BO_ 893 60.000;
BA_ "GenMsgSendType" BO_ 893 0;
BA_ "VFrameFormat" BO_ 893 14;
// Frame: FLRSafetyCANFD2Frame79
BA_ "GenMsgCycleTime" BO_ 894 60.000;
BA_ "GenMsgSendType" BO_ 894 0;
BA_ "VFrameFormat" BO_ 894 14;
// Frame: FLRSafetyCANFD2Frame80
BA_ "GenMsgCycleTime" BO_ 895 60.000;
BA_ "GenMsgSendType" BO_ 895 0;
BA_ "VFrameFormat" BO_ 895 14;
// Frame: FLRSafetyCANFD2Frame81
BA_ "GenMsgCycleTime" BO_ 896 60.000;
BA_ "GenMsgSendType" BO_ 896 0;
BA_ "VFrameFormat" BO_ 896 14;
// Frame: FLRSafetyCANFD2Frame82
BA_ "GenMsgCycleTime" BO_ 897 60.000;
BA_ "GenMsgSendType" BO_ 897 0;
BA_ "VFrameFormat" BO_ 897 14;
// Frame: FLRSafetyCANFD2Frame83
BA_ "GenMsgCycleTime" BO_ 898 60.000;
BA_ "GenMsgSendType" BO_ 898 0;
BA_ "VFrameFormat" BO_ 898 14;
BA_ "GenSigDataID" SG_ 881 FourDRadarObjSts02Chks "0xE04";
BA_ "GenSigFuncType" SG_ 881 FourDRadarObjSts02Chks 15;
BA_ "GenSigSendType" SG_ 881 FourDRadarObjSts02Chks 0;
BA_ "GenSigSendType" SG_ 881 FourDRadarObjSts02Classification 0;
BA_ "GenSigFuncType" SG_ 881 FourDRadarObjSts02Cntr 16;
BA_ "GenSigSendType" SG_ 881 FourDRadarObjSts02Cntr 0;
BA_ "GenSigSendType" SG_ 881 FourDRadarObjSts02DistX 0;
BA_ "GenSigStartValue" SG_ 881 FourDRadarObjSts02DistX 32768;
BA_ "GenSigSendType" SG_ 881 FourDRadarObjSts02DistXStd 0;
BA_ "GenSigSendType" SG_ 881 FourDRadarObjSts02DistY 0;
BA_ "GenSigStartValue" SG_ 881 FourDRadarObjSts02DistY 4096;
BA_ "GenSigSendType" SG_ 881 FourDRadarObjSts02DistYStd 0;
BA_ "GenSigSendType" SG_ 881 FourDRadarObjSts02DistZ 0;
BA_ "GenSigStartValue" SG_ 881 FourDRadarObjSts02DistZ 4096;
BA_ "GenSigSendType" SG_ 881 FourDRadarObjSts02DistZStd 0;
BA_ "GenSigSendType" SG_ 881 FourDRadarObjSts02DynamicProperty 0;
BA_ "GenSigSendType" SG_ 881 FourDRadarObjSts02HeadingAngle 0;
BA_ "GenSigStartValue" SG_ 881 FourDRadarObjSts02HeadingAngle 2047.78157;
BA_ "GenSigSendType" SG_ 881 FourDRadarObjSts02ID 0;
BA_ "GenSigSendType" SG_ 881 FourDRadarObjSts02LifeCycles 0;
BA_ "GenSigSendType" SG_ 881 FourDRadarObjSts02ObjBoundingBoxHeight 0;
BA_ "GenSigSendType" SG_ 881 FourDRadarObjSts02ObjBoundingBoxLength 0;
BA_ "GenSigSendType" SG_ 881 FourDRadarObjSts02ObjBoundingBoxWidth 0;
BA_ "GenSigSendType" SG_ 881 FourDRadarObjSts02ObjNearestPtX 0;
BA_ "GenSigStartValue" SG_ 881 FourDRadarObjSts02ObjNearestPtX 32768;
BA_ "GenSigSendType" SG_ 881 FourDRadarObjSts02ObjNearestPtY 0;
BA_ "GenSigStartValue" SG_ 881 FourDRadarObjSts02ObjNearestPtY 4096;
BA_ "GenSigSendType" SG_ 881 FourDRadarObjSts02ObjNearestPtZ 0;
BA_ "GenSigStartValue" SG_ 881 FourDRadarObjSts02ObjNearestPtZ 4096;
BA_ "GenSigSendType" SG_ 881 FourDRadarObjSts02ObjSNR 0;
BA_ "GenSigSendType" SG_ 881 FourDRadarObjSts02ObjXAccRel 0;
BA_ "GenSigStartValue" SG_ 881 FourDRadarObjSts02ObjXAccRel 356;
BA_ "GenSigSendType" SG_ 881 FourDRadarObjSts02ObjYAccRel 0;
BA_ "GenSigStartValue" SG_ 881 FourDRadarObjSts02ObjYAccRel 356;
BA_ "GenSigSendType" SG_ 881 FourDRadarObjSts02ObstacleProbability 0;
BA_ "GenSigSendType" SG_ 881 FourDRadarObjSts02ProbabilityOfExistence 0;
BA_ "GenSigSendType" SG_ 881 FourDRadarObjSts02RCS 0;
BA_ "GenSigStartValue" SG_ 881 FourDRadarObjSts02RCS 1000;
BA_ "GenSigSendType" SG_ 881 FourDRadarObjSts02TargetClassificationConfidence 0;
BA_ "GenSigSendType" SG_ 881 FourDRadarObjSts02UpdateFlag 0;
BA_ "GenSigSendType" SG_ 881 FourDRadarObjSts02VabsX 0;
BA_ "GenSigStartValue" SG_ 881 FourDRadarObjSts02VabsX 1024;
BA_ "GenSigSendType" SG_ 881 FourDRadarObjSts02VabsXStd 0;
BA_ "GenSigSendType" SG_ 881 FourDRadarObjSts02VabsY 0;
BA_ "GenSigStartValue" SG_ 881 FourDRadarObjSts02VabsY 1024;
BA_ "GenSigSendType" SG_ 881 FourDRadarObjSts02VabsYStd 0;
BA_ "GenSigSendType" SG_ 881 FourDRadarObjSts02ValidFlag 0;
BA_ "GenSigDataID" SG_ 882 FourDRadarObjSts03Chks "0xE05";
BA_ "GenSigFuncType" SG_ 882 FourDRadarObjSts03Chks 15;
BA_ "GenSigSendType" SG_ 882 FourDRadarObjSts03Chks 0;
BA_ "GenSigSendType" SG_ 882 FourDRadarObjSts03Classification 0;
BA_ "GenSigFuncType" SG_ 882 FourDRadarObjSts03Cntr 16;
BA_ "GenSigSendType" SG_ 882 FourDRadarObjSts03Cntr 0;
BA_ "GenSigSendType" SG_ 882 FourDRadarObjSts03DistX 0;
BA_ "GenSigStartValue" SG_ 882 FourDRadarObjSts03DistX 32768;
BA_ "GenSigSendType" SG_ 882 FourDRadarObjSts03DistXStd 0;
BA_ "GenSigSendType" SG_ 882 FourDRadarObjSts03DistY 0;
BA_ "GenSigStartValue" SG_ 882 FourDRadarObjSts03DistY 4096;
BA_ "GenSigSendType" SG_ 882 FourDRadarObjSts03DistYStd 0;
BA_ "GenSigSendType" SG_ 882 FourDRadarObjSts03DistZ 0;
BA_ "GenSigStartValue" SG_ 882 FourDRadarObjSts03DistZ 4096;
BA_ "GenSigSendType" SG_ 882 FourDRadarObjSts03DistZStd 0;
BA_ "GenSigSendType" SG_ 882 FourDRadarObjSts03DynamicProperty 0;
BA_ "GenSigSendType" SG_ 882 FourDRadarObjSts03HeadingAngle 0;
BA_ "GenSigStartValue" SG_ 882 FourDRadarObjSts03HeadingAngle 2047.78157;
BA_ "GenSigSendType" SG_ 882 FourDRadarObjSts03ID 0;
BA_ "GenSigSendType" SG_ 882 FourDRadarObjSts03LifeCycles 0;
BA_ "GenSigSendType" SG_ 882 FourDRadarObjSts03ObjBoundingBoxHeight 0;
BA_ "GenSigSendType" SG_ 882 FourDRadarObjSts03ObjBoundingBoxLength 0;
BA_ "GenSigSendType" SG_ 882 FourDRadarObjSts03ObjBoundingBoxWidth 0;
BA_ "GenSigSendType" SG_ 882 FourDRadarObjSts03ObjNearestPtX 0;
BA_ "GenSigStartValue" SG_ 882 FourDRadarObjSts03ObjNearestPtX 32768;
BA_ "GenSigSendType" SG_ 882 FourDRadarObjSts03ObjNearestPtY 0;
BA_ "GenSigStartValue" SG_ 882 FourDRadarObjSts03ObjNearestPtY 4096;
BA_ "GenSigSendType" SG_ 882 FourDRadarObjSts03ObjNearestPtZ 0;
BA_ "GenSigStartValue" SG_ 882 FourDRadarObjSts03ObjNearestPtZ 4096;
BA_ "GenSigSendType" SG_ 882 FourDRadarObjSts03ObjSNR 0;
BA_ "GenSigSendType" SG_ 882 FourDRadarObjSts03ObjXAccRel 0;
BA_ "GenSigStartValue" SG_ 882 FourDRadarObjSts03ObjXAccRel 356;
BA_ "GenSigSendType" SG_ 882 FourDRadarObjSts03ObjYAccRel 0;
BA_ "GenSigStartValue" SG_ 882 FourDRadarObjSts03ObjYAccRel 356;
BA_ "GenSigSendType" SG_ 882 FourDRadarObjSts03ObstacleProbability 0;
BA_ "GenSigSendType" SG_ 882 FourDRadarObjSts03ProbabilityOfExistence 0;
BA_ "GenSigSendType" SG_ 882 FourDRadarObjSts03RCS 0;
BA_ "GenSigStartValue" SG_ 882 FourDRadarObjSts03RCS 1000;
BA_ "GenSigSendType" SG_ 882 FourDRadarObjSts03TargetClassificationConfidence 0;
BA_ "GenSigSendType" SG_ 882 FourDRadarObjSts03UpdateFlag 0;
BA_ "GenSigSendType" SG_ 882 FourDRadarObjSts03VabsX 0;
BA_ "GenSigStartValue" SG_ 882 FourDRadarObjSts03VabsX 1024;
BA_ "GenSigSendType" SG_ 882 FourDRadarObjSts03VabsXStd 0;
BA_ "GenSigSendType" SG_ 882 FourDRadarObjSts03VabsY 0;
BA_ "GenSigStartValue" SG_ 882 FourDRadarObjSts03VabsY 1024;
BA_ "GenSigSendType" SG_ 882 FourDRadarObjSts03VabsYStd 0;
BA_ "GenSigSendType" SG_ 882 FourDRadarObjSts03ValidFlag 0;
BA_ "GenSigDataID" SG_ 883 FourDRadarObjSts05Chks "0xE07";
BA_ "GenSigFuncType" SG_ 883 FourDRadarObjSts05Chks 15;
BA_ "GenSigSendType" SG_ 883 FourDRadarObjSts05Chks 0;
BA_ "GenSigSendType" SG_ 883 FourDRadarObjSts05Classification 0;
BA_ "GenSigFuncType" SG_ 883 FourDRadarObjSts05Cntr 16;
BA_ "GenSigSendType" SG_ 883 FourDRadarObjSts05Cntr 0;
BA_ "GenSigSendType" SG_ 883 FourDRadarObjSts05DistX 0;
BA_ "GenSigStartValue" SG_ 883 FourDRadarObjSts05DistX 32768;
BA_ "GenSigSendType" SG_ 883 FourDRadarObjSts05DistXStd 0;
BA_ "GenSigSendType" SG_ 883 FourDRadarObjSts05DistY 0;
BA_ "GenSigStartValue" SG_ 883 FourDRadarObjSts05DistY 4096;
BA_ "GenSigSendType" SG_ 883 FourDRadarObjSts05DistYStd 0;
BA_ "GenSigSendType" SG_ 883 FourDRadarObjSts05DistZ 0;
BA_ "GenSigStartValue" SG_ 883 FourDRadarObjSts05DistZ 4096;
BA_ "GenSigSendType" SG_ 883 FourDRadarObjSts05DistZStd 0;
BA_ "GenSigSendType" SG_ 883 FourDRadarObjSts05DynamicProperty 0;
BA_ "GenSigSendType" SG_ 883 FourDRadarObjSts05HeadingAngle 0;
BA_ "GenSigStartValue" SG_ 883 FourDRadarObjSts05HeadingAngle 2047.78157;
BA_ "GenSigSendType" SG_ 883 FourDRadarObjSts05ID 0;
BA_ "GenSigSendType" SG_ 883 FourDRadarObjSts05LifeCycles 0;
BA_ "GenSigSendType" SG_ 883 FourDRadarObjSts05ObjBoundingBoxHeight 0;
BA_ "GenSigSendType" SG_ 883 FourDRadarObjSts05ObjBoundingBoxLength 0;
BA_ "GenSigSendType" SG_ 883 FourDRadarObjSts05ObjBoundingBoxWidth 0;
BA_ "GenSigSendType" SG_ 883 FourDRadarObjSts05ObjNearestPtX 0;
BA_ "GenSigStartValue" SG_ 883 FourDRadarObjSts05ObjNearestPtX 32768;
BA_ "GenSigSendType" SG_ 883 FourDRadarObjSts05ObjNearestPtY 0;
BA_ "GenSigStartValue" SG_ 883 FourDRadarObjSts05ObjNearestPtY 4096;
BA_ "GenSigSendType" SG_ 883 FourDRadarObjSts05ObjNearestPtZ 0;
BA_ "GenSigStartValue" SG_ 883 FourDRadarObjSts05ObjNearestPtZ 4096;
BA_ "GenSigSendType" SG_ 883 FourDRadarObjSts05ObjSNR 0;
BA_ "GenSigSendType" SG_ 883 FourDRadarObjSts05ObjXAccRel 0;
BA_ "GenSigStartValue" SG_ 883 FourDRadarObjSts05ObjXAccRel 356;
BA_ "GenSigSendType" SG_ 883 FourDRadarObjSts05ObjYAccRel 0;
BA_ "GenSigStartValue" SG_ 883 FourDRadarObjSts05ObjYAccRel 356;
BA_ "GenSigSendType" SG_ 883 FourDRadarObjSts05ObstacleProbability 0;
BA_ "GenSigSendType" SG_ 883 FourDRadarObjSts05ProbabilityOfExistence 0;
BA_ "GenSigSendType" SG_ 883 FourDRadarObjSts05RCS 0;
BA_ "GenSigStartValue" SG_ 883 FourDRadarObjSts05RCS 1000;
BA_ "GenSigSendType" SG_ 883 FourDRadarObjSts05TargetClassificationConfidence 0;
BA_ "GenSigSendType" SG_ 883 FourDRadarObjSts05UpdateFlag 0;
BA_ "GenSigSendType" SG_ 883 FourDRadarObjSts05VabsX 0;
BA_ "GenSigStartValue" SG_ 883 FourDRadarObjSts05VabsX 1024;
BA_ "GenSigSendType" SG_ 883 FourDRadarObjSts05VabsXStd 0;
BA_ "GenSigSendType" SG_ 883 FourDRadarObjSts05VabsY 0;
BA_ "GenSigStartValue" SG_ 883 FourDRadarObjSts05VabsY 1024;
BA_ "GenSigSendType" SG_ 883 FourDRadarObjSts05VabsYStd 0;
BA_ "GenSigSendType" SG_ 883 FourDRadarObjSts05ValidFlag 0;
BA_ "GenSigDataID" SG_ 884 FourDRadarObjSts07Chks "0xE09";
BA_ "GenSigFuncType" SG_ 884 FourDRadarObjSts07Chks 15;
BA_ "GenSigSendType" SG_ 884 FourDRadarObjSts07Chks 0;
BA_ "GenSigSendType" SG_ 884 FourDRadarObjSts07Classification 0;
BA_ "GenSigFuncType" SG_ 884 FourDRadarObjSts07Cntr 16;
BA_ "GenSigSendType" SG_ 884 FourDRadarObjSts07Cntr 0;
BA_ "GenSigSendType" SG_ 884 FourDRadarObjSts07DistX 0;
BA_ "GenSigStartValue" SG_ 884 FourDRadarObjSts07DistX 32768;
BA_ "GenSigSendType" SG_ 884 FourDRadarObjSts07DistXStd 0;
BA_ "GenSigSendType" SG_ 884 FourDRadarObjSts07DistY 0;
BA_ "GenSigStartValue" SG_ 884 FourDRadarObjSts07DistY 4096;
BA_ "GenSigSendType" SG_ 884 FourDRadarObjSts07DistYStd 0;
BA_ "GenSigSendType" SG_ 884 FourDRadarObjSts07DistZ 0;
BA_ "GenSigStartValue" SG_ 884 FourDRadarObjSts07DistZ 4096;
BA_ "GenSigSendType" SG_ 884 FourDRadarObjSts07DistZStd 0;
BA_ "GenSigSendType" SG_ 884 FourDRadarObjSts07DynamicProperty 0;
BA_ "GenSigSendType" SG_ 884 FourDRadarObjSts07HeadingAngle 0;
BA_ "GenSigStartValue" SG_ 884 FourDRadarObjSts07HeadingAngle 2047.78157;
BA_ "GenSigSendType" SG_ 884 FourDRadarObjSts07ID 0;
BA_ "GenSigSendType" SG_ 884 FourDRadarObjSts07LifeCycles 0;
BA_ "GenSigSendType" SG_ 884 FourDRadarObjSts07ObjBoundingBoxHeight 0;
BA_ "GenSigSendType" SG_ 884 FourDRadarObjSts07ObjBoundingBoxLength 0;
BA_ "GenSigSendType" SG_ 884 FourDRadarObjSts07ObjBoundingBoxWidth 0;
BA_ "GenSigSendType" SG_ 884 FourDRadarObjSts07ObjNearestPtX 0;
BA_ "GenSigStartValue" SG_ 884 FourDRadarObjSts07ObjNearestPtX 32768;
BA_ "GenSigSendType" SG_ 884 FourDRadarObjSts07ObjNearestPtY 0;
BA_ "GenSigStartValue" SG_ 884 FourDRadarObjSts07ObjNearestPtY 4096;
BA_ "GenSigSendType" SG_ 884 FourDRadarObjSts07ObjNearestPtZ 0;
BA_ "GenSigStartValue" SG_ 884 FourDRadarObjSts07ObjNearestPtZ 4096;
BA_ "GenSigSendType" SG_ 884 FourDRadarObjSts07ObjSNR 0;
BA_ "GenSigSendType" SG_ 884 FourDRadarObjSts07ObjXAccRel 0;
BA_ "GenSigStartValue" SG_ 884 FourDRadarObjSts07ObjXAccRel 356;
BA_ "GenSigSendType" SG_ 884 FourDRadarObjSts07ObjYAccRel 0;
BA_ "GenSigStartValue" SG_ 884 FourDRadarObjSts07ObjYAccRel 356;
BA_ "GenSigSendType" SG_ 884 FourDRadarObjSts07ObstacleProbability 0;
BA_ "GenSigSendType" SG_ 884 FourDRadarObjSts07ProbabilityOfExistence 0;
BA_ "GenSigSendType" SG_ 884 FourDRadarObjSts07RCS 0;
BA_ "GenSigStartValue" SG_ 884 FourDRadarObjSts07RCS 1000;
BA_ "GenSigSendType" SG_ 884 FourDRadarObjSts07TargetClassificationConfidence 0;
BA_ "GenSigSendType" SG_ 884 FourDRadarObjSts07UpdateFlag 0;
BA_ "GenSigSendType" SG_ 884 FourDRadarObjSts07VabsX 0;
BA_ "GenSigStartValue" SG_ 884 FourDRadarObjSts07VabsX 1024;
BA_ "GenSigSendType" SG_ 884 FourDRadarObjSts07VabsXStd 0;
BA_ "GenSigSendType" SG_ 884 FourDRadarObjSts07VabsY 0;
BA_ "GenSigStartValue" SG_ 884 FourDRadarObjSts07VabsY 1024;
BA_ "GenSigSendType" SG_ 884 FourDRadarObjSts07VabsYStd 0;
BA_ "GenSigSendType" SG_ 884 FourDRadarObjSts07ValidFlag 0;
BA_ "GenSigDataID" SG_ 885 FourDRadarObjSts09Chks "0xE0B";
BA_ "GenSigFuncType" SG_ 885 FourDRadarObjSts09Chks 15;
BA_ "GenSigSendType" SG_ 885 FourDRadarObjSts09Chks 0;
BA_ "GenSigSendType" SG_ 885 FourDRadarObjSts09Classification 0;
BA_ "GenSigFuncType" SG_ 885 FourDRadarObjSts09Cntr 16;
BA_ "GenSigSendType" SG_ 885 FourDRadarObjSts09Cntr 0;
BA_ "GenSigSendType" SG_ 885 FourDRadarObjSts09DistX 0;
BA_ "GenSigStartValue" SG_ 885 FourDRadarObjSts09DistX 32768;
BA_ "GenSigSendType" SG_ 885 FourDRadarObjSts09DistXStd 0;
BA_ "GenSigSendType" SG_ 885 FourDRadarObjSts09DistY 0;
BA_ "GenSigStartValue" SG_ 885 FourDRadarObjSts09DistY 4096;
BA_ "GenSigSendType" SG_ 885 FourDRadarObjSts09DistYStd 0;
BA_ "GenSigSendType" SG_ 885 FourDRadarObjSts09DistZ 0;
BA_ "GenSigStartValue" SG_ 885 FourDRadarObjSts09DistZ 4096;
BA_ "GenSigSendType" SG_ 885 FourDRadarObjSts09DistZStd 0;
BA_ "GenSigSendType" SG_ 885 FourDRadarObjSts09DynamicProperty 0;
BA_ "GenSigSendType" SG_ 885 FourDRadarObjSts09HeadingAngle 0;
BA_ "GenSigStartValue" SG_ 885 FourDRadarObjSts09HeadingAngle 2047.78157;
BA_ "GenSigSendType" SG_ 885 FourDRadarObjSts09ID 0;
BA_ "GenSigSendType" SG_ 885 FourDRadarObjSts09LifeCycles 0;
BA_ "GenSigSendType" SG_ 885 FourDRadarObjSts09ObjBoundingBoxHeight 0;
BA_ "GenSigSendType" SG_ 885 FourDRadarObjSts09ObjBoundingBoxLength 0;
BA_ "GenSigSendType" SG_ 885 FourDRadarObjSts09ObjBoundingBoxWidth 0;
BA_ "GenSigSendType" SG_ 885 FourDRadarObjSts09ObjNearestPtX 0;
BA_ "GenSigStartValue" SG_ 885 FourDRadarObjSts09ObjNearestPtX 32768;
BA_ "GenSigSendType" SG_ 885 FourDRadarObjSts09ObjNearestPtY 0;
BA_ "GenSigStartValue" SG_ 885 FourDRadarObjSts09ObjNearestPtY 4096;
BA_ "GenSigSendType" SG_ 885 FourDRadarObjSts09ObjNearestPtZ 0;
BA_ "GenSigStartValue" SG_ 885 FourDRadarObjSts09ObjNearestPtZ 4096;
BA_ "GenSigSendType" SG_ 885 FourDRadarObjSts09ObjSNR 0;
BA_ "GenSigSendType" SG_ 885 FourDRadarObjSts09ObjXAccRel 0;
BA_ "GenSigStartValue" SG_ 885 FourDRadarObjSts09ObjXAccRel 356;
BA_ "GenSigSendType" SG_ 885 FourDRadarObjSts09ObjYAccRel 0;
BA_ "GenSigStartValue" SG_ 885 FourDRadarObjSts09ObjYAccRel 356;
BA_ "GenSigSendType" SG_ 885 FourDRadarObjSts09ObstacleProbability 0;
BA_ "GenSigSendType" SG_ 885 FourDRadarObjSts09ProbabilityOfExistence 0;
BA_ "GenSigSendType" SG_ 885 FourDRadarObjSts09RCS 0;
BA_ "GenSigStartValue" SG_ 885 FourDRadarObjSts09RCS 1000;
BA_ "GenSigSendType" SG_ 885 FourDRadarObjSts09TargetClassificationConfidence 0;
BA_ "GenSigSendType" SG_ 885 FourDRadarObjSts09UpdateFlag 0;
BA_ "GenSigSendType" SG_ 885 FourDRadarObjSts09VabsX 0;
BA_ "GenSigStartValue" SG_ 885 FourDRadarObjSts09VabsX 1024;
BA_ "GenSigSendType" SG_ 885 FourDRadarObjSts09VabsXStd 0;
BA_ "GenSigSendType" SG_ 885 FourDRadarObjSts09VabsY 0;
BA_ "GenSigStartValue" SG_ 885 FourDRadarObjSts09VabsY 1024;
BA_ "GenSigSendType" SG_ 885 FourDRadarObjSts09VabsYStd 0;
BA_ "GenSigSendType" SG_ 885 FourDRadarObjSts09ValidFlag 0;
BA_ "GenSigDataID" SG_ 886 FourDRadarObjSts11Chks "0xE0D";
BA_ "GenSigFuncType" SG_ 886 FourDRadarObjSts11Chks 15;
BA_ "GenSigSendType" SG_ 886 FourDRadarObjSts11Chks 0;
BA_ "GenSigSendType" SG_ 886 FourDRadarObjSts11Classification 0;
BA_ "GenSigFuncType" SG_ 886 FourDRadarObjSts11Cntr 16;
BA_ "GenSigSendType" SG_ 886 FourDRadarObjSts11Cntr 0;
BA_ "GenSigSendType" SG_ 886 FourDRadarObjSts11DistX 0;
BA_ "GenSigStartValue" SG_ 886 FourDRadarObjSts11DistX 32768;
BA_ "GenSigSendType" SG_ 886 FourDRadarObjSts11DistXStd 0;
BA_ "GenSigSendType" SG_ 886 FourDRadarObjSts11DistY 0;
BA_ "GenSigStartValue" SG_ 886 FourDRadarObjSts11DistY 4096;
BA_ "GenSigSendType" SG_ 886 FourDRadarObjSts11DistYStd 0;
BA_ "GenSigSendType" SG_ 886 FourDRadarObjSts11DistZ 0;
BA_ "GenSigStartValue" SG_ 886 FourDRadarObjSts11DistZ 4096;
BA_ "GenSigSendType" SG_ 886 FourDRadarObjSts11DistZStd 0;
BA_ "GenSigSendType" SG_ 886 FourDRadarObjSts11DynamicProperty 0;
BA_ "GenSigSendType" SG_ 886 FourDRadarObjSts11HeadingAngle 0;
BA_ "GenSigStartValue" SG_ 886 FourDRadarObjSts11HeadingAngle 2047.78157;
BA_ "GenSigSendType" SG_ 886 FourDRadarObjSts11ID 0;
BA_ "GenSigSendType" SG_ 886 FourDRadarObjSts11LifeCycles 0;
BA_ "GenSigSendType" SG_ 886 FourDRadarObjSts11ObjBoundingBoxHeight 0;
BA_ "GenSigSendType" SG_ 886 FourDRadarObjSts11ObjBoundingBoxLength 0;
BA_ "GenSigSendType" SG_ 886 FourDRadarObjSts11ObjBoundingBoxWidth 0;
BA_ "GenSigSendType" SG_ 886 FourDRadarObjSts11ObjNearestPtX 0;
BA_ "GenSigStartValue" SG_ 886 FourDRadarObjSts11ObjNearestPtX 32768;
BA_ "GenSigSendType" SG_ 886 FourDRadarObjSts11ObjNearestPtY 0;
BA_ "GenSigStartValue" SG_ 886 FourDRadarObjSts11ObjNearestPtY 4096;
BA_ "GenSigSendType" SG_ 886 FourDRadarObjSts11ObjNearestPtZ 0;
BA_ "GenSigStartValue" SG_ 886 FourDRadarObjSts11ObjNearestPtZ 4096;
BA_ "GenSigSendType" SG_ 886 FourDRadarObjSts11ObjSNR 0;
BA_ "GenSigSendType" SG_ 886 FourDRadarObjSts11ObjXAccRel 0;
BA_ "GenSigStartValue" SG_ 886 FourDRadarObjSts11ObjXAccRel 356;
BA_ "GenSigSendType" SG_ 886 FourDRadarObjSts11ObjYAccRel 0;
BA_ "GenSigStartValue" SG_ 886 FourDRadarObjSts11ObjYAccRel 356;
BA_ "GenSigSendType" SG_ 886 FourDRadarObjSts11ObstacleProbability 0;
BA_ "GenSigSendType" SG_ 886 FourDRadarObjSts11ProbabilityOfExistence 0;
BA_ "GenSigSendType" SG_ 886 FourDRadarObjSts11RCS 0;
BA_ "GenSigStartValue" SG_ 886 FourDRadarObjSts11RCS 1000;
BA_ "GenSigSendType" SG_ 886 FourDRadarObjSts11TargetClassificationConfidence 0;
BA_ "GenSigSendType" SG_ 886 FourDRadarObjSts11UpdateFlag 0;
BA_ "GenSigSendType" SG_ 886 FourDRadarObjSts11VabsX 0;
BA_ "GenSigStartValue" SG_ 886 FourDRadarObjSts11VabsX 1024;
BA_ "GenSigSendType" SG_ 886 FourDRadarObjSts11VabsXStd 0;
BA_ "GenSigSendType" SG_ 886 FourDRadarObjSts11VabsY 0;
BA_ "GenSigStartValue" SG_ 886 FourDRadarObjSts11VabsY 1024;
BA_ "GenSigSendType" SG_ 886 FourDRadarObjSts11VabsYStd 0;
BA_ "GenSigSendType" SG_ 886 FourDRadarObjSts11ValidFlag 0;
BA_ "GenSigDataID" SG_ 887 FourDRadarObjSts13Chks "0xE0F";
BA_ "GenSigFuncType" SG_ 887 FourDRadarObjSts13Chks 15;
BA_ "GenSigSendType" SG_ 887 FourDRadarObjSts13Chks 0;
BA_ "GenSigSendType" SG_ 887 FourDRadarObjSts13Classification 0;
BA_ "GenSigFuncType" SG_ 887 FourDRadarObjSts13Cntr 16;
BA_ "GenSigSendType" SG_ 887 FourDRadarObjSts13Cntr 0;
BA_ "GenSigSendType" SG_ 887 FourDRadarObjSts13DistX 0;
BA_ "GenSigStartValue" SG_ 887 FourDRadarObjSts13DistX 32768;
BA_ "GenSigSendType" SG_ 887 FourDRadarObjSts13DistXStd 0;
BA_ "GenSigSendType" SG_ 887 FourDRadarObjSts13DistY 0;
BA_ "GenSigStartValue" SG_ 887 FourDRadarObjSts13DistY 4096;
BA_ "GenSigSendType" SG_ 887 FourDRadarObjSts13DistYStd 0;
BA_ "GenSigSendType" SG_ 887 FourDRadarObjSts13DistZ 0;
BA_ "GenSigStartValue" SG_ 887 FourDRadarObjSts13DistZ 4096;
BA_ "GenSigSendType" SG_ 887 FourDRadarObjSts13DistZStd 0;
BA_ "GenSigSendType" SG_ 887 FourDRadarObjSts13DynamicProperty 0;
BA_ "GenSigSendType" SG_ 887 FourDRadarObjSts13HeadingAngle 0;
BA_ "GenSigStartValue" SG_ 887 FourDRadarObjSts13HeadingAngle 2047.78157;
BA_ "GenSigSendType" SG_ 887 FourDRadarObjSts13ID 0;
BA_ "GenSigSendType" SG_ 887 FourDRadarObjSts13LifeCycles 0;
BA_ "GenSigSendType" SG_ 887 FourDRadarObjSts13ObjBoundingBoxHeight 0;
BA_ "GenSigSendType" SG_ 887 FourDRadarObjSts13ObjBoundingBoxLength 0;
BA_ "GenSigSendType" SG_ 887 FourDRadarObjSts13ObjBoundingBoxWidth 0;
BA_ "GenSigSendType" SG_ 887 FourDRadarObjSts13ObjNearestPtX 0;
BA_ "GenSigStartValue" SG_ 887 FourDRadarObjSts13ObjNearestPtX 32768;
BA_ "GenSigSendType" SG_ 887 FourDRadarObjSts13ObjNearestPtY 0;
BA_ "GenSigStartValue" SG_ 887 FourDRadarObjSts13ObjNearestPtY 4096;
BA_ "GenSigSendType" SG_ 887 FourDRadarObjSts13ObjNearestPtZ 0;
BA_ "GenSigStartValue" SG_ 887 FourDRadarObjSts13ObjNearestPtZ 4096;
BA_ "GenSigSendType" SG_ 887 FourDRadarObjSts13ObjSNR 0;
BA_ "GenSigSendType" SG_ 887 FourDRadarObjSts13ObjXAccRel 0;
BA_ "GenSigStartValue" SG_ 887 FourDRadarObjSts13ObjXAccRel 356;
BA_ "GenSigSendType" SG_ 887 FourDRadarObjSts13ObjYAccRel 0;
BA_ "GenSigStartValue" SG_ 887 FourDRadarObjSts13ObjYAccRel 356;
BA_ "GenSigSendType" SG_ 887 FourDRadarObjSts13ObstacleProbability 0;
BA_ "GenSigSendType" SG_ 887 FourDRadarObjSts13ProbabilityOfExistence 0;
BA_ "GenSigSendType" SG_ 887 FourDRadarObjSts13RCS 0;
BA_ "GenSigStartValue" SG_ 887 FourDRadarObjSts13RCS 1000;
BA_ "GenSigSendType" SG_ 887 FourDRadarObjSts13TargetClassificationConfidence 0;
BA_ "GenSigSendType" SG_ 887 FourDRadarObjSts13UpdateFlag 0;
BA_ "GenSigSendType" SG_ 887 FourDRadarObjSts13VabsX 0;
BA_ "GenSigStartValue" SG_ 887 FourDRadarObjSts13VabsX 1024;
BA_ "GenSigSendType" SG_ 887 FourDRadarObjSts13VabsXStd 0;
BA_ "GenSigSendType" SG_ 887 FourDRadarObjSts13VabsY 0;
BA_ "GenSigStartValue" SG_ 887 FourDRadarObjSts13VabsY 1024;
BA_ "GenSigSendType" SG_ 887 FourDRadarObjSts13VabsYStd 0;
BA_ "GenSigSendType" SG_ 887 FourDRadarObjSts13ValidFlag 0;
BA_ "GenSigDataID" SG_ 888 FourDRadarObjSts15Chks "0xE11";
BA_ "GenSigFuncType" SG_ 888 FourDRadarObjSts15Chks 15;
BA_ "GenSigSendType" SG_ 888 FourDRadarObjSts15Chks 0;
BA_ "GenSigSendType" SG_ 888 FourDRadarObjSts15Classification 0;
BA_ "GenSigFuncType" SG_ 888 FourDRadarObjSts15Cntr 16;
BA_ "GenSigSendType" SG_ 888 FourDRadarObjSts15Cntr 0;
BA_ "GenSigSendType" SG_ 888 FourDRadarObjSts15DistX 0;
BA_ "GenSigStartValue" SG_ 888 FourDRadarObjSts15DistX 32768;
BA_ "GenSigSendType" SG_ 888 FourDRadarObjSts15DistXStd 0;
BA_ "GenSigSendType" SG_ 888 FourDRadarObjSts15DistY 0;
BA_ "GenSigStartValue" SG_ 888 FourDRadarObjSts15DistY 4096;
BA_ "GenSigSendType" SG_ 888 FourDRadarObjSts15DistYStd 0;
BA_ "GenSigSendType" SG_ 888 FourDRadarObjSts15DistZ 0;
BA_ "GenSigStartValue" SG_ 888 FourDRadarObjSts15DistZ 4096;
BA_ "GenSigSendType" SG_ 888 FourDRadarObjSts15DistZStd 0;
BA_ "GenSigSendType" SG_ 888 FourDRadarObjSts15DynamicProperty 0;
BA_ "GenSigSendType" SG_ 888 FourDRadarObjSts15HeadingAngle 0;
BA_ "GenSigStartValue" SG_ 888 FourDRadarObjSts15HeadingAngle 2047.78157;
BA_ "GenSigSendType" SG_ 888 FourDRadarObjSts15ID 0;
BA_ "GenSigSendType" SG_ 888 FourDRadarObjSts15LifeCycles 0;
BA_ "GenSigSendType" SG_ 888 FourDRadarObjSts15ObjBoundingBoxHeight 0;
BA_ "GenSigSendType" SG_ 888 FourDRadarObjSts15ObjBoundingBoxLength 0;
BA_ "GenSigSendType" SG_ 888 FourDRadarObjSts15ObjBoundingBoxWidth 0;
BA_ "GenSigSendType" SG_ 888 FourDRadarObjSts15ObjNearestPtX 0;
BA_ "GenSigStartValue" SG_ 888 FourDRadarObjSts15ObjNearestPtX 32768;
BA_ "GenSigSendType" SG_ 888 FourDRadarObjSts15ObjNearestPtY 0;
BA_ "GenSigStartValue" SG_ 888 FourDRadarObjSts15ObjNearestPtY 4096;
BA_ "GenSigSendType" SG_ 888 FourDRadarObjSts15ObjNearestPtZ 0;
BA_ "GenSigStartValue" SG_ 888 FourDRadarObjSts15ObjNearestPtZ 4096;
BA_ "GenSigSendType" SG_ 888 FourDRadarObjSts15ObjSNR 0;
BA_ "GenSigSendType" SG_ 888 FourDRadarObjSts15ObjXAccRel 0;
BA_ "GenSigStartValue" SG_ 888 FourDRadarObjSts15ObjXAccRel 356;
BA_ "GenSigSendType" SG_ 888 FourDRadarObjSts15ObjYAccRel 0;
BA_ "GenSigStartValue" SG_ 888 FourDRadarObjSts15ObjYAccRel 356;
BA_ "GenSigSendType" SG_ 888 FourDRadarObjSts15ObstacleProbability 0;
BA_ "GenSigSendType" SG_ 888 FourDRadarObjSts15ProbabilityOfExistence 0;
BA_ "GenSigSendType" SG_ 888 FourDRadarObjSts15RCS 0;
BA_ "GenSigStartValue" SG_ 888 FourDRadarObjSts15RCS 1000;
BA_ "GenSigSendType" SG_ 888 FourDRadarObjSts15TargetClassificationConfidence 0;
BA_ "GenSigSendType" SG_ 888 FourDRadarObjSts15UpdateFlag 0;
BA_ "GenSigSendType" SG_ 888 FourDRadarObjSts15VabsX 0;
BA_ "GenSigStartValue" SG_ 888 FourDRadarObjSts15VabsX 1024;
BA_ "GenSigSendType" SG_ 888 FourDRadarObjSts15VabsXStd 0;
BA_ "GenSigSendType" SG_ 888 FourDRadarObjSts15VabsY 0;
BA_ "GenSigStartValue" SG_ 888 FourDRadarObjSts15VabsY 1024;
BA_ "GenSigSendType" SG_ 888 FourDRadarObjSts15VabsYStd 0;
BA_ "GenSigSendType" SG_ 888 FourDRadarObjSts15ValidFlag 0;
BA_ "GenSigDataID" SG_ 889 FourDRadarObjSts17Chks "0xE13";
BA_ "GenSigFuncType" SG_ 889 FourDRadarObjSts17Chks 15;
BA_ "GenSigSendType" SG_ 889 FourDRadarObjSts17Chks 0;
BA_ "GenSigSendType" SG_ 889 FourDRadarObjSts17Classification 0;
BA_ "GenSigFuncType" SG_ 889 FourDRadarObjSts17Cntr 16;
BA_ "GenSigSendType" SG_ 889 FourDRadarObjSts17Cntr 0;
BA_ "GenSigSendType" SG_ 889 FourDRadarObjSts17DistX 0;
BA_ "GenSigStartValue" SG_ 889 FourDRadarObjSts17DistX 32768;
BA_ "GenSigSendType" SG_ 889 FourDRadarObjSts17DistXStd 0;
BA_ "GenSigSendType" SG_ 889 FourDRadarObjSts17DistY 0;
BA_ "GenSigStartValue" SG_ 889 FourDRadarObjSts17DistY 4096;
BA_ "GenSigSendType" SG_ 889 FourDRadarObjSts17DistYStd 0;
BA_ "GenSigSendType" SG_ 889 FourDRadarObjSts17DistZ 0;
BA_ "GenSigStartValue" SG_ 889 FourDRadarObjSts17DistZ 4096;
BA_ "GenSigSendType" SG_ 889 FourDRadarObjSts17DistZStd 0;
BA_ "GenSigSendType" SG_ 889 FourDRadarObjSts17DynamicProperty 0;
BA_ "GenSigSendType" SG_ 889 FourDRadarObjSts17HeadingAngle 0;
BA_ "GenSigStartValue" SG_ 889 FourDRadarObjSts17HeadingAngle 2047.78157;
BA_ "GenSigSendType" SG_ 889 FourDRadarObjSts17ID 0;
BA_ "GenSigSendType" SG_ 889 FourDRadarObjSts17LifeCycles 0;
BA_ "GenSigSendType" SG_ 889 FourDRadarObjSts17ObjBoundingBoxHeight 0;
BA_ "GenSigSendType" SG_ 889 FourDRadarObjSts17ObjBoundingBoxLength 0;
BA_ "GenSigSendType" SG_ 889 FourDRadarObjSts17ObjBoundingBoxWidth 0;
BA_ "GenSigSendType" SG_ 889 FourDRadarObjSts17ObjNearestPtX 0;
BA_ "GenSigStartValue" SG_ 889 FourDRadarObjSts17ObjNearestPtX 32768;
BA_ "GenSigSendType" SG_ 889 FourDRadarObjSts17ObjNearestPtY 0;
BA_ "GenSigStartValue" SG_ 889 FourDRadarObjSts17ObjNearestPtY 4096;
BA_ "GenSigSendType" SG_ 889 FourDRadarObjSts17ObjNearestPtZ 0;
BA_ "GenSigStartValue" SG_ 889 FourDRadarObjSts17ObjNearestPtZ 4096;
BA_ "GenSigSendType" SG_ 889 FourDRadarObjSts17ObjSNR 0;
BA_ "GenSigSendType" SG_ 889 FourDRadarObjSts17ObjXAccRel 0;
BA_ "GenSigStartValue" SG_ 889 FourDRadarObjSts17ObjXAccRel 356;
BA_ "GenSigSendType" SG_ 889 FourDRadarObjSts17ObjYAccRel 0;
BA_ "GenSigStartValue" SG_ 889 FourDRadarObjSts17ObjYAccRel 356;
BA_ "GenSigSendType" SG_ 889 FourDRadarObjSts17ObstacleProbability 0;
BA_ "GenSigSendType" SG_ 889 FourDRadarObjSts17ProbabilityOfExistence 0;
BA_ "GenSigSendType" SG_ 889 FourDRadarObjSts17RCS 0;
BA_ "GenSigStartValue" SG_ 889 FourDRadarObjSts17RCS 1000;
BA_ "GenSigSendType" SG_ 889 FourDRadarObjSts17TargetClassificationConfidence 0;
BA_ "GenSigSendType" SG_ 889 FourDRadarObjSts17UpdateFlag 0;
BA_ "GenSigSendType" SG_ 889 FourDRadarObjSts17VabsX 0;
BA_ "GenSigStartValue" SG_ 889 FourDRadarObjSts17VabsX 1024;
BA_ "GenSigSendType" SG_ 889 FourDRadarObjSts17VabsXStd 0;
BA_ "GenSigSendType" SG_ 889 FourDRadarObjSts17VabsY 0;
BA_ "GenSigStartValue" SG_ 889 FourDRadarObjSts17VabsY 1024;
BA_ "GenSigSendType" SG_ 889 FourDRadarObjSts17VabsYStd 0;
BA_ "GenSigSendType" SG_ 889 FourDRadarObjSts17ValidFlag 0;
BA_ "GenSigDataID" SG_ 890 FourDRadarObjSts19Chks "0xE15";
BA_ "GenSigFuncType" SG_ 890 FourDRadarObjSts19Chks 15;
BA_ "GenSigSendType" SG_ 890 FourDRadarObjSts19Chks 0;
BA_ "GenSigSendType" SG_ 890 FourDRadarObjSts19Classification 0;
BA_ "GenSigFuncType" SG_ 890 FourDRadarObjSts19Cntr 16;
BA_ "GenSigSendType" SG_ 890 FourDRadarObjSts19Cntr 0;
BA_ "GenSigSendType" SG_ 890 FourDRadarObjSts19DistX 0;
BA_ "GenSigStartValue" SG_ 890 FourDRadarObjSts19DistX 32768;
BA_ "GenSigSendType" SG_ 890 FourDRadarObjSts19DistXStd 0;
BA_ "GenSigSendType" SG_ 890 FourDRadarObjSts19DistY 0;
BA_ "GenSigStartValue" SG_ 890 FourDRadarObjSts19DistY 4096;
BA_ "GenSigSendType" SG_ 890 FourDRadarObjSts19DistYStd 0;
BA_ "GenSigSendType" SG_ 890 FourDRadarObjSts19DistZ 0;
BA_ "GenSigStartValue" SG_ 890 FourDRadarObjSts19DistZ 4096;
BA_ "GenSigSendType" SG_ 890 FourDRadarObjSts19DistZStd 0;
BA_ "GenSigSendType" SG_ 890 FourDRadarObjSts19DynamicProperty 0;
BA_ "GenSigSendType" SG_ 890 FourDRadarObjSts19HeadingAngle 0;
BA_ "GenSigStartValue" SG_ 890 FourDRadarObjSts19HeadingAngle 2047.78157;
BA_ "GenSigSendType" SG_ 890 FourDRadarObjSts19ID 0;
BA_ "GenSigSendType" SG_ 890 FourDRadarObjSts19LifeCycles 0;
BA_ "GenSigSendType" SG_ 890 FourDRadarObjSts19ObjBoundingBoxHeight 0;
BA_ "GenSigSendType" SG_ 890 FourDRadarObjSts19ObjBoundingBoxLength 0;
BA_ "GenSigSendType" SG_ 890 FourDRadarObjSts19ObjBoundingBoxWidth 0;
BA_ "GenSigSendType" SG_ 890 FourDRadarObjSts19ObjNearestPtX 0;
BA_ "GenSigStartValue" SG_ 890 FourDRadarObjSts19ObjNearestPtX 32768;
BA_ "GenSigSendType" SG_ 890 FourDRadarObjSts19ObjNearestPtY 0;
BA_ "GenSigStartValue" SG_ 890 FourDRadarObjSts19ObjNearestPtY 4096;
BA_ "GenSigSendType" SG_ 890 FourDRadarObjSts19ObjNearestPtZ 0;
BA_ "GenSigStartValue" SG_ 890 FourDRadarObjSts19ObjNearestPtZ 4096;
BA_ "GenSigSendType" SG_ 890 FourDRadarObjSts19ObjSNR 0;
BA_ "GenSigSendType" SG_ 890 FourDRadarObjSts19ObjXAccRel 0;
BA_ "GenSigStartValue" SG_ 890 FourDRadarObjSts19ObjXAccRel 356;
BA_ "GenSigSendType" SG_ 890 FourDRadarObjSts19ObjYAccRel 0;
BA_ "GenSigStartValue" SG_ 890 FourDRadarObjSts19ObjYAccRel 356;
BA_ "GenSigSendType" SG_ 890 FourDRadarObjSts19ObstacleProbability 0;
BA_ "GenSigSendType" SG_ 890 FourDRadarObjSts19ProbabilityOfExistence 0;
BA_ "GenSigSendType" SG_ 890 FourDRadarObjSts19RCS 0;
BA_ "GenSigStartValue" SG_ 890 FourDRadarObjSts19RCS 1000;
BA_ "GenSigSendType" SG_ 890 FourDRadarObjSts19TargetClassificationConfidence 0;
BA_ "GenSigSendType" SG_ 890 FourDRadarObjSts19UpdateFlag 0;
BA_ "GenSigSendType" SG_ 890 FourDRadarObjSts19VabsX 0;
BA_ "GenSigStartValue" SG_ 890 FourDRadarObjSts19VabsX 1024;
BA_ "GenSigSendType" SG_ 890 FourDRadarObjSts19VabsXStd 0;
BA_ "GenSigSendType" SG_ 890 FourDRadarObjSts19VabsY 0;
BA_ "GenSigStartValue" SG_ 890 FourDRadarObjSts19VabsY 1024;
BA_ "GenSigSendType" SG_ 890 FourDRadarObjSts19VabsYStd 0;
BA_ "GenSigSendType" SG_ 890 FourDRadarObjSts19ValidFlag 0;
BA_ "GenSigDataID" SG_ 891 FourDRadarObjSts21Chks "0xE17";
BA_ "GenSigFuncType" SG_ 891 FourDRadarObjSts21Chks 15;
BA_ "GenSigSendType" SG_ 891 FourDRadarObjSts21Chks 0;
BA_ "GenSigSendType" SG_ 891 FourDRadarObjSts21Classification 0;
BA_ "GenSigFuncType" SG_ 891 FourDRadarObjSts21Cntr 16;
BA_ "GenSigSendType" SG_ 891 FourDRadarObjSts21Cntr 0;
BA_ "GenSigSendType" SG_ 891 FourDRadarObjSts21DistX 0;
BA_ "GenSigStartValue" SG_ 891 FourDRadarObjSts21DistX 32768;
BA_ "GenSigSendType" SG_ 891 FourDRadarObjSts21DistXStd 0;
BA_ "GenSigSendType" SG_ 891 FourDRadarObjSts21DistY 0;
BA_ "GenSigStartValue" SG_ 891 FourDRadarObjSts21DistY 4096;
BA_ "GenSigSendType" SG_ 891 FourDRadarObjSts21DistYStd 0;
BA_ "GenSigSendType" SG_ 891 FourDRadarObjSts21DistZ 0;
BA_ "GenSigStartValue" SG_ 891 FourDRadarObjSts21DistZ 4096;
BA_ "GenSigSendType" SG_ 891 FourDRadarObjSts21DistZStd 0;
BA_ "GenSigSendType" SG_ 891 FourDRadarObjSts21DynamicProperty 0;
BA_ "GenSigSendType" SG_ 891 FourDRadarObjSts21HeadingAngle 0;
BA_ "GenSigStartValue" SG_ 891 FourDRadarObjSts21HeadingAngle 2047.78157;
BA_ "GenSigSendType" SG_ 891 FourDRadarObjSts21ID 0;
BA_ "GenSigSendType" SG_ 891 FourDRadarObjSts21LifeCycles 0;
BA_ "GenSigSendType" SG_ 891 FourDRadarObjSts21ObjBoundingBoxHeight 0;
BA_ "GenSigSendType" SG_ 891 FourDRadarObjSts21ObjBoundingBoxLength 0;
BA_ "GenSigSendType" SG_ 891 FourDRadarObjSts21ObjBoundingBoxWidth 0;
BA_ "GenSigSendType" SG_ 891 FourDRadarObjSts21ObjNearestPtX 0;
BA_ "GenSigStartValue" SG_ 891 FourDRadarObjSts21ObjNearestPtX 32768;
BA_ "GenSigSendType" SG_ 891 FourDRadarObjSts21ObjNearestPtY 0;
BA_ "GenSigStartValue" SG_ 891 FourDRadarObjSts21ObjNearestPtY 4096;
BA_ "GenSigSendType" SG_ 891 FourDRadarObjSts21ObjNearestPtZ 0;
BA_ "GenSigStartValue" SG_ 891 FourDRadarObjSts21ObjNearestPtZ 4096;
BA_ "GenSigSendType" SG_ 891 FourDRadarObjSts21ObjSNR 0;
BA_ "GenSigSendType" SG_ 891 FourDRadarObjSts21ObjXAccRel 0;
BA_ "GenSigStartValue" SG_ 891 FourDRadarObjSts21ObjXAccRel 356;
BA_ "GenSigSendType" SG_ 891 FourDRadarObjSts21ObjYAccRel 0;
BA_ "GenSigStartValue" SG_ 891 FourDRadarObjSts21ObjYAccRel 356;
BA_ "GenSigSendType" SG_ 891 FourDRadarObjSts21ObstacleProbability 0;
BA_ "GenSigSendType" SG_ 891 FourDRadarObjSts21ProbabilityOfExistence 0;
BA_ "GenSigSendType" SG_ 891 FourDRadarObjSts21RCS 0;
BA_ "GenSigStartValue" SG_ 891 FourDRadarObjSts21RCS 1000;
BA_ "GenSigSendType" SG_ 891 FourDRadarObjSts21TargetClassificationConfidence 0;
BA_ "GenSigSendType" SG_ 891 FourDRadarObjSts21UpdateFlag 0;
BA_ "GenSigSendType" SG_ 891 FourDRadarObjSts21VabsX 0;
BA_ "GenSigStartValue" SG_ 891 FourDRadarObjSts21VabsX 1024;
BA_ "GenSigSendType" SG_ 891 FourDRadarObjSts21VabsXStd 0;
BA_ "GenSigSendType" SG_ 891 FourDRadarObjSts21VabsY 0;
BA_ "GenSigStartValue" SG_ 891 FourDRadarObjSts21VabsY 1024;
BA_ "GenSigSendType" SG_ 891 FourDRadarObjSts21VabsYStd 0;
BA_ "GenSigSendType" SG_ 891 FourDRadarObjSts21ValidFlag 0;
BA_ "GenSigDataID" SG_ 892 FourDRadarObjSts23Chks "0xE19";
BA_ "GenSigFuncType" SG_ 892 FourDRadarObjSts23Chks 15;
BA_ "GenSigSendType" SG_ 892 FourDRadarObjSts23Chks 0;
BA_ "GenSigSendType" SG_ 892 FourDRadarObjSts23Classification 0;
BA_ "GenSigFuncType" SG_ 892 FourDRadarObjSts23Cntr 16;
BA_ "GenSigSendType" SG_ 892 FourDRadarObjSts23Cntr 0;
BA_ "GenSigSendType" SG_ 892 FourDRadarObjSts23DistX 0;
BA_ "GenSigStartValue" SG_ 892 FourDRadarObjSts23DistX 32768;
BA_ "GenSigSendType" SG_ 892 FourDRadarObjSts23DistXStd 0;
BA_ "GenSigSendType" SG_ 892 FourDRadarObjSts23DistY 0;
BA_ "GenSigStartValue" SG_ 892 FourDRadarObjSts23DistY 4096;
BA_ "GenSigSendType" SG_ 892 FourDRadarObjSts23DistYStd 0;
BA_ "GenSigSendType" SG_ 892 FourDRadarObjSts23DistZ 0;
BA_ "GenSigStartValue" SG_ 892 FourDRadarObjSts23DistZ 4096;
BA_ "GenSigSendType" SG_ 892 FourDRadarObjSts23DistZStd 0;
BA_ "GenSigSendType" SG_ 892 FourDRadarObjSts23DynamicProperty 0;
BA_ "GenSigSendType" SG_ 892 FourDRadarObjSts23HeadingAngle 0;
BA_ "GenSigStartValue" SG_ 892 FourDRadarObjSts23HeadingAngle 2047.78157;
BA_ "GenSigSendType" SG_ 892 FourDRadarObjSts23ID 0;
BA_ "GenSigSendType" SG_ 892 FourDRadarObjSts23LifeCycles 0;
BA_ "GenSigSendType" SG_ 892 FourDRadarObjSts23ObjBoundingBoxHeight 0;
BA_ "GenSigSendType" SG_ 892 FourDRadarObjSts23ObjBoundingBoxLength 0;
BA_ "GenSigSendType" SG_ 892 FourDRadarObjSts23ObjBoundingBoxWidth 0;
BA_ "GenSigSendType" SG_ 892 FourDRadarObjSts23ObjNearestPtX 0;
BA_ "GenSigStartValue" SG_ 892 FourDRadarObjSts23ObjNearestPtX 32768;
BA_ "GenSigSendType" SG_ 892 FourDRadarObjSts23ObjNearestPtY 0;
BA_ "GenSigStartValue" SG_ 892 FourDRadarObjSts23ObjNearestPtY 4096;
BA_ "GenSigSendType" SG_ 892 FourDRadarObjSts23ObjNearestPtZ 0;
BA_ "GenSigStartValue" SG_ 892 FourDRadarObjSts23ObjNearestPtZ 4096;
BA_ "GenSigSendType" SG_ 892 FourDRadarObjSts23ObjSNR 0;
BA_ "GenSigSendType" SG_ 892 FourDRadarObjSts23ObjXAccRel 0;
BA_ "GenSigStartValue" SG_ 892 FourDRadarObjSts23ObjXAccRel 356;
BA_ "GenSigSendType" SG_ 892 FourDRadarObjSts23ObjYAccRel 0;
BA_ "GenSigStartValue" SG_ 892 FourDRadarObjSts23ObjYAccRel 356;
BA_ "GenSigSendType" SG_ 892 FourDRadarObjSts23ObstacleProbability 0;
BA_ "GenSigSendType" SG_ 892 FourDRadarObjSts23ProbabilityOfExistence 0;
BA_ "GenSigSendType" SG_ 892 FourDRadarObjSts23RCS 0;
BA_ "GenSigStartValue" SG_ 892 FourDRadarObjSts23RCS 1000;
BA_ "GenSigSendType" SG_ 892 FourDRadarObjSts23TargetClassificationConfidence 0;
BA_ "GenSigSendType" SG_ 892 FourDRadarObjSts23UpdateFlag 0;
BA_ "GenSigSendType" SG_ 892 FourDRadarObjSts23VabsX 0;
BA_ "GenSigStartValue" SG_ 892 FourDRadarObjSts23VabsX 1024;
BA_ "GenSigSendType" SG_ 892 FourDRadarObjSts23VabsXStd 0;
BA_ "GenSigSendType" SG_ 892 FourDRadarObjSts23VabsY 0;
BA_ "GenSigStartValue" SG_ 892 FourDRadarObjSts23VabsY 1024;
BA_ "GenSigSendType" SG_ 892 FourDRadarObjSts23VabsYStd 0;
BA_ "GenSigSendType" SG_ 892 FourDRadarObjSts23ValidFlag 0;
BA_ "GenSigDataID" SG_ 893 FourDRadarObjSts25Chks "0xE1B";
BA_ "GenSigFuncType" SG_ 893 FourDRadarObjSts25Chks 15;
BA_ "GenSigSendType" SG_ 893 FourDRadarObjSts25Chks 0;
BA_ "GenSigSendType" SG_ 893 FourDRadarObjSts25Classification 0;
BA_ "GenSigFuncType" SG_ 893 FourDRadarObjSts25Cntr 16;
BA_ "GenSigSendType" SG_ 893 FourDRadarObjSts25Cntr 0;
BA_ "GenSigSendType" SG_ 893 FourDRadarObjSts25DistX 0;
BA_ "GenSigStartValue" SG_ 893 FourDRadarObjSts25DistX 32768;
BA_ "GenSigSendType" SG_ 893 FourDRadarObjSts25DistXStd 0;
BA_ "GenSigSendType" SG_ 893 FourDRadarObjSts25DistY 0;
BA_ "GenSigStartValue" SG_ 893 FourDRadarObjSts25DistY 4096;
BA_ "GenSigSendType" SG_ 893 FourDRadarObjSts25DistYStd 0;
BA_ "GenSigSendType" SG_ 893 FourDRadarObjSts25DistZ 0;
BA_ "GenSigStartValue" SG_ 893 FourDRadarObjSts25DistZ 4096;
BA_ "GenSigSendType" SG_ 893 FourDRadarObjSts25DistZStd 0;
BA_ "GenSigSendType" SG_ 893 FourDRadarObjSts25DynamicProperty 0;
BA_ "GenSigSendType" SG_ 893 FourDRadarObjSts25HeadingAngle 0;
BA_ "GenSigStartValue" SG_ 893 FourDRadarObjSts25HeadingAngle 2047.78157;
BA_ "GenSigSendType" SG_ 893 FourDRadarObjSts25ID 0;
BA_ "GenSigSendType" SG_ 893 FourDRadarObjSts25LifeCycles 0;
BA_ "GenSigSendType" SG_ 893 FourDRadarObjSts25ObjBoundingBoxHeight 0;
BA_ "GenSigSendType" SG_ 893 FourDRadarObjSts25ObjBoundingBoxLength 0;
BA_ "GenSigSendType" SG_ 893 FourDRadarObjSts25ObjBoundingBoxWidth 0;
BA_ "GenSigSendType" SG_ 893 FourDRadarObjSts25ObjNearestPtX 0;
BA_ "GenSigStartValue" SG_ 893 FourDRadarObjSts25ObjNearestPtX 32768;
BA_ "GenSigSendType" SG_ 893 FourDRadarObjSts25ObjNearestPtY 0;
BA_ "GenSigStartValue" SG_ 893 FourDRadarObjSts25ObjNearestPtY 4096;
BA_ "GenSigSendType" SG_ 893 FourDRadarObjSts25ObjNearestPtZ 0;
BA_ "GenSigStartValue" SG_ 893 FourDRadarObjSts25ObjNearestPtZ 4096;
BA_ "GenSigSendType" SG_ 893 FourDRadarObjSts25ObjSNR 0;
BA_ "GenSigSendType" SG_ 893 FourDRadarObjSts25ObjXAccRel 0;
BA_ "GenSigStartValue" SG_ 893 FourDRadarObjSts25ObjXAccRel 356;
BA_ "GenSigSendType" SG_ 893 FourDRadarObjSts25ObjYAccRel 0;
BA_ "GenSigStartValue" SG_ 893 FourDRadarObjSts25ObjYAccRel 356;
BA_ "GenSigSendType" SG_ 893 FourDRadarObjSts25ObstacleProbability 0;
BA_ "GenSigSendType" SG_ 893 FourDRadarObjSts25ProbabilityOfExistence 0;
BA_ "GenSigSendType" SG_ 893 FourDRadarObjSts25RCS 0;
BA_ "GenSigStartValue" SG_ 893 FourDRadarObjSts25RCS 1000;
BA_ "GenSigSendType" SG_ 893 FourDRadarObjSts25TargetClassificationConfidence 0;
BA_ "GenSigSendType" SG_ 893 FourDRadarObjSts25UpdateFlag 0;
BA_ "GenSigSendType" SG_ 893 FourDRadarObjSts25VabsX 0;
BA_ "GenSigStartValue" SG_ 893 FourDRadarObjSts25VabsX 1024;
BA_ "GenSigSendType" SG_ 893 FourDRadarObjSts25VabsXStd 0;
BA_ "GenSigSendType" SG_ 893 FourDRadarObjSts25VabsY 0;
BA_ "GenSigStartValue" SG_ 893 FourDRadarObjSts25VabsY 1024;
BA_ "GenSigSendType" SG_ 893 FourDRadarObjSts25VabsYStd 0;
BA_ "GenSigSendType" SG_ 893 FourDRadarObjSts25ValidFlag 0;
BA_ "GenSigDataID" SG_ 894 FourDRadarObjSts27Chks "0xE1D";
BA_ "GenSigFuncType" SG_ 894 FourDRadarObjSts27Chks 15;
BA_ "GenSigSendType" SG_ 894 FourDRadarObjSts27Chks 0;
BA_ "GenSigSendType" SG_ 894 FourDRadarObjSts27Classification 0;
BA_ "GenSigFuncType" SG_ 894 FourDRadarObjSts27Cntr 16;
BA_ "GenSigSendType" SG_ 894 FourDRadarObjSts27Cntr 0;
BA_ "GenSigSendType" SG_ 894 FourDRadarObjSts27DistX 0;
BA_ "GenSigStartValue" SG_ 894 FourDRadarObjSts27DistX 32768;
BA_ "GenSigSendType" SG_ 894 FourDRadarObjSts27DistXStd 0;
BA_ "GenSigSendType" SG_ 894 FourDRadarObjSts27DistY 0;
BA_ "GenSigStartValue" SG_ 894 FourDRadarObjSts27DistY 4096;
BA_ "GenSigSendType" SG_ 894 FourDRadarObjSts27DistYStd 0;
BA_ "GenSigSendType" SG_ 894 FourDRadarObjSts27DistZ 0;
BA_ "GenSigStartValue" SG_ 894 FourDRadarObjSts27DistZ 4096;
BA_ "GenSigSendType" SG_ 894 FourDRadarObjSts27DistZStd 0;
BA_ "GenSigSendType" SG_ 894 FourDRadarObjSts27DynamicProperty 0;
BA_ "GenSigSendType" SG_ 894 FourDRadarObjSts27HeadingAngle 0;
BA_ "GenSigStartValue" SG_ 894 FourDRadarObjSts27HeadingAngle 2047.78157;
BA_ "GenSigSendType" SG_ 894 FourDRadarObjSts27ID 0;
BA_ "GenSigSendType" SG_ 894 FourDRadarObjSts27LifeCycles 0;
BA_ "GenSigSendType" SG_ 894 FourDRadarObjSts27ObjBoundingBoxHeight 0;
BA_ "GenSigSendType" SG_ 894 FourDRadarObjSts27ObjBoundingBoxLength 0;
BA_ "GenSigSendType" SG_ 894 FourDRadarObjSts27ObjBoundingBoxWidth 0;
BA_ "GenSigSendType" SG_ 894 FourDRadarObjSts27ObjNearestPtX 0;
BA_ "GenSigStartValue" SG_ 894 FourDRadarObjSts27ObjNearestPtX 32768;
BA_ "GenSigSendType" SG_ 894 FourDRadarObjSts27ObjNearestPtY 0;
BA_ "GenSigStartValue" SG_ 894 FourDRadarObjSts27ObjNearestPtY 4096;
BA_ "GenSigSendType" SG_ 894 FourDRadarObjSts27ObjNearestPtZ 0;
BA_ "GenSigStartValue" SG_ 894 FourDRadarObjSts27ObjNearestPtZ 4096;
BA_ "GenSigSendType" SG_ 894 FourDRadarObjSts27ObjSNR 0;
BA_ "GenSigSendType" SG_ 894 FourDRadarObjSts27ObjXAccRel 0;
BA_ "GenSigStartValue" SG_ 894 FourDRadarObjSts27ObjXAccRel 356;
BA_ "GenSigSendType" SG_ 894 FourDRadarObjSts27ObjYAccRel 0;
BA_ "GenSigStartValue" SG_ 894 FourDRadarObjSts27ObjYAccRel 356;
BA_ "GenSigSendType" SG_ 894 FourDRadarObjSts27ObstacleProbability 0;
BA_ "GenSigSendType" SG_ 894 FourDRadarObjSts27ProbabilityOfExistence 0;
BA_ "GenSigSendType" SG_ 894 FourDRadarObjSts27RCS 0;
BA_ "GenSigStartValue" SG_ 894 FourDRadarObjSts27RCS 1000;
BA_ "GenSigSendType" SG_ 894 FourDRadarObjSts27TargetClassificationConfidence 0;
BA_ "GenSigSendType" SG_ 894 FourDRadarObjSts27UpdateFlag 0;
BA_ "GenSigSendType" SG_ 894 FourDRadarObjSts27VabsX 0;
BA_ "GenSigStartValue" SG_ 894 FourDRadarObjSts27VabsX 1024;
BA_ "GenSigSendType" SG_ 894 FourDRadarObjSts27VabsXStd 0;
BA_ "GenSigSendType" SG_ 894 FourDRadarObjSts27VabsY 0;
BA_ "GenSigStartValue" SG_ 894 FourDRadarObjSts27VabsY 1024;
BA_ "GenSigSendType" SG_ 894 FourDRadarObjSts27VabsYStd 0;
BA_ "GenSigSendType" SG_ 894 FourDRadarObjSts27ValidFlag 0;
BA_ "GenSigDataID" SG_ 895 FourDRadarObjSts29Chks "0xE1F";
BA_ "GenSigFuncType" SG_ 895 FourDRadarObjSts29Chks 15;
BA_ "GenSigSendType" SG_ 895 FourDRadarObjSts29Chks 0;
BA_ "GenSigSendType" SG_ 895 FourDRadarObjSts29Classification 0;
BA_ "GenSigFuncType" SG_ 895 FourDRadarObjSts29Cntr 16;
BA_ "GenSigSendType" SG_ 895 FourDRadarObjSts29Cntr 0;
BA_ "GenSigSendType" SG_ 895 FourDRadarObjSts29DistX 0;
BA_ "GenSigStartValue" SG_ 895 FourDRadarObjSts29DistX 32768;
BA_ "GenSigSendType" SG_ 895 FourDRadarObjSts29DistXStd 0;
BA_ "GenSigSendType" SG_ 895 FourDRadarObjSts29DistY 0;
BA_ "GenSigStartValue" SG_ 895 FourDRadarObjSts29DistY 4096;
BA_ "GenSigSendType" SG_ 895 FourDRadarObjSts29DistYStd 0;
BA_ "GenSigSendType" SG_ 895 FourDRadarObjSts29DistZ 0;
BA_ "GenSigStartValue" SG_ 895 FourDRadarObjSts29DistZ 4096;
BA_ "GenSigSendType" SG_ 895 FourDRadarObjSts29DistZStd 0;
BA_ "GenSigSendType" SG_ 895 FourDRadarObjSts29DynamicProperty 0;
BA_ "GenSigSendType" SG_ 895 FourDRadarObjSts29HeadingAngle 0;
BA_ "GenSigStartValue" SG_ 895 FourDRadarObjSts29HeadingAngle 2047.78157;
BA_ "GenSigSendType" SG_ 895 FourDRadarObjSts29ID 0;
BA_ "GenSigSendType" SG_ 895 FourDRadarObjSts29LifeCycles 0;
BA_ "GenSigSendType" SG_ 895 FourDRadarObjSts29ObjBoundingBoxHeight 0;
BA_ "GenSigSendType" SG_ 895 FourDRadarObjSts29ObjBoundingBoxLength 0;
BA_ "GenSigSendType" SG_ 895 FourDRadarObjSts29ObjBoundingBoxWidth 0;
BA_ "GenSigSendType" SG_ 895 FourDRadarObjSts29ObjNearestPtX 0;
BA_ "GenSigStartValue" SG_ 895 FourDRadarObjSts29ObjNearestPtX 32768;
BA_ "GenSigSendType" SG_ 895 FourDRadarObjSts29ObjNearestPtY 0;
BA_ "GenSigStartValue" SG_ 895 FourDRadarObjSts29ObjNearestPtY 4096;
BA_ "GenSigSendType" SG_ 895 FourDRadarObjSts29ObjNearestPtZ 0;
BA_ "GenSigStartValue" SG_ 895 FourDRadarObjSts29ObjNearestPtZ 4096;
BA_ "GenSigSendType" SG_ 895 FourDRadarObjSts29ObjSNR 0;
BA_ "GenSigSendType" SG_ 895 FourDRadarObjSts29ObjXAccRel 0;
BA_ "GenSigStartValue" SG_ 895 FourDRadarObjSts29ObjXAccRel 356;
BA_ "GenSigSendType" SG_ 895 FourDRadarObjSts29ObjYAccRel 0;
BA_ "GenSigStartValue" SG_ 895 FourDRadarObjSts29ObjYAccRel 356;
BA_ "GenSigSendType" SG_ 895 FourDRadarObjSts29ObstacleProbability 0;
BA_ "GenSigSendType" SG_ 895 FourDRadarObjSts29ProbabilityOfExistence 0;
BA_ "GenSigSendType" SG_ 895 FourDRadarObjSts29RCS 0;
BA_ "GenSigStartValue" SG_ 895 FourDRadarObjSts29RCS 1000;
BA_ "GenSigSendType" SG_ 895 FourDRadarObjSts29TargetClassificationConfidence 0;
BA_ "GenSigSendType" SG_ 895 FourDRadarObjSts29UpdateFlag 0;
BA_ "GenSigSendType" SG_ 895 FourDRadarObjSts29VabsX 0;
BA_ "GenSigStartValue" SG_ 895 FourDRadarObjSts29VabsX 1024;
BA_ "GenSigSendType" SG_ 895 FourDRadarObjSts29VabsXStd 0;
BA_ "GenSigSendType" SG_ 895 FourDRadarObjSts29VabsY 0;
BA_ "GenSigStartValue" SG_ 895 FourDRadarObjSts29VabsY 1024;
BA_ "GenSigSendType" SG_ 895 FourDRadarObjSts29VabsYStd 0;
BA_ "GenSigSendType" SG_ 895 FourDRadarObjSts29ValidFlag 0;
BA_ "GenSigDataID" SG_ 896 FourDRadarObjSts31Chks "0xE21";
BA_ "GenSigFuncType" SG_ 896 FourDRadarObjSts31Chks 15;
BA_ "GenSigSendType" SG_ 896 FourDRadarObjSts31Chks 0;
BA_ "GenSigSendType" SG_ 896 FourDRadarObjSts31Classification 0;
BA_ "GenSigFuncType" SG_ 896 FourDRadarObjSts31Cntr 16;
BA_ "GenSigSendType" SG_ 896 FourDRadarObjSts31Cntr 0;
BA_ "GenSigSendType" SG_ 896 FourDRadarObjSts31DistX 0;
BA_ "GenSigStartValue" SG_ 896 FourDRadarObjSts31DistX 32768;
BA_ "GenSigSendType" SG_ 896 FourDRadarObjSts31DistXStd 0;
BA_ "GenSigSendType" SG_ 896 FourDRadarObjSts31DistY 0;
BA_ "GenSigStartValue" SG_ 896 FourDRadarObjSts31DistY 4096;
BA_ "GenSigSendType" SG_ 896 FourDRadarObjSts31DistYStd 0;
BA_ "GenSigSendType" SG_ 896 FourDRadarObjSts31DistZ 0;
BA_ "GenSigStartValue" SG_ 896 FourDRadarObjSts31DistZ 4096;
BA_ "GenSigSendType" SG_ 896 FourDRadarObjSts31DistZStd 0;
BA_ "GenSigSendType" SG_ 896 FourDRadarObjSts31DynamicProperty 0;
BA_ "GenSigSendType" SG_ 896 FourDRadarObjSts31HeadingAngle 0;
BA_ "GenSigStartValue" SG_ 896 FourDRadarObjSts31HeadingAngle 2047.78157;
BA_ "GenSigSendType" SG_ 896 FourDRadarObjSts31ID 0;
BA_ "GenSigSendType" SG_ 896 FourDRadarObjSts31LifeCycles 0;
BA_ "GenSigSendType" SG_ 896 FourDRadarObjSts31ObjBoundingBoxHeight 0;
BA_ "GenSigSendType" SG_ 896 FourDRadarObjSts31ObjBoundingBoxLength 0;
BA_ "GenSigSendType" SG_ 896 FourDRadarObjSts31ObjBoundingBoxWidth 0;
BA_ "GenSigSendType" SG_ 896 FourDRadarObjSts31ObjNearestPtX 0;
BA_ "GenSigStartValue" SG_ 896 FourDRadarObjSts31ObjNearestPtX 32768;
BA_ "GenSigSendType" SG_ 896 FourDRadarObjSts31ObjNearestPtY 0;
BA_ "GenSigStartValue" SG_ 896 FourDRadarObjSts31ObjNearestPtY 4096;
BA_ "GenSigSendType" SG_ 896 FourDRadarObjSts31ObjNearestPtZ 0;
BA_ "GenSigStartValue" SG_ 896 FourDRadarObjSts31ObjNearestPtZ 4096;
BA_ "GenSigSendType" SG_ 896 FourDRadarObjSts31ObjSNR 0;
BA_ "GenSigSendType" SG_ 896 FourDRadarObjSts31ObjXAccRel 0;
BA_ "GenSigStartValue" SG_ 896 FourDRadarObjSts31ObjXAccRel 356;
BA_ "GenSigSendType" SG_ 896 FourDRadarObjSts31ObjYAccRel 0;
BA_ "GenSigStartValue" SG_ 896 FourDRadarObjSts31ObjYAccRel 356;
BA_ "GenSigSendType" SG_ 896 FourDRadarObjSts31ObstacleProbability 0;
BA_ "GenSigSendType" SG_ 896 FourDRadarObjSts31ProbabilityOfExistence 0;
BA_ "GenSigSendType" SG_ 896 FourDRadarObjSts31RCS 0;
BA_ "GenSigStartValue" SG_ 896 FourDRadarObjSts31RCS 1000;
BA_ "GenSigSendType" SG_ 896 FourDRadarObjSts31TargetClassificationConfidence 0;
BA_ "GenSigSendType" SG_ 896 FourDRadarObjSts31UpdateFlag 0;
BA_ "GenSigSendType" SG_ 896 FourDRadarObjSts31VabsX 0;
BA_ "GenSigStartValue" SG_ 896 FourDRadarObjSts31VabsX 1024;
BA_ "GenSigSendType" SG_ 896 FourDRadarObjSts31VabsXStd 0;
BA_ "GenSigSendType" SG_ 896 FourDRadarObjSts31VabsY 0;
BA_ "GenSigStartValue" SG_ 896 FourDRadarObjSts31VabsY 1024;
BA_ "GenSigSendType" SG_ 896 FourDRadarObjSts31VabsYStd 0;
BA_ "GenSigSendType" SG_ 896 FourDRadarObjSts31ValidFlag 0;
BA_ "GenSigDataID" SG_ 897 FourDRadarObjSts33Chks "0xE23";
BA_ "GenSigFuncType" SG_ 897 FourDRadarObjSts33Chks 15;
BA_ "GenSigSendType" SG_ 897 FourDRadarObjSts33Chks 0;
BA_ "GenSigSendType" SG_ 897 FourDRadarObjSts33Classification 0;
BA_ "GenSigFuncType" SG_ 897 FourDRadarObjSts33Cntr 16;
BA_ "GenSigSendType" SG_ 897 FourDRadarObjSts33Cntr 0;
BA_ "GenSigSendType" SG_ 897 FourDRadarObjSts33DistX 0;
BA_ "GenSigStartValue" SG_ 897 FourDRadarObjSts33DistX 32768;
BA_ "GenSigSendType" SG_ 897 FourDRadarObjSts33DistXStd 0;
BA_ "GenSigSendType" SG_ 897 FourDRadarObjSts33DistY 0;
BA_ "GenSigStartValue" SG_ 897 FourDRadarObjSts33DistY 4096;
BA_ "GenSigSendType" SG_ 897 FourDRadarObjSts33DistYStd 0;
BA_ "GenSigSendType" SG_ 897 FourDRadarObjSts33DistZ 0;
BA_ "GenSigStartValue" SG_ 897 FourDRadarObjSts33DistZ 4096;
BA_ "GenSigSendType" SG_ 897 FourDRadarObjSts33DistZStd 0;
BA_ "GenSigSendType" SG_ 897 FourDRadarObjSts33DynamicProperty 0;
BA_ "GenSigSendType" SG_ 897 FourDRadarObjSts33HeadingAngle 0;
BA_ "GenSigStartValue" SG_ 897 FourDRadarObjSts33HeadingAngle 2047.78157;
BA_ "GenSigSendType" SG_ 897 FourDRadarObjSts33ID 0;
BA_ "GenSigSendType" SG_ 897 FourDRadarObjSts33LifeCycles 0;
BA_ "GenSigSendType" SG_ 897 FourDRadarObjSts33ObjBoundingBoxHeight 0;
BA_ "GenSigSendType" SG_ 897 FourDRadarObjSts33ObjBoundingBoxLength 0;
BA_ "GenSigSendType" SG_ 897 FourDRadarObjSts33ObjBoundingBoxWidth 0;
BA_ "GenSigSendType" SG_ 897 FourDRadarObjSts33ObjNearestPtX 0;
BA_ "GenSigStartValue" SG_ 897 FourDRadarObjSts33ObjNearestPtX 32768;
BA_ "GenSigSendType" SG_ 897 FourDRadarObjSts33ObjNearestPtY 0;
BA_ "GenSigStartValue" SG_ 897 FourDRadarObjSts33ObjNearestPtY 4096;
BA_ "GenSigSendType" SG_ 897 FourDRadarObjSts33ObjNearestPtZ 0;
BA_ "GenSigStartValue" SG_ 897 FourDRadarObjSts33ObjNearestPtZ 4096;
BA_ "GenSigSendType" SG_ 897 FourDRadarObjSts33ObjSNR 0;
BA_ "GenSigSendType" SG_ 897 FourDRadarObjSts33ObjXAccRel 0;
BA_ "GenSigStartValue" SG_ 897 FourDRadarObjSts33ObjXAccRel 356;
BA_ "GenSigSendType" SG_ 897 FourDRadarObjSts33ObjYAccRel 0;
BA_ "GenSigStartValue" SG_ 897 FourDRadarObjSts33ObjYAccRel 356;
BA_ "GenSigSendType" SG_ 897 FourDRadarObjSts33ObstacleProbability 0;
BA_ "GenSigSendType" SG_ 897 FourDRadarObjSts33ProbabilityOfExistence 0;
BA_ "GenSigSendType" SG_ 897 FourDRadarObjSts33RCS 0;
BA_ "GenSigStartValue" SG_ 897 FourDRadarObjSts33RCS 1000;
BA_ "GenSigSendType" SG_ 897 FourDRadarObjSts33TargetClassificationConfidence 0;
BA_ "GenSigSendType" SG_ 897 FourDRadarObjSts33UpdateFlag 0;
BA_ "GenSigSendType" SG_ 897 FourDRadarObjSts33VabsX 0;
BA_ "GenSigStartValue" SG_ 897 FourDRadarObjSts33VabsX 1024;
BA_ "GenSigSendType" SG_ 897 FourDRadarObjSts33VabsXStd 0;
BA_ "GenSigSendType" SG_ 897 FourDRadarObjSts33VabsY 0;
BA_ "GenSigStartValue" SG_ 897 FourDRadarObjSts33VabsY 1024;
BA_ "GenSigSendType" SG_ 897 FourDRadarObjSts33VabsYStd 0;
BA_ "GenSigSendType" SG_ 897 FourDRadarObjSts33ValidFlag 0;
BA_ "GenSigDataID" SG_ 898 FourDRadarObjSts35Chks "0xE25";
BA_ "GenSigFuncType" SG_ 898 FourDRadarObjSts35Chks 15;
BA_ "GenSigSendType" SG_ 898 FourDRadarObjSts35Chks 0;
BA_ "GenSigSendType" SG_ 898 FourDRadarObjSts35Classification 0;
BA_ "GenSigFuncType" SG_ 898 FourDRadarObjSts35Cntr 16;
BA_ "GenSigSendType" SG_ 898 FourDRadarObjSts35Cntr 0;
BA_ "GenSigSendType" SG_ 898 FourDRadarObjSts35DistX 0;
BA_ "GenSigStartValue" SG_ 898 FourDRadarObjSts35DistX 32768;
BA_ "GenSigSendType" SG_ 898 FourDRadarObjSts35DistXStd 0;
BA_ "GenSigSendType" SG_ 898 FourDRadarObjSts35DistY 0;
BA_ "GenSigStartValue" SG_ 898 FourDRadarObjSts35DistY 4096;
BA_ "GenSigSendType" SG_ 898 FourDRadarObjSts35DistYStd 0;
BA_ "GenSigSendType" SG_ 898 FourDRadarObjSts35DistZ 0;
BA_ "GenSigStartValue" SG_ 898 FourDRadarObjSts35DistZ 4096;
BA_ "GenSigSendType" SG_ 898 FourDRadarObjSts35DistZStd 0;
BA_ "GenSigSendType" SG_ 898 FourDRadarObjSts35DynamicProperty 0;
BA_ "GenSigSendType" SG_ 898 FourDRadarObjSts35HeadingAngle 0;
BA_ "GenSigStartValue" SG_ 898 FourDRadarObjSts35HeadingAngle 2047.78157;
BA_ "GenSigSendType" SG_ 898 FourDRadarObjSts35ID 0;
BA_ "GenSigSendType" SG_ 898 FourDRadarObjSts35LifeCycles 0;
BA_ "GenSigSendType" SG_ 898 FourDRadarObjSts35ObjBoundingBoxHeight 0;
BA_ "GenSigSendType" SG_ 898 FourDRadarObjSts35ObjBoundingBoxLength 0;
BA_ "GenSigSendType" SG_ 898 FourDRadarObjSts35ObjBoundingBoxWidth 0;
BA_ "GenSigSendType" SG_ 898 FourDRadarObjSts35ObjNearestPtX 0;
BA_ "GenSigStartValue" SG_ 898 FourDRadarObjSts35ObjNearestPtX 32768;
BA_ "GenSigSendType" SG_ 898 FourDRadarObjSts35ObjNearestPtY 0;
BA_ "GenSigStartValue" SG_ 898 FourDRadarObjSts35ObjNearestPtY 4096;
BA_ "GenSigSendType" SG_ 898 FourDRadarObjSts35ObjNearestPtZ 0;
BA_ "GenSigStartValue" SG_ 898 FourDRadarObjSts35ObjNearestPtZ 4096;
BA_ "GenSigSendType" SG_ 898 FourDRadarObjSts35ObjSNR 0;
BA_ "GenSigSendType" SG_ 898 FourDRadarObjSts35ObjXAccRel 0;
BA_ "GenSigStartValue" SG_ 898 FourDRadarObjSts35ObjXAccRel 356;
BA_ "GenSigSendType" SG_ 898 FourDRadarObjSts35ObjYAccRel 0;
BA_ "GenSigStartValue" SG_ 898 FourDRadarObjSts35ObjYAccRel 356;
BA_ "GenSigSendType" SG_ 898 FourDRadarObjSts35ObstacleProbability 0;
BA_ "GenSigSendType" SG_ 898 FourDRadarObjSts35ProbabilityOfExistence 0;
BA_ "GenSigSendType" SG_ 898 FourDRadarObjSts35RCS 0;
BA_ "GenSigStartValue" SG_ 898 FourDRadarObjSts35RCS 1000;
BA_ "GenSigSendType" SG_ 898 FourDRadarObjSts35TargetClassificationConfidence 0;
BA_ "GenSigSendType" SG_ 898 FourDRadarObjSts35UpdateFlag 0;
BA_ "GenSigSendType" SG_ 898 FourDRadarObjSts35VabsX 0;
BA_ "GenSigStartValue" SG_ 898 FourDRadarObjSts35VabsX 1024;
BA_ "GenSigSendType" SG_ 898 FourDRadarObjSts35VabsXStd 0;
BA_ "GenSigSendType" SG_ 898 FourDRadarObjSts35VabsY 0;
BA_ "GenSigStartValue" SG_ 898 FourDRadarObjSts35VabsY 1024;
BA_ "GenSigSendType" SG_ 898 FourDRadarObjSts35VabsYStd 0;
BA_ "GenSigSendType" SG_ 898 FourDRadarObjSts35ValidFlag 0;
VAL_ 881 FourDRadarObjSts02Classification 0 "EClassification_Point" 1 "EClassification_Car" 2 "EClassification_Truck" 3 "EClassification_Pedestrian" 4 "EClassification_Motorcycle" 5 "EClassification_Bicycle" 6 "EClassification_Wide" 7 "EClassification_Reserved1" 8 "EClassification_Reserved2" 9 "EClassification_Reserved3" 10 "EClassification_Unclassified" 11 "EClassification_Reserved4" 12 "EClassification_Reserved5" 13 "EClassification_Reserved6" 14 "EClassification_Reserved7" 15 "EClassification_Reserved8";
VAL_ 881 FourDRadarObjSts02DynamicProperty 0 "EDynamicProperty_Moving" 1 "EDynamicProperty_Stationary" 2 "EDynamicProperty_Oncoming" 3 "EDynamicProperty_CrossingLeftToRight" 4 "EDynamicProperty_CrossingRightToLeft" 5 "EDynamicProperty_Unknown" 6 "EDynamicProperty_Stopped" 7 "EDynamicProperty_Reserved1";
VAL_ 881 FourDRadarObjSts02UpdateFlag 0 "Boolean_FALSE" 1 "Boolean_TRUE";
VAL_ 881 FourDRadarObjSts02ValidFlag 0 "Validity_NotValid" 1 "Validity_Valid";
VAL_ 882 FourDRadarObjSts03Classification 0 "EClassification_Point" 1 "EClassification_Car" 2 "EClassification_Truck" 3 "EClassification_Pedestrian" 4 "EClassification_Motorcycle" 5 "EClassification_Bicycle" 6 "EClassification_Wide" 7 "EClassification_Reserved1" 8 "EClassification_Reserved2" 9 "EClassification_Reserved3" 10 "EClassification_Unclassified" 11 "EClassification_Reserved4" 12 "EClassification_Reserved5" 13 "EClassification_Reserved6" 14 "EClassification_Reserved7" 15 "EClassification_Reserved8";
VAL_ 882 FourDRadarObjSts03DynamicProperty 0 "EDynamicProperty_Moving" 1 "EDynamicProperty_Stationary" 2 "EDynamicProperty_Oncoming" 3 "EDynamicProperty_CrossingLeftToRight" 4 "EDynamicProperty_CrossingRightToLeft" 5 "EDynamicProperty_Unknown" 6 "EDynamicProperty_Stopped" 7 "EDynamicProperty_Reserved1";
VAL_ 882 FourDRadarObjSts03UpdateFlag 0 "Boolean_FALSE" 1 "Boolean_TRUE";
VAL_ 882 FourDRadarObjSts03ValidFlag 0 "Validity_NotValid" 1 "Validity_Valid";
VAL_ 883 FourDRadarObjSts05Classification 0 "EClassification_Point" 1 "EClassification_Car" 2 "EClassification_Truck" 3 "EClassification_Pedestrian" 4 "EClassification_Motorcycle" 5 "EClassification_Bicycle" 6 "EClassification_Wide" 7 "EClassification_Reserved1" 8 "EClassification_Reserved2" 9 "EClassification_Reserved3" 10 "EClassification_Unclassified" 11 "EClassification_Reserved4" 12 "EClassification_Reserved5" 13 "EClassification_Reserved6" 14 "EClassification_Reserved7" 15 "EClassification_Reserved8";
VAL_ 883 FourDRadarObjSts05DynamicProperty 0 "EDynamicProperty_Moving" 1 "EDynamicProperty_Stationary" 2 "EDynamicProperty_Oncoming" 3 "EDynamicProperty_CrossingLeftToRight" 4 "EDynamicProperty_CrossingRightToLeft" 5 "EDynamicProperty_Unknown" 6 "EDynamicProperty_Stopped" 7 "EDynamicProperty_Reserved1";
VAL_ 883 FourDRadarObjSts05UpdateFlag 0 "Boolean_FALSE" 1 "Boolean_TRUE";
VAL_ 883 FourDRadarObjSts05ValidFlag 0 "Validity_NotValid" 1 "Validity_Valid";
VAL_ 884 FourDRadarObjSts07Classification 0 "EClassification_Point" 1 "EClassification_Car" 2 "EClassification_Truck" 3 "EClassification_Pedestrian" 4 "EClassification_Motorcycle" 5 "EClassification_Bicycle" 6 "EClassification_Wide" 7 "EClassification_Reserved1" 8 "EClassification_Reserved2" 9 "EClassification_Reserved3" 10 "EClassification_Unclassified" 11 "EClassification_Reserved4" 12 "EClassification_Reserved5" 13 "EClassification_Reserved6" 14 "EClassification_Reserved7" 15 "EClassification_Reserved8";
VAL_ 884 FourDRadarObjSts07DynamicProperty 0 "EDynamicProperty_Moving" 1 "EDynamicProperty_Stationary" 2 "EDynamicProperty_Oncoming" 3 "EDynamicProperty_CrossingLeftToRight" 4 "EDynamicProperty_CrossingRightToLeft" 5 "EDynamicProperty_Unknown" 6 "EDynamicProperty_Stopped" 7 "EDynamicProperty_Reserved1";
VAL_ 884 FourDRadarObjSts07UpdateFlag 0 "Boolean_FALSE" 1 "Boolean_TRUE";
VAL_ 884 FourDRadarObjSts07ValidFlag 0 "Validity_NotValid" 1 "Validity_Valid";
VAL_ 885 FourDRadarObjSts09Classification 0 "EClassification_Point" 1 "EClassification_Car" 2 "EClassification_Truck" 3 "EClassification_Pedestrian" 4 "EClassification_Motorcycle" 5 "EClassification_Bicycle" 6 "EClassification_Wide" 7 "EClassification_Reserved1" 8 "EClassification_Reserved2" 9 "EClassification_Reserved3" 10 "EClassification_Unclassified" 11 "EClassification_Reserved4" 12 "EClassification_Reserved5" 13 "EClassification_Reserved6" 14 "EClassification_Reserved7" 15 "EClassification_Reserved8";
VAL_ 885 FourDRadarObjSts09DynamicProperty 0 "EDynamicProperty_Moving" 1 "EDynamicProperty_Stationary" 2 "EDynamicProperty_Oncoming" 3 "EDynamicProperty_CrossingLeftToRight" 4 "EDynamicProperty_CrossingRightToLeft" 5 "EDynamicProperty_Unknown" 6 "EDynamicProperty_Stopped" 7 "EDynamicProperty_Reserved1";
VAL_ 885 FourDRadarObjSts09UpdateFlag 0 "Boolean_FALSE" 1 "Boolean_TRUE";
VAL_ 885 FourDRadarObjSts09ValidFlag 0 "Validity_NotValid" 1 "Validity_Valid";
VAL_ 886 FourDRadarObjSts11Classification 0 "EClassification_Point" 1 "EClassification_Car" 2 "EClassification_Truck" 3 "EClassification_Pedestrian" 4 "EClassification_Motorcycle" 5 "EClassification_Bicycle" 6 "EClassification_Wide" 7 "EClassification_Reserved1" 8 "EClassification_Reserved2" 9 "EClassification_Reserved3" 10 "EClassification_Unclassified" 11 "EClassification_Reserved4" 12 "EClassification_Reserved5" 13 "EClassification_Reserved6" 14 "EClassification_Reserved7" 15 "EClassification_Reserved8";
VAL_ 886 FourDRadarObjSts11DynamicProperty 0 "EDynamicProperty_Moving" 1 "EDynamicProperty_Stationary" 2 "EDynamicProperty_Oncoming" 3 "EDynamicProperty_CrossingLeftToRight" 4 "EDynamicProperty_CrossingRightToLeft" 5 "EDynamicProperty_Unknown" 6 "EDynamicProperty_Stopped" 7 "EDynamicProperty_Reserved1";
VAL_ 886 FourDRadarObjSts11UpdateFlag 0 "Boolean_FALSE" 1 "Boolean_TRUE";
VAL_ 886 FourDRadarObjSts11ValidFlag 0 "Validity_NotValid" 1 "Validity_Valid";
VAL_ 887 FourDRadarObjSts13Classification 0 "EClassification_Point" 1 "EClassification_Car" 2 "EClassification_Truck" 3 "EClassification_Pedestrian" 4 "EClassification_Motorcycle" 5 "EClassification_Bicycle" 6 "EClassification_Wide" 7 "EClassification_Reserved1" 8 "EClassification_Reserved2" 9 "EClassification_Reserved3" 10 "EClassification_Unclassified" 11 "EClassification_Reserved4" 12 "EClassification_Reserved5" 13 "EClassification_Reserved6" 14 "EClassification_Reserved7" 15 "EClassification_Reserved8";
VAL_ 887 FourDRadarObjSts13DynamicProperty 0 "EDynamicProperty_Moving" 1 "EDynamicProperty_Stationary" 2 "EDynamicProperty_Oncoming" 3 "EDynamicProperty_CrossingLeftToRight" 4 "EDynamicProperty_CrossingRightToLeft" 5 "EDynamicProperty_Unknown" 6 "EDynamicProperty_Stopped" 7 "EDynamicProperty_Reserved1";
VAL_ 887 FourDRadarObjSts13UpdateFlag 0 "Boolean_FALSE" 1 "Boolean_TRUE";
VAL_ 887 FourDRadarObjSts13ValidFlag 0 "Validity_NotValid" 1 "Validity_Valid";
VAL_ 888 FourDRadarObjSts15Classification 0 "EClassification_Point" 1 "EClassification_Car" 2 "EClassification_Truck" 3 "EClassification_Pedestrian" 4 "EClassification_Motorcycle" 5 "EClassification_Bicycle" 6 "EClassification_Wide" 7 "EClassification_Reserved1" 8 "EClassification_Reserved2" 9 "EClassification_Reserved3" 10 "EClassification_Unclassified" 11 "EClassification_Reserved4" 12 "EClassification_Reserved5" 13 "EClassification_Reserved6" 14 "EClassification_Reserved7" 15 "EClassification_Reserved8";
VAL_ 888 FourDRadarObjSts15DynamicProperty 0 "EDynamicProperty_Moving" 1 "EDynamicProperty_Stationary" 2 "EDynamicProperty_Oncoming" 3 "EDynamicProperty_CrossingLeftToRight" 4 "EDynamicProperty_CrossingRightToLeft" 5 "EDynamicProperty_Unknown" 6 "EDynamicProperty_Stopped" 7 "EDynamicProperty_Reserved1";
VAL_ 888 FourDRadarObjSts15UpdateFlag 0 "Boolean_FALSE" 1 "Boolean_TRUE";
VAL_ 888 FourDRadarObjSts15ValidFlag 0 "Validity_NotValid" 1 "Validity_Valid";
VAL_ 889 FourDRadarObjSts17Classification 0 "EClassification_Point" 1 "EClassification_Car" 2 "EClassification_Truck" 3 "EClassification_Pedestrian" 4 "EClassification_Motorcycle" 5 "EClassification_Bicycle" 6 "EClassification_Wide" 7 "EClassification_Reserved1" 8 "EClassification_Reserved2" 9 "EClassification_Reserved3" 10 "EClassification_Unclassified" 11 "EClassification_Reserved4" 12 "EClassification_Reserved5" 13 "EClassification_Reserved6" 14 "EClassification_Reserved7" 15 "EClassification_Reserved8";
VAL_ 889 FourDRadarObjSts17DynamicProperty 0 "EDynamicProperty_Moving" 1 "EDynamicProperty_Stationary" 2 "EDynamicProperty_Oncoming" 3 "EDynamicProperty_CrossingLeftToRight" 4 "EDynamicProperty_CrossingRightToLeft" 5 "EDynamicProperty_Unknown" 6 "EDynamicProperty_Stopped" 7 "EDynamicProperty_Reserved1";
VAL_ 889 FourDRadarObjSts17UpdateFlag 0 "Boolean_FALSE" 1 "Boolean_TRUE";
VAL_ 889 FourDRadarObjSts17ValidFlag 0 "Validity_NotValid" 1 "Validity_Valid";
VAL_ 890 FourDRadarObjSts19Classification 0 "EClassification_Point" 1 "EClassification_Car" 2 "EClassification_Truck" 3 "EClassification_Pedestrian" 4 "EClassification_Motorcycle" 5 "EClassification_Bicycle" 6 "EClassification_Wide" 7 "EClassification_Reserved1" 8 "EClassification_Reserved2" 9 "EClassification_Reserved3" 10 "EClassification_Unclassified" 11 "EClassification_Reserved4" 12 "EClassification_Reserved5" 13 "EClassification_Reserved6" 14 "EClassification_Reserved7" 15 "EClassification_Reserved8";
VAL_ 890 FourDRadarObjSts19DynamicProperty 0 "EDynamicProperty_Moving" 1 "EDynamicProperty_Stationary" 2 "EDynamicProperty_Oncoming" 3 "EDynamicProperty_CrossingLeftToRight" 4 "EDynamicProperty_CrossingRightToLeft" 5 "EDynamicProperty_Unknown" 6 "EDynamicProperty_Stopped" 7 "EDynamicProperty_Reserved1";
VAL_ 890 FourDRadarObjSts19UpdateFlag 0 "Boolean_FALSE" 1 "Boolean_TRUE";
VAL_ 890 FourDRadarObjSts19ValidFlag 0 "Validity_NotValid" 1 "Validity_Valid";
VAL_ 891 FourDRadarObjSts21Classification 0 "EClassification_Point" 1 "EClassification_Car" 2 "EClassification_Truck" 3 "EClassification_Pedestrian" 4 "EClassification_Motorcycle" 5 "EClassification_Bicycle" 6 "EClassification_Wide" 7 "EClassification_Reserved1" 8 "EClassification_Reserved2" 9 "EClassification_Reserved3" 10 "EClassification_Unclassified" 11 "EClassification_Reserved4" 12 "EClassification_Reserved5" 13 "EClassification_Reserved6" 14 "EClassification_Reserved7" 15 "EClassification_Reserved8";
VAL_ 891 FourDRadarObjSts21DynamicProperty 0 "EDynamicProperty_Moving" 1 "EDynamicProperty_Stationary" 2 "EDynamicProperty_Oncoming" 3 "EDynamicProperty_CrossingLeftToRight" 4 "EDynamicProperty_CrossingRightToLeft" 5 "EDynamicProperty_Unknown" 6 "EDynamicProperty_Stopped" 7 "EDynamicProperty_Reserved1";
VAL_ 891 FourDRadarObjSts21UpdateFlag 0 "Boolean_FALSE" 1 "Boolean_TRUE";
VAL_ 891 FourDRadarObjSts21ValidFlag 0 "Validity_NotValid" 1 "Validity_Valid";
VAL_ 892 FourDRadarObjSts23Classification 0 "EClassification_Point" 1 "EClassification_Car" 2 "EClassification_Truck" 3 "EClassification_Pedestrian" 4 "EClassification_Motorcycle" 5 "EClassification_Bicycle" 6 "EClassification_Wide" 7 "EClassification_Reserved1" 8 "EClassification_Reserved2" 9 "EClassification_Reserved3" 10 "EClassification_Unclassified" 11 "EClassification_Reserved4" 12 "EClassification_Reserved5" 13 "EClassification_Reserved6" 14 "EClassification_Reserved7" 15 "EClassification_Reserved8";
VAL_ 892 FourDRadarObjSts23DynamicProperty 0 "EDynamicProperty_Moving" 1 "EDynamicProperty_Stationary" 2 "EDynamicProperty_Oncoming" 3 "EDynamicProperty_CrossingLeftToRight" 4 "EDynamicProperty_CrossingRightToLeft" 5 "EDynamicProperty_Unknown" 6 "EDynamicProperty_Stopped" 7 "EDynamicProperty_Reserved1";
VAL_ 892 FourDRadarObjSts23UpdateFlag 0 "Boolean_FALSE" 1 "Boolean_TRUE";
VAL_ 892 FourDRadarObjSts23ValidFlag 0 "Validity_NotValid" 1 "Validity_Valid";
VAL_ 893 FourDRadarObjSts25Classification 0 "EClassification_Point" 1 "EClassification_Car" 2 "EClassification_Truck" 3 "EClassification_Pedestrian" 4 "EClassification_Motorcycle" 5 "EClassification_Bicycle" 6 "EClassification_Wide" 7 "EClassification_Reserved1" 8 "EClassification_Reserved2" 9 "EClassification_Reserved3" 10 "EClassification_Unclassified" 11 "EClassification_Reserved4" 12 "EClassification_Reserved5" 13 "EClassification_Reserved6" 14 "EClassification_Reserved7" 15 "EClassification_Reserved8";
VAL_ 893 FourDRadarObjSts25DynamicProperty 0 "EDynamicProperty_Moving" 1 "EDynamicProperty_Stationary" 2 "EDynamicProperty_Oncoming" 3 "EDynamicProperty_CrossingLeftToRight" 4 "EDynamicProperty_CrossingRightToLeft" 5 "EDynamicProperty_Unknown" 6 "EDynamicProperty_Stopped" 7 "EDynamicProperty_Reserved1";
VAL_ 893 FourDRadarObjSts25UpdateFlag 0 "Boolean_FALSE" 1 "Boolean_TRUE";
VAL_ 893 FourDRadarObjSts25ValidFlag 0 "Validity_NotValid" 1 "Validity_Valid";
VAL_ 894 FourDRadarObjSts27Classification 0 "EClassification_Point" 1 "EClassification_Car" 2 "EClassification_Truck" 3 "EClassification_Pedestrian" 4 "EClassification_Motorcycle" 5 "EClassification_Bicycle" 6 "EClassification_Wide" 7 "EClassification_Reserved1" 8 "EClassification_Reserved2" 9 "EClassification_Reserved3" 10 "EClassification_Unclassified" 11 "EClassification_Reserved4" 12 "EClassification_Reserved5" 13 "EClassification_Reserved6" 14 "EClassification_Reserved7" 15 "EClassification_Reserved8";
VAL_ 894 FourDRadarObjSts27DynamicProperty 0 "EDynamicProperty_Moving" 1 "EDynamicProperty_Stationary" 2 "EDynamicProperty_Oncoming" 3 "EDynamicProperty_CrossingLeftToRight" 4 "EDynamicProperty_CrossingRightToLeft" 5 "EDynamicProperty_Unknown" 6 "EDynamicProperty_Stopped" 7 "EDynamicProperty_Reserved1";
VAL_ 894 FourDRadarObjSts27UpdateFlag 0 "Boolean_FALSE" 1 "Boolean_TRUE";
VAL_ 894 FourDRadarObjSts27ValidFlag 0 "Validity_NotValid" 1 "Validity_Valid";
VAL_ 895 FourDRadarObjSts29Classification 0 "EClassification_Point" 1 "EClassification_Car" 2 "EClassification_Truck" 3 "EClassification_Pedestrian" 4 "EClassification_Motorcycle" 5 "EClassification_Bicycle" 6 "EClassification_Wide" 7 "EClassification_Reserved1" 8 "EClassification_Reserved2" 9 "EClassification_Reserved3" 10 "EClassification_Unclassified" 11 "EClassification_Reserved4" 12 "EClassification_Reserved5" 13 "EClassification_Reserved6" 14 "EClassification_Reserved7" 15 "EClassification_Reserved8";
VAL_ 895 FourDRadarObjSts29DynamicProperty 0 "EDynamicProperty_Moving" 1 "EDynamicProperty_Stationary" 2 "EDynamicProperty_Oncoming" 3 "EDynamicProperty_CrossingLeftToRight" 4 "EDynamicProperty_CrossingRightToLeft" 5 "EDynamicProperty_Unknown" 6 "EDynamicProperty_Stopped" 7 "EDynamicProperty_Reserved1";
VAL_ 895 FourDRadarObjSts29UpdateFlag 0 "Boolean_FALSE" 1 "Boolean_TRUE";
VAL_ 895 FourDRadarObjSts29ValidFlag 0 "Validity_NotValid" 1 "Validity_Valid";
VAL_ 896 FourDRadarObjSts31Classification 0 "EClassification_Point" 1 "EClassification_Car" 2 "EClassification_Truck" 3 "EClassification_Pedestrian" 4 "EClassification_Motorcycle" 5 "EClassification_Bicycle" 6 "EClassification_Wide" 7 "EClassification_Reserved1" 8 "EClassification_Reserved2" 9 "EClassification_Reserved3" 10 "EClassification_Unclassified" 11 "EClassification_Reserved4" 12 "EClassification_Reserved5" 13 "EClassification_Reserved6" 14 "EClassification_Reserved7" 15 "EClassification_Reserved8";
VAL_ 896 FourDRadarObjSts31DynamicProperty 0 "EDynamicProperty_Moving" 1 "EDynamicProperty_Stationary" 2 "EDynamicProperty_Oncoming" 3 "EDynamicProperty_CrossingLeftToRight" 4 "EDynamicProperty_CrossingRightToLeft" 5 "EDynamicProperty_Unknown" 6 "EDynamicProperty_Stopped" 7 "EDynamicProperty_Reserved1";
VAL_ 896 FourDRadarObjSts31UpdateFlag 0 "Boolean_FALSE" 1 "Boolean_TRUE";
VAL_ 896 FourDRadarObjSts31ValidFlag 0 "Validity_NotValid" 1 "Validity_Valid";
VAL_ 897 FourDRadarObjSts33Classification 0 "EClassification_Point" 1 "EClassification_Car" 2 "EClassification_Truck" 3 "EClassification_Pedestrian" 4 "EClassification_Motorcycle" 5 "EClassification_Bicycle" 6 "EClassification_Wide" 7 "EClassification_Reserved1" 8 "EClassification_Reserved2" 9 "EClassification_Reserved3" 10 "EClassification_Unclassified" 11 "EClassification_Reserved4" 12 "EClassification_Reserved5" 13 "EClassification_Reserved6" 14 "EClassification_Reserved7" 15 "EClassification_Reserved8";
VAL_ 897 FourDRadarObjSts33DynamicProperty 0 "EDynamicProperty_Moving" 1 "EDynamicProperty_Stationary" 2 "EDynamicProperty_Oncoming" 3 "EDynamicProperty_CrossingLeftToRight" 4 "EDynamicProperty_CrossingRightToLeft" 5 "EDynamicProperty_Unknown" 6 "EDynamicProperty_Stopped" 7 "EDynamicProperty_Reserved1";
VAL_ 897 FourDRadarObjSts33UpdateFlag 0 "Boolean_FALSE" 1 "Boolean_TRUE";
VAL_ 897 FourDRadarObjSts33ValidFlag 0 "Validity_NotValid" 1 "Validity_Valid";
VAL_ 898 FourDRadarObjSts35Classification 0 "EClassification_Point" 1 "EClassification_Car" 2 "EClassification_Truck" 3 "EClassification_Pedestrian" 4 "EClassification_Motorcycle" 5 "EClassification_Bicycle" 6 "EClassification_Wide" 7 "EClassification_Reserved1" 8 "EClassification_Reserved2" 9 "EClassification_Reserved3" 10 "EClassification_Unclassified" 11 "EClassification_Reserved4" 12 "EClassification_Reserved5" 13 "EClassification_Reserved6" 14 "EClassification_Reserved7" 15 "EClassification_Reserved8";
VAL_ 898 FourDRadarObjSts35DynamicProperty 0 "EDynamicProperty_Moving" 1 "EDynamicProperty_Stationary" 2 "EDynamicProperty_Oncoming" 3 "EDynamicProperty_CrossingLeftToRight" 4 "EDynamicProperty_CrossingRightToLeft" 5 "EDynamicProperty_Unknown" 6 "EDynamicProperty_Stopped" 7 "EDynamicProperty_Reserved1";
VAL_ 898 FourDRadarObjSts35UpdateFlag 0 "Boolean_FALSE" 1 "Boolean_TRUE";
VAL_ 898 FourDRadarObjSts35ValidFlag 0 "Validity_NotValid" 1 "Validity_Valid";
SIG_GROUP_ 881 FourDRadarObjSts02 1 : FourDRadarObjSts02Chks FourDRadarObjSts02Classification FourDRadarObjSts02Cntr FourDRadarObjSts02DistX FourDRadarObjSts02DistXStd FourDRadarObjSts02DistY FourDRadarObjSts02DistYStd FourDRadarObjSts02DistZ FourDRadarObjSts02DistZStd FourDRadarObjSts02DynamicProperty FourDRadarObjSts02HeadingAngle FourDRadarObjSts02ID FourDRadarObjSts02LifeCycles FourDRadarObjSts02ObjBoundingBoxHeight FourDRadarObjSts02ObjBoundingBoxLength FourDRadarObjSts02ObjBoundingBoxWidth FourDRadarObjSts02ObjNearestPtX FourDRadarObjSts02ObjNearestPtY FourDRadarObjSts02ObjNearestPtZ FourDRadarObjSts02ObjSNR FourDRadarObjSts02ObjXAccRel FourDRadarObjSts02ObjYAccRel FourDRadarObjSts02ObstacleProbability FourDRadarObjSts02ProbabilityOfExistence FourDRadarObjSts02RCS FourDRadarObjSts02TargetClassificationConfidence FourDRadarObjSts02UpdateFlag FourDRadarObjSts02VabsX FourDRadarObjSts02VabsXStd FourDRadarObjSts02VabsY FourDRadarObjSts02VabsYStd FourDRadarObjSts02ValidFlag;
SIG_GROUP_ 882 FourDRadarObjSts03 1 : FourDRadarObjSts03Chks FourDRadarObjSts03Classification FourDRadarObjSts03Cntr FourDRadarObjSts03DistX FourDRadarObjSts03DistXStd FourDRadarObjSts03DistY FourDRadarObjSts03DistYStd FourDRadarObjSts03DistZ FourDRadarObjSts03DistZStd FourDRadarObjSts03DynamicProperty FourDRadarObjSts03HeadingAngle FourDRadarObjSts03ID FourDRadarObjSts03LifeCycles FourDRadarObjSts03ObjBoundingBoxHeight FourDRadarObjSts03ObjBoundingBoxLength FourDRadarObjSts03ObjBoundingBoxWidth FourDRadarObjSts03ObjNearestPtX FourDRadarObjSts03ObjNearestPtY FourDRadarObjSts03ObjNearestPtZ FourDRadarObjSts03ObjSNR FourDRadarObjSts03ObjXAccRel FourDRadarObjSts03ObjYAccRel FourDRadarObjSts03ObstacleProbability FourDRadarObjSts03ProbabilityOfExistence FourDRadarObjSts03RCS FourDRadarObjSts03TargetClassificationConfidence FourDRadarObjSts03UpdateFlag FourDRadarObjSts03VabsX FourDRadarObjSts03VabsXStd FourDRadarObjSts03VabsY FourDRadarObjSts03VabsYStd FourDRadarObjSts03ValidFlag;
SIG_GROUP_ 883 FourDRadarObjSts05 1 : FourDRadarObjSts05Chks FourDRadarObjSts05Classification FourDRadarObjSts05Cntr FourDRadarObjSts05DistX FourDRadarObjSts05DistXStd FourDRadarObjSts05DistY FourDRadarObjSts05DistYStd FourDRadarObjSts05DistZ FourDRadarObjSts05DistZStd FourDRadarObjSts05DynamicProperty FourDRadarObjSts05HeadingAngle FourDRadarObjSts05ID FourDRadarObjSts05LifeCycles FourDRadarObjSts05ObjBoundingBoxHeight FourDRadarObjSts05ObjBoundingBoxLength FourDRadarObjSts05ObjBoundingBoxWidth FourDRadarObjSts05ObjNearestPtX FourDRadarObjSts05ObjNearestPtY FourDRadarObjSts05ObjNearestPtZ FourDRadarObjSts05ObjSNR FourDRadarObjSts05ObjXAccRel FourDRadarObjSts05ObjYAccRel FourDRadarObjSts05ObstacleProbability FourDRadarObjSts05ProbabilityOfExistence FourDRadarObjSts05RCS FourDRadarObjSts05TargetClassificationConfidence FourDRadarObjSts05UpdateFlag FourDRadarObjSts05VabsX FourDRadarObjSts05VabsXStd FourDRadarObjSts05VabsY FourDRadarObjSts05VabsYStd FourDRadarObjSts05ValidFlag;
SIG_GROUP_ 884 FourDRadarObjSts07 1 : FourDRadarObjSts07Chks FourDRadarObjSts07Classification FourDRadarObjSts07Cntr FourDRadarObjSts07DistX FourDRadarObjSts07DistXStd FourDRadarObjSts07DistY FourDRadarObjSts07DistYStd FourDRadarObjSts07DistZ FourDRadarObjSts07DistZStd FourDRadarObjSts07DynamicProperty FourDRadarObjSts07HeadingAngle FourDRadarObjSts07ID FourDRadarObjSts07LifeCycles FourDRadarObjSts07ObjBoundingBoxHeight FourDRadarObjSts07ObjBoundingBoxLength FourDRadarObjSts07ObjBoundingBoxWidth FourDRadarObjSts07ObjNearestPtX FourDRadarObjSts07ObjNearestPtY FourDRadarObjSts07ObjNearestPtZ FourDRadarObjSts07ObjSNR FourDRadarObjSts07ObjXAccRel FourDRadarObjSts07ObjYAccRel FourDRadarObjSts07ObstacleProbability FourDRadarObjSts07ProbabilityOfExistence FourDRadarObjSts07RCS FourDRadarObjSts07TargetClassificationConfidence FourDRadarObjSts07UpdateFlag FourDRadarObjSts07VabsX FourDRadarObjSts07VabsXStd FourDRadarObjSts07VabsY FourDRadarObjSts07VabsYStd FourDRadarObjSts07ValidFlag;
SIG_GROUP_ 885 FourDRadarObjSts09 1 : FourDRadarObjSts09Chks FourDRadarObjSts09Classification FourDRadarObjSts09Cntr FourDRadarObjSts09DistX FourDRadarObjSts09DistXStd FourDRadarObjSts09DistY FourDRadarObjSts09DistYStd FourDRadarObjSts09DistZ FourDRadarObjSts09DistZStd FourDRadarObjSts09DynamicProperty FourDRadarObjSts09HeadingAngle FourDRadarObjSts09ID FourDRadarObjSts09LifeCycles FourDRadarObjSts09ObjBoundingBoxHeight FourDRadarObjSts09ObjBoundingBoxLength FourDRadarObjSts09ObjBoundingBoxWidth FourDRadarObjSts09ObjNearestPtX FourDRadarObjSts09ObjNearestPtY FourDRadarObjSts09ObjNearestPtZ FourDRadarObjSts09ObjSNR FourDRadarObjSts09ObjXAccRel FourDRadarObjSts09ObjYAccRel FourDRadarObjSts09ObstacleProbability FourDRadarObjSts09ProbabilityOfExistence FourDRadarObjSts09RCS FourDRadarObjSts09TargetClassificationConfidence FourDRadarObjSts09UpdateFlag FourDRadarObjSts09VabsX FourDRadarObjSts09VabsXStd FourDRadarObjSts09VabsY FourDRadarObjSts09VabsYStd FourDRadarObjSts09ValidFlag;
SIG_GROUP_ 886 FourDRadarObjSts11 1 : FourDRadarObjSts11Chks FourDRadarObjSts11Classification FourDRadarObjSts11Cntr FourDRadarObjSts11DistX FourDRadarObjSts11DistXStd FourDRadarObjSts11DistY FourDRadarObjSts11DistYStd FourDRadarObjSts11DistZ FourDRadarObjSts11DistZStd FourDRadarObjSts11DynamicProperty FourDRadarObjSts11HeadingAngle FourDRadarObjSts11ID FourDRadarObjSts11LifeCycles FourDRadarObjSts11ObjBoundingBoxHeight FourDRadarObjSts11ObjBoundingBoxLength FourDRadarObjSts11ObjBoundingBoxWidth FourDRadarObjSts11ObjNearestPtX FourDRadarObjSts11ObjNearestPtY FourDRadarObjSts11ObjNearestPtZ FourDRadarObjSts11ObjSNR FourDRadarObjSts11ObjXAccRel FourDRadarObjSts11ObjYAccRel FourDRadarObjSts11ObstacleProbability FourDRadarObjSts11ProbabilityOfExistence FourDRadarObjSts11RCS FourDRadarObjSts11TargetClassificationConfidence FourDRadarObjSts11UpdateFlag FourDRadarObjSts11VabsX FourDRadarObjSts11VabsXStd FourDRadarObjSts11VabsY FourDRadarObjSts11VabsYStd FourDRadarObjSts11ValidFlag;
SIG_GROUP_ 887 FourDRadarObjSts13 1 : FourDRadarObjSts13Chks FourDRadarObjSts13Classification FourDRadarObjSts13Cntr FourDRadarObjSts13DistX FourDRadarObjSts13DistXStd FourDRadarObjSts13DistY FourDRadarObjSts13DistYStd FourDRadarObjSts13DistZ FourDRadarObjSts13DistZStd FourDRadarObjSts13DynamicProperty FourDRadarObjSts13HeadingAngle FourDRadarObjSts13ID FourDRadarObjSts13LifeCycles FourDRadarObjSts13ObjBoundingBoxHeight FourDRadarObjSts13ObjBoundingBoxLength FourDRadarObjSts13ObjBoundingBoxWidth FourDRadarObjSts13ObjNearestPtX FourDRadarObjSts13ObjNearestPtY FourDRadarObjSts13ObjNearestPtZ FourDRadarObjSts13ObjSNR FourDRadarObjSts13ObjXAccRel FourDRadarObjSts13ObjYAccRel FourDRadarObjSts13ObstacleProbability FourDRadarObjSts13ProbabilityOfExistence FourDRadarObjSts13RCS FourDRadarObjSts13TargetClassificationConfidence FourDRadarObjSts13UpdateFlag FourDRadarObjSts13VabsX FourDRadarObjSts13VabsXStd FourDRadarObjSts13VabsY FourDRadarObjSts13VabsYStd FourDRadarObjSts13ValidFlag;
SIG_GROUP_ 888 FourDRadarObjSts15 1 : FourDRadarObjSts15Chks FourDRadarObjSts15Classification FourDRadarObjSts15Cntr FourDRadarObjSts15DistX FourDRadarObjSts15DistXStd FourDRadarObjSts15DistY FourDRadarObjSts15DistYStd FourDRadarObjSts15DistZ FourDRadarObjSts15DistZStd FourDRadarObjSts15DynamicProperty FourDRadarObjSts15HeadingAngle FourDRadarObjSts15ID FourDRadarObjSts15LifeCycles FourDRadarObjSts15ObjBoundingBoxHeight FourDRadarObjSts15ObjBoundingBoxLength FourDRadarObjSts15ObjBoundingBoxWidth FourDRadarObjSts15ObjNearestPtX FourDRadarObjSts15ObjNearestPtY FourDRadarObjSts15ObjNearestPtZ FourDRadarObjSts15ObjSNR FourDRadarObjSts15ObjXAccRel FourDRadarObjSts15ObjYAccRel FourDRadarObjSts15ObstacleProbability FourDRadarObjSts15ProbabilityOfExistence FourDRadarObjSts15RCS FourDRadarObjSts15TargetClassificationConfidence FourDRadarObjSts15UpdateFlag FourDRadarObjSts15VabsX FourDRadarObjSts15VabsXStd FourDRadarObjSts15VabsY FourDRadarObjSts15VabsYStd FourDRadarObjSts15ValidFlag;
SIG_GROUP_ 889 FourDRadarObjSts17 1 : FourDRadarObjSts17Chks FourDRadarObjSts17Classification FourDRadarObjSts17Cntr FourDRadarObjSts17DistX FourDRadarObjSts17DistXStd FourDRadarObjSts17DistY FourDRadarObjSts17DistYStd FourDRadarObjSts17DistZ FourDRadarObjSts17DistZStd FourDRadarObjSts17DynamicProperty FourDRadarObjSts17HeadingAngle FourDRadarObjSts17ID FourDRadarObjSts17LifeCycles FourDRadarObjSts17ObjBoundingBoxHeight FourDRadarObjSts17ObjBoundingBoxLength FourDRadarObjSts17ObjBoundingBoxWidth FourDRadarObjSts17ObjNearestPtX FourDRadarObjSts17ObjNearestPtY FourDRadarObjSts17ObjNearestPtZ FourDRadarObjSts17ObjSNR FourDRadarObjSts17ObjXAccRel FourDRadarObjSts17ObjYAccRel FourDRadarObjSts17ObstacleProbability FourDRadarObjSts17ProbabilityOfExistence FourDRadarObjSts17RCS FourDRadarObjSts17TargetClassificationConfidence FourDRadarObjSts17UpdateFlag FourDRadarObjSts17VabsX FourDRadarObjSts17VabsXStd FourDRadarObjSts17VabsY FourDRadarObjSts17VabsYStd FourDRadarObjSts17ValidFlag;
SIG_GROUP_ 890 FourDRadarObjSts19 1 : FourDRadarObjSts19Chks FourDRadarObjSts19Classification FourDRadarObjSts19Cntr FourDRadarObjSts19DistX FourDRadarObjSts19DistXStd FourDRadarObjSts19DistY FourDRadarObjSts19DistYStd FourDRadarObjSts19DistZ FourDRadarObjSts19DistZStd FourDRadarObjSts19DynamicProperty FourDRadarObjSts19HeadingAngle FourDRadarObjSts19ID FourDRadarObjSts19LifeCycles FourDRadarObjSts19ObjBoundingBoxHeight FourDRadarObjSts19ObjBoundingBoxLength FourDRadarObjSts19ObjBoundingBoxWidth FourDRadarObjSts19ObjNearestPtX FourDRadarObjSts19ObjNearestPtY FourDRadarObjSts19ObjNearestPtZ FourDRadarObjSts19ObjSNR FourDRadarObjSts19ObjXAccRel FourDRadarObjSts19ObjYAccRel FourDRadarObjSts19ObstacleProbability FourDRadarObjSts19ProbabilityOfExistence FourDRadarObjSts19RCS FourDRadarObjSts19TargetClassificationConfidence FourDRadarObjSts19UpdateFlag FourDRadarObjSts19VabsX FourDRadarObjSts19VabsXStd FourDRadarObjSts19VabsY FourDRadarObjSts19VabsYStd FourDRadarObjSts19ValidFlag;
SIG_GROUP_ 891 FourDRadarObjSts21 1 : FourDRadarObjSts21Chks FourDRadarObjSts21Classification FourDRadarObjSts21Cntr FourDRadarObjSts21DistX FourDRadarObjSts21DistXStd FourDRadarObjSts21DistY FourDRadarObjSts21DistYStd FourDRadarObjSts21DistZ FourDRadarObjSts21DistZStd FourDRadarObjSts21DynamicProperty FourDRadarObjSts21HeadingAngle FourDRadarObjSts21ID FourDRadarObjSts21LifeCycles FourDRadarObjSts21ObjBoundingBoxHeight FourDRadarObjSts21ObjBoundingBoxLength FourDRadarObjSts21ObjBoundingBoxWidth FourDRadarObjSts21ObjNearestPtX FourDRadarObjSts21ObjNearestPtY FourDRadarObjSts21ObjNearestPtZ FourDRadarObjSts21ObjSNR FourDRadarObjSts21ObjXAccRel FourDRadarObjSts21ObjYAccRel FourDRadarObjSts21ObstacleProbability FourDRadarObjSts21ProbabilityOfExistence FourDRadarObjSts21RCS FourDRadarObjSts21TargetClassificationConfidence FourDRadarObjSts21UpdateFlag FourDRadarObjSts21VabsX FourDRadarObjSts21VabsXStd FourDRadarObjSts21VabsY FourDRadarObjSts21VabsYStd FourDRadarObjSts21ValidFlag;
SIG_GROUP_ 892 FourDRadarObjSts23 1 : FourDRadarObjSts23Chks FourDRadarObjSts23Classification FourDRadarObjSts23Cntr FourDRadarObjSts23DistX FourDRadarObjSts23DistXStd FourDRadarObjSts23DistY FourDRadarObjSts23DistYStd FourDRadarObjSts23DistZ FourDRadarObjSts23DistZStd FourDRadarObjSts23DynamicProperty FourDRadarObjSts23HeadingAngle FourDRadarObjSts23ID FourDRadarObjSts23LifeCycles FourDRadarObjSts23ObjBoundingBoxHeight FourDRadarObjSts23ObjBoundingBoxLength FourDRadarObjSts23ObjBoundingBoxWidth FourDRadarObjSts23ObjNearestPtX FourDRadarObjSts23ObjNearestPtY FourDRadarObjSts23ObjNearestPtZ FourDRadarObjSts23ObjSNR FourDRadarObjSts23ObjXAccRel FourDRadarObjSts23ObjYAccRel FourDRadarObjSts23ObstacleProbability FourDRadarObjSts23ProbabilityOfExistence FourDRadarObjSts23RCS FourDRadarObjSts23TargetClassificationConfidence FourDRadarObjSts23UpdateFlag FourDRadarObjSts23VabsX FourDRadarObjSts23VabsXStd FourDRadarObjSts23VabsY FourDRadarObjSts23VabsYStd FourDRadarObjSts23ValidFlag;
SIG_GROUP_ 893 FourDRadarObjSts25 1 : FourDRadarObjSts25Chks FourDRadarObjSts25Classification FourDRadarObjSts25Cntr FourDRadarObjSts25DistX FourDRadarObjSts25DistXStd FourDRadarObjSts25DistY FourDRadarObjSts25DistYStd FourDRadarObjSts25DistZ FourDRadarObjSts25DistZStd FourDRadarObjSts25DynamicProperty FourDRadarObjSts25HeadingAngle FourDRadarObjSts25ID FourDRadarObjSts25LifeCycles FourDRadarObjSts25ObjBoundingBoxHeight FourDRadarObjSts25ObjBoundingBoxLength FourDRadarObjSts25ObjBoundingBoxWidth FourDRadarObjSts25ObjNearestPtX FourDRadarObjSts25ObjNearestPtY FourDRadarObjSts25ObjNearestPtZ FourDRadarObjSts25ObjSNR FourDRadarObjSts25ObjXAccRel FourDRadarObjSts25ObjYAccRel FourDRadarObjSts25ObstacleProbability FourDRadarObjSts25ProbabilityOfExistence FourDRadarObjSts25RCS FourDRadarObjSts25TargetClassificationConfidence FourDRadarObjSts25UpdateFlag FourDRadarObjSts25VabsX FourDRadarObjSts25VabsXStd FourDRadarObjSts25VabsY FourDRadarObjSts25VabsYStd FourDRadarObjSts25ValidFlag;
SIG_GROUP_ 894 FourDRadarObjSts27 1 : FourDRadarObjSts27Chks FourDRadarObjSts27Classification FourDRadarObjSts27Cntr FourDRadarObjSts27DistX FourDRadarObjSts27DistXStd FourDRadarObjSts27DistY FourDRadarObjSts27DistYStd FourDRadarObjSts27DistZ FourDRadarObjSts27DistZStd FourDRadarObjSts27DynamicProperty FourDRadarObjSts27HeadingAngle FourDRadarObjSts27ID FourDRadarObjSts27LifeCycles FourDRadarObjSts27ObjBoundingBoxHeight FourDRadarObjSts27ObjBoundingBoxLength FourDRadarObjSts27ObjBoundingBoxWidth FourDRadarObjSts27ObjNearestPtX FourDRadarObjSts27ObjNearestPtY FourDRadarObjSts27ObjNearestPtZ FourDRadarObjSts27ObjSNR FourDRadarObjSts27ObjXAccRel FourDRadarObjSts27ObjYAccRel FourDRadarObjSts27ObstacleProbability FourDRadarObjSts27ProbabilityOfExistence FourDRadarObjSts27RCS FourDRadarObjSts27TargetClassificationConfidence FourDRadarObjSts27UpdateFlag FourDRadarObjSts27VabsX FourDRadarObjSts27VabsXStd FourDRadarObjSts27VabsY FourDRadarObjSts27VabsYStd FourDRadarObjSts27ValidFlag;
SIG_GROUP_ 895 FourDRadarObjSts29 1 : FourDRadarObjSts29Chks FourDRadarObjSts29Classification FourDRadarObjSts29Cntr FourDRadarObjSts29DistX FourDRadarObjSts29DistXStd FourDRadarObjSts29DistY FourDRadarObjSts29DistYStd FourDRadarObjSts29DistZ FourDRadarObjSts29DistZStd FourDRadarObjSts29DynamicProperty FourDRadarObjSts29HeadingAngle FourDRadarObjSts29ID FourDRadarObjSts29LifeCycles FourDRadarObjSts29ObjBoundingBoxHeight FourDRadarObjSts29ObjBoundingBoxLength FourDRadarObjSts29ObjBoundingBoxWidth FourDRadarObjSts29ObjNearestPtX FourDRadarObjSts29ObjNearestPtY FourDRadarObjSts29ObjNearestPtZ FourDRadarObjSts29ObjSNR FourDRadarObjSts29ObjXAccRel FourDRadarObjSts29ObjYAccRel FourDRadarObjSts29ObstacleProbability FourDRadarObjSts29ProbabilityOfExistence FourDRadarObjSts29RCS FourDRadarObjSts29TargetClassificationConfidence FourDRadarObjSts29UpdateFlag FourDRadarObjSts29VabsX FourDRadarObjSts29VabsXStd FourDRadarObjSts29VabsY FourDRadarObjSts29VabsYStd FourDRadarObjSts29ValidFlag;
SIG_GROUP_ 896 FourDRadarObjSts31 1 : FourDRadarObjSts31Chks FourDRadarObjSts31Classification FourDRadarObjSts31Cntr FourDRadarObjSts31DistX FourDRadarObjSts31DistXStd FourDRadarObjSts31DistY FourDRadarObjSts31DistYStd FourDRadarObjSts31DistZ FourDRadarObjSts31DistZStd FourDRadarObjSts31DynamicProperty FourDRadarObjSts31HeadingAngle FourDRadarObjSts31ID FourDRadarObjSts31LifeCycles FourDRadarObjSts31ObjBoundingBoxHeight FourDRadarObjSts31ObjBoundingBoxLength FourDRadarObjSts31ObjBoundingBoxWidth FourDRadarObjSts31ObjNearestPtX FourDRadarObjSts31ObjNearestPtY FourDRadarObjSts31ObjNearestPtZ FourDRadarObjSts31ObjSNR FourDRadarObjSts31ObjXAccRel FourDRadarObjSts31ObjYAccRel FourDRadarObjSts31ObstacleProbability FourDRadarObjSts31ProbabilityOfExistence FourDRadarObjSts31RCS FourDRadarObjSts31TargetClassificationConfidence FourDRadarObjSts31UpdateFlag FourDRadarObjSts31VabsX FourDRadarObjSts31VabsXStd FourDRadarObjSts31VabsY FourDRadarObjSts31VabsYStd FourDRadarObjSts31ValidFlag;
SIG_GROUP_ 897 FourDRadarObjSts33 1 : FourDRadarObjSts33Chks FourDRadarObjSts33Classification FourDRadarObjSts33Cntr FourDRadarObjSts33DistX FourDRadarObjSts33DistXStd FourDRadarObjSts33DistY FourDRadarObjSts33DistYStd FourDRadarObjSts33DistZ FourDRadarObjSts33DistZStd FourDRadarObjSts33DynamicProperty FourDRadarObjSts33HeadingAngle FourDRadarObjSts33ID FourDRadarObjSts33LifeCycles FourDRadarObjSts33ObjBoundingBoxHeight FourDRadarObjSts33ObjBoundingBoxLength FourDRadarObjSts33ObjBoundingBoxWidth FourDRadarObjSts33ObjNearestPtX FourDRadarObjSts33ObjNearestPtY FourDRadarObjSts33ObjNearestPtZ FourDRadarObjSts33ObjSNR FourDRadarObjSts33ObjXAccRel FourDRadarObjSts33ObjYAccRel FourDRadarObjSts33ObstacleProbability FourDRadarObjSts33ProbabilityOfExistence FourDRadarObjSts33RCS FourDRadarObjSts33TargetClassificationConfidence FourDRadarObjSts33UpdateFlag FourDRadarObjSts33VabsX FourDRadarObjSts33VabsXStd FourDRadarObjSts33VabsY FourDRadarObjSts33VabsYStd FourDRadarObjSts33ValidFlag;
SIG_GROUP_ 898 FourDRadarObjSts35 1 : FourDRadarObjSts35Chks FourDRadarObjSts35Classification FourDRadarObjSts35Cntr FourDRadarObjSts35DistX FourDRadarObjSts35DistXStd FourDRadarObjSts35DistY FourDRadarObjSts35DistYStd FourDRadarObjSts35DistZ FourDRadarObjSts35DistZStd FourDRadarObjSts35DynamicProperty FourDRadarObjSts35HeadingAngle FourDRadarObjSts35ID FourDRadarObjSts35LifeCycles FourDRadarObjSts35ObjBoundingBoxHeight FourDRadarObjSts35ObjBoundingBoxLength FourDRadarObjSts35ObjBoundingBoxWidth FourDRadarObjSts35ObjNearestPtX FourDRadarObjSts35ObjNearestPtY FourDRadarObjSts35ObjNearestPtZ FourDRadarObjSts35ObjSNR FourDRadarObjSts35ObjXAccRel FourDRadarObjSts35ObjYAccRel FourDRadarObjSts35ObstacleProbability FourDRadarObjSts35ProbabilityOfExistence FourDRadarObjSts35RCS FourDRadarObjSts35TargetClassificationConfidence FourDRadarObjSts35UpdateFlag FourDRadarObjSts35VabsX FourDRadarObjSts35VabsXStd FourDRadarObjSts35VabsY FourDRadarObjSts35VabsYStd FourDRadarObjSts35ValidFlag;
